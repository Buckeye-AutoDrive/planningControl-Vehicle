/******************************************************************************
* ASAP2 file: ModelWithControllersOnly.a2l
* Academic License - for use in teaching, academic research, and meeting
* course requirements at degree granting institutions only. Not for
* government, commercial, or other organizational use.
* Code generation for model "ModelWithControllersOnly".
* Model version : 2.117
* Simulink Coder version : 10.4 R2021b
* C source code generated on : Thu Sep 29 18:40:39 2022
* Target selection: slrealtime.tlc
* Embedded hardware selection: Intel->x86-64 (Linux 64)
* Code generation objectives: Unspecified
* Validation result: Not run
* (add additional file header information here)
******************************************************************************/
ASAP2_VERSION 1 71
/begin PROJECT ProjectName "Project Comment Goes Here"
/begin HEADER "Header Comments go here" /end HEADER
/begin MODULE ModuleName "Module Comment Goes Here"
/begin IF_DATA XCP
 /begin PROTOCOL_LAYER 0x0100 0x03E8 0x00C8 0x0000 0x0000 0x0000 0x0000 0x0000 0xFC 0x0578 BYTE_ORDER_MSB_LAST ADDRESS_GRANULARITY_BYTE OPTIONAL_CMD ALLOC_ODT_ENTRY OPTIONAL_CMD ALLOC_ODT OPTIONAL_CMD ALLOC_DAQ OPTIONAL_CMD FREE_DAQ OPTIONAL_CMD GET_DAQ_CLOCK OPTIONAL_CMD GET_DAQ_RESOLUTION_INFO OPTIONAL_CMD GET_DAQ_PROCESSOR_INFO OPTIONAL_CMD START_STOP_SYNCH OPTIONAL_CMD START_STOP_DAQ_LIST OPTIONAL_CMD SET_DAQ_LIST_MODE OPTIONAL_CMD WRITE_DAQ OPTIONAL_CMD SET_DAQ_PTR OPTIONAL_CMD GET_CAL_PAGE OPTIONAL_CMD SET_CAL_PAGE OPTIONAL_CMD COPY_CAL_PAGE OPTIONAL_CMD SHORT_DOWNLOAD OPTIONAL_CMD DOWNLOAD_MAX OPTIONAL_CMD DOWNLOAD OPTIONAL_CMD SHORT_UPLOAD OPTIONAL_CMD UPLOAD OPTIONAL_CMD SET_MTA OPTIONAL_CMD GET_SEGMENT_INFO OPTIONAL_CMD GET_PAGE_INFO OPTIONAL_CMD SET_SEGMENT_MODE OPTIONAL_CMD GET_SEGMENT_MODE OPTIONAL_CMD GET_PAG_PROCESSOR_INFO OPTIONAL_CMD MODIFY_BITS /end PROTOCOL_LAYER
 /begin DAQ DYNAMIC 0x0000 0x0080 0x00 OPTIMISATION_TYPE_DEFAULT ADDRESS_EXTENSION_FREE IDENTIFICATION_FIELD_TYPE_RELATIVE_WORD_ALIGNED GRANULARITY_ODT_ENTRY_SIZE_DAQ_BYTE 0xFF OVERLOAD_INDICATION_PID PRESCALER_SUPPORTED /begin STIM GRANULARITY_ODT_ENTRY_SIZE_STIM_BYTE 0xFF /end STIM /begin TIMESTAMP_SUPPORTED 0x0001 SIZE_DWORD UNIT_1US TIMESTAMP_FIXED /end TIMESTAMP_SUPPORTED /begin EVENT "10 ms" "10 ms" 0x0000 DAQ 0xFF 0x01 0x07 0x00 /end EVENT /begin EVENT "50 ms" "50 ms" 0x0001 DAQ 0xFF 0x05 0x07 0x00 /end EVENT /end DAQ
 /begin XCP_ON_UDP_IP 0x0100 0x15B3 ADDRESS "192.168.7.2" /end XCP_ON_UDP_IP
/end IF_DATA
/begin MOD_PAR "MOD PAR Comment Goes Here"
 /begin MEMORY_SEGMENT RTE_Param_Service "RTE_Param_Service" DATA FLASH INTERN 0x0026C4A0 0x118 -1 -1 -1 -1 -1
  /begin IF_DATA XCP
   /begin SEGMENT 0x00 0x02 0x00 0x00 0x00
    /begin PAGE 0x00 ECU_ACCESS_DONT_CARE XCP_READ_ACCESS_DONT_CARE XCP_WRITE_ACCESS_NOT_ALLOWED /end PAGE
    /begin PAGE 0x01 ECU_ACCESS_DONT_CARE XCP_READ_ACCESS_DONT_CARE XCP_WRITE_ACCESS_DONT_CARE /end PAGE
   /end SEGMENT
  /end IF_DATA
 /end MEMORY_SEGMENT
 /begin MEMORY_SEGMENT ModelWithControllersOn_cal_impl "ModelWithControllersOn_cal_impl" DATA FLASH INTERN 0x0026BC20 0x878 -1 -1 -1 -1 -1
  /begin IF_DATA XCP
   /begin SEGMENT 0x01 0x02 0x00 0x00 0x00
    /begin PAGE 0x00 ECU_ACCESS_DONT_CARE XCP_READ_ACCESS_DONT_CARE XCP_WRITE_ACCESS_NOT_ALLOWED /end PAGE
    /begin PAGE 0x01 ECU_ACCESS_DONT_CARE XCP_READ_ACCESS_DONT_CARE XCP_WRITE_ACCESS_DONT_CARE /end PAGE
   /end SEGMENT
  /end IF_DATA
 /end MEMORY_SEGMENT
/end MOD_PAR
/begin MOD_COMMON "Mod Common Comment Here" BYTE_ORDER MSB_LAST ALIGNMENT_BYTE 1 ALIGNMENT_WORD 2 ALIGNMENT_LONG 4 ALIGNMENT_FLOAT32_IEEE 4 ALIGNMENT_FLOAT64_IEEE 8 ALIGNMENT_INT64 8 /end MOD_COMMON
/begin CHARACTERISTIC ModelWithControllersOn_cal_impl.Constant1_Value "" VALUE 0x0026C118 Scalar_FLOAT64_IEEE 0 ModelWithControllersOnly_CM_double -1.7E+308 1.7E+308 /end CHARACTERISTIC
/begin CHARACTERISTIC ModelWithControllersOn_cal_impl.Constant1_Value_b "" VALUE 0x0026C418 Scalar_FLOAT64_IEEE 0 ModelWithControllersOnly_CM_double -1.7E+308 1.7E+308 /end CHARACTERISTIC
/begin CHARACTERISTIC ModelWithControllersOn_cal_impl.Constant1_Value_f "" VALUE 0x0026C130 Scalar_FLOAT64_IEEE 0 ModelWithControllersOnly_CM_double -1.7E+308 1.7E+308 /end CHARACTERISTIC
/begin CHARACTERISTIC ModelWithControllersOn_cal_impl.Constant1_Value_k "" VALUE 0x0026C170 Scalar_FLOAT64_IEEE 0 ModelWithControllersOnly_CM_double -1.7E+308 1.7E+308 /end CHARACTERISTIC
/begin CHARACTERISTIC ModelWithControllersOn_cal_impl.Constant1_Value_ks "" VALUE 0x0026C448 Scalar_FLOAT64_IEEE 0 ModelWithControllersOnly_CM_double -1.7E+308 1.7E+308 /end CHARACTERISTIC
/begin CHARACTERISTIC ModelWithControllersOn_cal_impl.Constant2_Value_e "" VALUE 0x0026C430 Scalar_FLOAT64_IEEE 0 ModelWithControllersOnly_CM_double -1.7E+308 1.7E+308 /end CHARACTERISTIC
/begin CHARACTERISTIC ModelWithControllersOn_cal_impl.Constant2_Value_g "" VALUE 0x0026C350 Scalar_FLOAT64_IEEE 0 ModelWithControllersOnly_CM_double -1.7E+308 1.7E+308 /end CHARACTERISTIC
/begin CHARACTERISTIC ModelWithControllersOn_cal_impl.Constant2_Value_i "" VALUE 0x0026C458 Scalar_FLOAT64_IEEE 0 ModelWithControllersOnly_CM_double -1.7E+308 1.7E+308 /end CHARACTERISTIC
/begin CHARACTERISTIC ModelWithControllersOn_cal_impl.Constant2_Value_o "" VALUE 0x0026C420 Scalar_FLOAT64_IEEE 0 ModelWithControllersOnly_CM_double -1.7E+308 1.7E+308 /end CHARACTERISTIC
/begin CHARACTERISTIC ModelWithControllersOn_cal_impl.Constant3_Value_g "" VALUE 0x0026C400 Scalar_FLOAT64_IEEE 0 ModelWithControllersOnly_CM_double -1.7E+308 1.7E+308 /end CHARACTERISTIC
/begin CHARACTERISTIC ModelWithControllersOn_cal_impl.Constant3_Value_j2 "" VALUE 0x0026C438 Scalar_FLOAT64_IEEE 0 ModelWithControllersOnly_CM_double -1.7E+308 1.7E+308 /end CHARACTERISTIC
/begin CHARACTERISTIC ModelWithControllersOn_cal_impl.Constant3_Value_n "" VALUE 0x0026C450 Scalar_FLOAT64_IEEE 0 ModelWithControllersOnly_CM_double -1.7E+308 1.7E+308 /end CHARACTERISTIC
/begin CHARACTERISTIC ModelWithControllersOn_cal_impl.Constant4_Value "" VAL_BLK 0x0026BF48 Scalar_FLOAT64_IEEE 0 ModelWithControllersOnly_CM_double -1.7E+308 1.7E+308 MATRIX_DIM 3 1 /end CHARACTERISTIC
/begin CHARACTERISTIC ModelWithControllersOn_cal_impl.Constant4_Value_a "" VAL_BLK 0x0026BF98 Scalar_FLOAT64_IEEE 0 ModelWithControllersOnly_CM_double -1.7E+308 1.7E+308 MATRIX_DIM 1 3 /end CHARACTERISTIC
/begin CHARACTERISTIC ModelWithControllersOn_cal_impl.Constant4_Value_ad "" VALUE 0x0026C408 Scalar_FLOAT64_IEEE 0 ModelWithControllersOnly_CM_double -1.7E+308 1.7E+308 /end CHARACTERISTIC
/begin CHARACTERISTIC ModelWithControllersOn_cal_impl.Constant4_Value_i "" VALUE 0x0026C440 Scalar_FLOAT64_IEEE 0 ModelWithControllersOnly_CM_double -1.7E+308 1.7E+308 /end CHARACTERISTIC
/begin CHARACTERISTIC ModelWithControllersOn_cal_impl.Constant5_Value_h "" VALUE 0x0026C428 Scalar_FLOAT64_IEEE 0 ModelWithControllersOnly_CM_double -1.7E+308 1.7E+308 /end CHARACTERISTIC
/begin CHARACTERISTIC ModelWithControllersOn_cal_impl.Constant9_Value "" VALUE 0x0026C278 Scalar_FLOAT64_IEEE 0 ModelWithControllersOnly_CM_double -1.7E+308 1.7E+308 /end CHARACTERISTIC
/begin CHARACTERISTIC ModelWithControllersOn_cal_impl.Constant_Value "" VALUE 0x0026C178 Scalar_FLOAT64_IEEE 0 ModelWithControllersOnly_CM_double -1.7E+308 1.7E+308 /end CHARACTERISTIC
/begin CHARACTERISTIC ModelWithControllersOn_cal_impl.Constant_Value_c "" VALUE 0x0026C468 Scalar_FLOAT64_IEEE 0 ModelWithControllersOnly_CM_double -1.7E+308 1.7E+308 /end CHARACTERISTIC
/begin CHARACTERISTIC ModelWithControllersOn_cal_impl.Constant_Value_d "" VALUE 0x0026C228 Scalar_FLOAT64_IEEE 0 ModelWithControllersOnly_CM_double -1.7E+308 1.7E+308 /end CHARACTERISTIC
/begin CHARACTERISTIC ModelWithControllersOn_cal_impl.Constant_Value_h "" VALUE 0x0026C410 Scalar_FLOAT64_IEEE 0 ModelWithControllersOnly_CM_double -1.7E+308 1.7E+308 /end CHARACTERISTIC
/begin CHARACTERISTIC ModelWithControllersOn_cal_impl.Constant_Value_k "" VALUE 0x0026C368 Scalar_FLOAT64_IEEE 0 ModelWithControllersOnly_CM_double -1.7E+308 1.7E+308 /end CHARACTERISTIC
/begin CHARACTERISTIC ModelWithControllersOn_cal_impl.Constant_Value_ke "" VALUE 0x0026C480 Scalar_FLOAT64_IEEE 0 ModelWithControllersOnly_CM_double -1.7E+308 1.7E+308 /end CHARACTERISTIC
/begin CHARACTERISTIC ModelWithControllersOn_cal_impl.Crm_tableData "" CURVE 0x0026BF60 FixLookup_FLOAT64_IEEE 0 ModelWithControllersOnly_CM_double -1.7E+308 1.7E+308
 /begin AXIS_DESCR FIX_AXIS ModelWithControllersOnly_B.TrigonometricFunction ModelWithControllersOnly_CM_double 2 -1.000000 1.000000 FIX_AXIS_PAR -1 1 2 /end AXIS_DESCR
/end CHARACTERISTIC
/begin CHARACTERISTIC ModelWithControllersOn_cal_impl.DragForce_R "" VALUE 0x0026C078 Scalar_FLOAT64_IEEE 0 ModelWithControllersOnly_CM_double -1.7E+308 1.7E+308 /end CHARACTERISTIC
/begin CHARACTERISTIC ModelWithControllersOn_cal_impl.FirstOrderHold1_IniOut "" VALUE 0x0026C360 Scalar_FLOAT64_IEEE 0 ModelWithControllersOnly_CM_double -1.7E+308 1.7E+308 /end CHARACTERISTIC
/begin CHARACTERISTIC ModelWithControllersOn_cal_impl.FirstOrderHold_IniOut "" VALUE 0x0026C358 Scalar_FLOAT64_IEEE 0 ModelWithControllersOnly_CM_double -1.7E+308 1.7E+308 /end CHARACTERISTIC
/begin CHARACTERISTIC ModelWithControllersOn_cal_impl.Gain1_Gain "" VALUE 0x0026C168 Scalar_FLOAT64_IEEE 0 ModelWithControllersOnly_CM_double -1.7E+308 1.7E+308 /end CHARACTERISTIC
/begin CHARACTERISTIC ModelWithControllersOn_cal_impl.Gain1_Gain_a "" VALUE 0x0026C190 Scalar_FLOAT64_IEEE 0 ModelWithControllersOnly_CM_double -1.7E+308 1.7E+308 /end CHARACTERISTIC
/begin CHARACTERISTIC ModelWithControllersOn_cal_impl.Gain1_Gain_b "" VALUE 0x0026C2B0 Scalar_FLOAT64_IEEE 0 ModelWithControllersOnly_CM_double -1.7E+308 1.7E+308 /end CHARACTERISTIC
/begin CHARACTERISTIC ModelWithControllersOn_cal_impl.Gain1_Gain_d "" VALUE 0x0026C210 Scalar_FLOAT64_IEEE 0 ModelWithControllersOnly_CM_double -1.7E+308 1.7E+308 /end CHARACTERISTIC
/begin CHARACTERISTIC ModelWithControllersOn_cal_impl.Gain1_Gain_o "" VALUE 0x0026C188 Scalar_FLOAT64_IEEE 0 ModelWithControllersOnly_CM_double -1.7E+308 1.7E+308 /end CHARACTERISTIC
/begin CHARACTERISTIC ModelWithControllersOn_cal_impl.Gain1_Gain_p "" VALUE 0x0026C240 Scalar_FLOAT64_IEEE 0 ModelWithControllersOnly_CM_double -1.7E+308 1.7E+308 /end CHARACTERISTIC
/begin CHARACTERISTIC ModelWithControllersOn_cal_impl.Gain2_Gain "" VALUE 0x0026C218 Scalar_FLOAT64_IEEE 0 ModelWithControllersOnly_CM_double -1.7E+308 1.7E+308 /end CHARACTERISTIC
/begin CHARACTERISTIC ModelWithControllersOn_cal_impl.Gain2_Gain_c "" VALUE 0x0026C2B8 Scalar_FLOAT64_IEEE 0 ModelWithControllersOnly_CM_double -1.7E+308 1.7E+308 /end CHARACTERISTIC
/begin CHARACTERISTIC ModelWithControllersOn_cal_impl.Gain2_Gain_h "" VALUE 0x0026C248 Scalar_FLOAT64_IEEE 0 ModelWithControllersOnly_CM_double -1.7E+308 1.7E+308 /end CHARACTERISTIC
/begin CHARACTERISTIC ModelWithControllersOn_cal_impl.Gain3_Gain "" VALUE 0x0026C2C0 Scalar_FLOAT64_IEEE 0 ModelWithControllersOnly_CM_double -1.7E+308 1.7E+308 /end CHARACTERISTIC
/begin CHARACTERISTIC ModelWithControllersOn_cal_impl.Gain4_Gain "" VALUE 0x0026C2D0 Scalar_FLOAT64_IEEE 0 ModelWithControllersOnly_CM_double -1.7E+308 1.7E+308 /end CHARACTERISTIC
/begin CHARACTERISTIC ModelWithControllersOn_cal_impl.Gain5_Gain "" VALUE 0x0026C290 Scalar_FLOAT64_IEEE 0 ModelWithControllersOnly_CM_double -1.7E+308 1.7E+308 /end CHARACTERISTIC
/begin CHARACTERISTIC ModelWithControllersOn_cal_impl.Gain6_Gain "" VALUE 0x0026C2A0 Scalar_FLOAT64_IEEE 0 ModelWithControllersOnly_CM_double -1.7E+308 1.7E+308 /end CHARACTERISTIC
/begin CHARACTERISTIC ModelWithControllersOn_cal_impl.Gain_Gain "" VALUE 0x0026C180 Scalar_FLOAT64_IEEE 0 ModelWithControllersOnly_CM_double -1.7E+308 1.7E+308 /end CHARACTERISTIC
/begin CHARACTERISTIC ModelWithControllersOn_cal_impl.Gain_Gain_l "" VALUE 0x0026C288 Scalar_FLOAT64_IEEE 0 ModelWithControllersOnly_CM_double -1.7E+308 1.7E+308 /end CHARACTERISTIC
/begin CHARACTERISTIC ModelWithControllersOn_cal_impl.Integrator_IC "" VALUE 0x0026C208 Scalar_FLOAT64_IEEE 0 ModelWithControllersOnly_CM_double -1.7E+308 1.7E+308 /end CHARACTERISTIC
/begin CHARACTERISTIC ModelWithControllersOn_cal_impl.Integrator_IC_g "" VALUE 0x0026C238 Scalar_FLOAT64_IEEE 0 ModelWithControllersOnly_CM_double -1.7E+308 1.7E+308 /end CHARACTERISTIC
/begin CHARACTERISTIC ModelWithControllersOn_cal_impl.Integrator_gainval "" VALUE 0x0026C120 Scalar_FLOAT64_IEEE 0 ModelWithControllersOnly_CM_double -1.7E+308 1.7E+308 /end CHARACTERISTIC
/begin CHARACTERISTIC ModelWithControllersOn_cal_impl.Integrator_gainval_e "" VALUE 0x0026C138 Scalar_FLOAT64_IEEE 0 ModelWithControllersOnly_CM_double -1.7E+308 1.7E+308 /end CHARACTERISTIC
/begin CHARACTERISTIC ModelWithControllersOn_cal_impl.Kinematic_MaxSteeringAngle "" VALUE 0x0026C108 Scalar_FLOAT64_IEEE 0 ModelWithControllersOnly_CM_double -1.7E+308 1.7E+308 /end CHARACTERISTIC
/begin CHARACTERISTIC ModelWithControllersOn_cal_impl.Kinematic_Wheelbase "" VALUE 0x0026C110 Scalar_FLOAT64_IEEE 0 ModelWithControllersOnly_CM_double -1.7E+308 1.7E+308 /end CHARACTERISTIC
/begin CHARACTERISTIC ModelWithControllersOn_cal_impl.LateralControllerStanley_DelayG "" VALUE 0x0026C000 Scalar_FLOAT64_IEEE 0 ModelWithControllersOnly_CM_double -1.7E+308 1.7E+308 /end CHARACTERISTIC
/begin CHARACTERISTIC ModelWithControllersOn_cal_impl.LateralControllerStanley_Posi_i "" VALUE 0x0026C070 Scalar_FLOAT64_IEEE 0 ModelWithControllersOnly_CM_double -1.7E+308 1.7E+308 /end CHARACTERISTIC
/begin CHARACTERISTIC ModelWithControllersOn_cal_impl.LateralControllerStanley_Positi "" VALUE 0x0026C068 Scalar_FLOAT64_IEEE 0 ModelWithControllersOnly_CM_double -1.7E+308 1.7E+308 /end CHARACTERISTIC
/begin CHARACTERISTIC ModelWithControllersOn_cal_impl.LateralControllerStanley_YawRat "" VALUE 0x0026C0A8 Scalar_FLOAT64_IEEE 0 ModelWithControllersOnly_CM_double -1.7E+308 1.7E+308 /end CHARACTERISTIC
/begin CHARACTERISTIC ModelWithControllersOn_cal_impl.LongitudinalControllerStanley_K "" VALUE 0x0026C030 Scalar_FLOAT64_IEEE 0 ModelWithControllersOnly_CM_double -1.7E+308 1.7E+308 /end CHARACTERISTIC
/begin CHARACTERISTIC ModelWithControllersOn_cal_impl.LongitudinalControllerStanley_g "" VALUE 0x0026C038 Scalar_FLOAT64_IEEE 0 ModelWithControllersOnly_CM_double -1.7E+308 1.7E+308 /end CHARACTERISTIC
/begin CHARACTERISTIC ModelWithControllersOn_cal_impl.Merge_InitialOutput "" VALUE 0x0026C460 Scalar_FLOAT64_IEEE 0 ModelWithControllersOnly_CM_double -1.7E+308 1.7E+308 /end CHARACTERISTIC
/begin CHARACTERISTIC ModelWithControllersOn_cal_impl.PIForward_InitialConditionForIn "" VALUE 0x0026C018 Scalar_FLOAT64_IEEE 0 ModelWithControllersOnly_CM_double -1.7E+308 1.7E+308 /end CHARACTERISTIC
/begin CHARACTERISTIC ModelWithControllersOn_cal_impl.PIForward_LowerSaturationLimit "" VALUE 0x0026C040 Scalar_FLOAT64_IEEE 0 ModelWithControllersOnly_CM_double -1.7E+308 1.7E+308 /end CHARACTERISTIC
/begin CHARACTERISTIC ModelWithControllersOn_cal_impl.PIForward_UpperSaturationLimit "" VALUE 0x0026C098 Scalar_FLOAT64_IEEE 0 ModelWithControllersOnly_CM_double -1.7E+308 1.7E+308 /end CHARACTERISTIC
/begin CHARACTERISTIC ModelWithControllersOn_cal_impl.PIReverse_InitialConditionForIn "" VALUE 0x0026C020 Scalar_FLOAT64_IEEE 0 ModelWithControllersOnly_CM_double -1.7E+308 1.7E+308 /end CHARACTERISTIC
/begin CHARACTERISTIC ModelWithControllersOn_cal_impl.PIReverse_LowerSaturationLimit "" VALUE 0x0026C048 Scalar_FLOAT64_IEEE 0 ModelWithControllersOnly_CM_double -1.7E+308 1.7E+308 /end CHARACTERISTIC
/begin CHARACTERISTIC ModelWithControllersOn_cal_impl.PIReverse_UpperSaturationLimit "" VALUE 0x0026C0A0 Scalar_FLOAT64_IEEE 0 ModelWithControllersOnly_CM_double -1.7E+308 1.7E+308 /end CHARACTERISTIC
/begin CHARACTERISTIC ModelWithControllersOn_cal_impl.RateTransition1_InitialConditio "" VALUE 0x0026C2E0 Scalar_FLOAT64_IEEE 0 ModelWithControllersOnly_CM_double -1.7E+308 1.7E+308 /end CHARACTERISTIC
/begin CHARACTERISTIC ModelWithControllersOn_cal_impl.RateTransition2_InitialConditio "" VALUE 0x0026C2E8 Scalar_FLOAT64_IEEE 0 ModelWithControllersOnly_CM_double -1.7E+308 1.7E+308 /end CHARACTERISTIC
/begin CHARACTERISTIC ModelWithControllersOn_cal_impl.RateTransition_InitialCondition "" VALUE 0x0026C2D8 Scalar_FLOAT64_IEEE 0 ModelWithControllersOnly_CM_double -1.7E+308 1.7E+308 /end CHARACTERISTIC
/begin CHARACTERISTIC ModelWithControllersOn_cal_impl.Saturation_LowerSat "" VALUE 0x0026C160 Scalar_FLOAT64_IEEE 0 ModelWithControllersOnly_CM_double -1.7E+308 1.7E+308 /end CHARACTERISTIC
/begin CHARACTERISTIC ModelWithControllersOn_cal_impl.Saturation_LowerSat_f "" VALUE 0x0026C1B0 Scalar_FLOAT64_IEEE 0 ModelWithControllersOnly_CM_double -1.7E+308 1.7E+308 /end CHARACTERISTIC
/begin CHARACTERISTIC ModelWithControllersOn_cal_impl.Saturation_UpperSat_n "" VALUE 0x0026C1A8 Scalar_FLOAT64_IEEE 0 ModelWithControllersOnly_CM_double -1.7E+308 1.7E+308 /end CHARACTERISTIC
/begin CHARACTERISTIC ModelWithControllersOn_cal_impl.Switch1_Threshold "" VALUE 0x0026C270 Scalar_FLOAT64_IEEE 0 ModelWithControllersOnly_CM_double -1.7E+308 1.7E+308 /end CHARACTERISTIC
/begin CHARACTERISTIC ModelWithControllersOn_cal_impl.Switch1_Threshold_i "" VALUE 0x0026C478 Scalar_FLOAT64_IEEE 0 ModelWithControllersOnly_CM_double -1.7E+308 1.7E+308 /end CHARACTERISTIC
/begin CHARACTERISTIC ModelWithControllersOn_cal_impl.Switch_Threshold "" VALUE 0x0026C268 Scalar_FLOAT64_IEEE 0 ModelWithControllersOnly_CM_double -1.7E+308 1.7E+308 /end CHARACTERISTIC
/begin CHARACTERISTIC ModelWithControllersOn_cal_impl.Switch_Threshold_l "" VALUE 0x0026C470 Scalar_FLOAT64_IEEE 0 ModelWithControllersOnly_CM_double -1.7E+308 1.7E+308 /end CHARACTERISTIC
/begin CHARACTERISTIC ModelWithControllersOn_cal_impl.UnitDelay_InitialCondition "" VALUE 0x0026C198 Scalar_FLOAT64_IEEE 0 ModelWithControllersOnly_CM_double -1.7E+308 1.7E+308 /end CHARACTERISTIC
/begin CHARACTERISTIC ModelWithControllersOn_cal_impl.UnitDelay_InitialCondition_g "" VALUE 0x0026C1A0 Scalar_FLOAT64_IEEE 0 ModelWithControllersOnly_CM_double -1.7E+308 1.7E+308 /end CHARACTERISTIC
/begin CHARACTERISTIC ModelWithControllersOn_cal_impl.VehicleBody3DOFSingleTrack_Af "" VALUE 0x0026BFD0 Scalar_FLOAT64_IEEE 0 ModelWithControllersOnly_CM_double -1.7E+308 1.7E+308 /end CHARACTERISTIC
/begin CHARACTERISTIC ModelWithControllersOn_cal_impl.VehicleBody3DOFSingleTrack_Cd "" VALUE 0x0026BFD8 Scalar_FLOAT64_IEEE 0 ModelWithControllersOnly_CM_double -1.7E+308 1.7E+308 /end CHARACTERISTIC
/begin CHARACTERISTIC ModelWithControllersOn_cal_impl.VehicleBody3DOFSingleTrack_Cl "" VALUE 0x0026BFE0 Scalar_FLOAT64_IEEE 0 ModelWithControllersOnly_CM_double -1.7E+308 1.7E+308 /end CHARACTERISTIC
/begin CHARACTERISTIC ModelWithControllersOn_cal_impl.VehicleBody3DOFSingleTrack_Cpm "" VALUE 0x0026BFE8 Scalar_FLOAT64_IEEE 0 ModelWithControllersOnly_CM_double -1.7E+308 1.7E+308 /end CHARACTERISTIC
/begin CHARACTERISTIC ModelWithControllersOn_cal_impl.VehicleBody3DOFSingleTrack_Cs "" CURVE 0x0026BC20 FixLookup_FLOAT64_IEEE 0 ModelWithControllersOnly_CM_double -1.7E+308 1.7E+308
 /begin AXIS_DESCR FIX_AXIS ModelWithControllersOnly_B.TrigonometricFunction ModelWithControllersOnly_CM_double 31 0.000000 0.300000 FIX_AXIS_PAR_DIST 0 0.01 31 /end AXIS_DESCR
/end CHARACTERISTIC
/begin CHARACTERISTIC ModelWithControllersOn_cal_impl.VehicleBody3DOFSingleTrack_Cy_f "" VALUE 0x0026BFF0 Scalar_FLOAT64_IEEE 0 ModelWithControllersOnly_CM_double -1.7E+308 1.7E+308 /end CHARACTERISTIC
/begin CHARACTERISTIC ModelWithControllersOn_cal_impl.VehicleBody3DOFSingleTrack_Cy_r "" VALUE 0x0026BFF8 Scalar_FLOAT64_IEEE 0 ModelWithControllersOnly_CM_double -1.7E+308 1.7E+308 /end CHARACTERISTIC
/begin CHARACTERISTIC ModelWithControllersOn_cal_impl.VehicleBody3DOFSingleTrack_Cym "" CURVE 0x0026BD18 FixLookup_FLOAT64_IEEE 0 ModelWithControllersOnly_CM_double -1.7E+308 1.7E+308
 /begin AXIS_DESCR FIX_AXIS ModelWithControllersOnly_B.TrigonometricFunction ModelWithControllersOnly_CM_double 31 0.000000 0.300000 FIX_AXIS_PAR_DIST 0 0.01 31 /end AXIS_DESCR
/end CHARACTERISTIC
/begin CHARACTERISTIC ModelWithControllersOn_cal_impl.VehicleBody3DOFSingleTrack_Fzno "" VALUE 0x0026C008 Scalar_FLOAT64_IEEE 0 ModelWithControllersOnly_CM_double -1.7E+308 1.7E+308 /end CHARACTERISTIC
/begin CHARACTERISTIC ModelWithControllersOn_cal_impl.VehicleBody3DOFSingleTrack_Izz "" VALUE 0x0026C028 Scalar_FLOAT64_IEEE 0 ModelWithControllersOnly_CM_double -1.7E+308 1.7E+308 /end CHARACTERISTIC
/begin CHARACTERISTIC ModelWithControllersOn_cal_impl.VehicleBody3DOFSingleTrack_NF "" VALUE 0x0026C050 Scalar_FLOAT64_IEEE 0 ModelWithControllersOnly_CM_double -1.7E+308 1.7E+308 /end CHARACTERISTIC
/begin CHARACTERISTIC ModelWithControllersOn_cal_impl.VehicleBody3DOFSingleTrack_NR "" VALUE 0x0026C058 Scalar_FLOAT64_IEEE 0 ModelWithControllersOnly_CM_double -1.7E+308 1.7E+308 /end CHARACTERISTIC
/begin CHARACTERISTIC ModelWithControllersOn_cal_impl.VehicleBody3DOFSingleTrack_Pabs "" VALUE 0x0026C060 Scalar_FLOAT64_IEEE 0 ModelWithControllersOnly_CM_double -1.7E+308 1.7E+308 /end CHARACTERISTIC
/begin CHARACTERISTIC ModelWithControllersOn_cal_impl.VehicleBody3DOFSingleTrack_Tair "" VALUE 0x0026C090 Scalar_FLOAT64_IEEE 0 ModelWithControllersOnly_CM_double -1.7E+308 1.7E+308 /end CHARACTERISTIC
/begin CHARACTERISTIC ModelWithControllersOn_cal_impl.VehicleBody3DOFSingleTrack_g "" VALUE 0x0026C0B0 Scalar_FLOAT64_IEEE 0 ModelWithControllersOnly_CM_double -1.7E+308 1.7E+308 /end CHARACTERISTIC
/begin CHARACTERISTIC ModelWithControllersOn_cal_impl.VehicleBody3DOFSingleTrack_h "" VALUE 0x0026C0B8 Scalar_FLOAT64_IEEE 0 ModelWithControllersOnly_CM_double -1.7E+308 1.7E+308 /end CHARACTERISTIC
/begin CHARACTERISTIC ModelWithControllersOn_cal_impl.VehicleBody3DOFSingleTrack_r_o "" VALUE 0x0026C0D8 Scalar_FLOAT64_IEEE 0 ModelWithControllersOnly_CM_double -1.7E+308 1.7E+308 /end CHARACTERISTIC
/begin CHARACTERISTIC ModelWithControllersOn_cal_impl.VehicleBody3DOFSingleTrack_xdot "" VALUE 0x0026C0F8 Scalar_FLOAT64_IEEE 0 ModelWithControllersOnly_CM_double -1.7E+308 1.7E+308 /end CHARACTERISTIC
/begin CHARACTERISTIC ModelWithControllersOn_cal_impl.VehicleBody3DOFSingleTrack_ydot "" VALUE 0x0026C100 Scalar_FLOAT64_IEEE 0 ModelWithControllersOnly_CM_double -1.7E+308 1.7E+308 /end CHARACTERISTIC
/begin CHARACTERISTIC ModelWithControllersOn_cal_impl.VehicleDynamics_InitSpeed "" VALUE 0x0026C010 Scalar_FLOAT64_IEEE 0 ModelWithControllersOnly_CM_double -1.7E+308 1.7E+308 /end CHARACTERISTIC
/begin CHARACTERISTIC ModelWithControllersOn_cal_impl.ZeroGain_Gain "" VALUE 0x0026C128 Scalar_FLOAT64_IEEE 0 ModelWithControllersOnly_CM_double -1.7E+308 1.7E+308 /end CHARACTERISTIC
/begin CHARACTERISTIC ModelWithControllersOn_cal_impl.ZeroGain_Gain_i "" VALUE 0x0026C140 Scalar_FLOAT64_IEEE 0 ModelWithControllersOnly_CM_double -1.7E+308 1.7E+308 /end CHARACTERISTIC
/begin CHARACTERISTIC ModelWithControllersOn_cal_impl.u_Gain "" VAL_BLK 0x0026BF80 Scalar_FLOAT64_IEEE 0 ModelWithControllersOnly_CM_double -1.7E+308 1.7E+308 MATRIX_DIM 1 3 /end CHARACTERISTIC
/begin CHARACTERISTIC ModelWithControllersOn_cal_impl.vehiclemodel_Fxtire_sat "" VALUE 0x0026C148 Scalar_FLOAT64_IEEE 0 ModelWithControllersOnly_CM_double -1.7E+308 1.7E+308 /end CHARACTERISTIC
/begin CHARACTERISTIC ModelWithControllersOn_cal_impl.vehiclemodel_Fytire_sat "" VALUE 0x0026C150 Scalar_FLOAT64_IEEE 0 ModelWithControllersOnly_CM_double -1.7E+308 1.7E+308 /end CHARACTERISTIC
/begin CHARACTERISTIC ModelWithControllersOn_cal_impl.vehiclemodel_d "" VALUE 0x0026C158 Scalar_FLOAT64_IEEE 0 ModelWithControllersOnly_CM_double -1.7E+308 1.7E+308 /end CHARACTERISTIC
/begin CHARACTERISTIC ModelWithControllersOn_cal_impl.vehiclemodel_w "" VAL_BLK 0x0026BF38 Scalar_FLOAT64_IEEE 0 ModelWithControllersOnly_CM_double -1.7E+308 1.7E+308 MATRIX_DIM 2 1 /end CHARACTERISTIC
/begin CHARACTERISTIC ModelWithControllersOnly_P.FirstOrderHold1_ErrTol "" VALUE 0x0026E5D0 Scalar_FLOAT64_IEEE 0 ModelWithControllersOnly_CM_double -1.7E+308 1.7E+308 /end CHARACTERISTIC
/begin CHARACTERISTIC ModelWithControllersOnly_P.FirstOrderHold_ErrTol "" VALUE 0x0026E5C8 Scalar_FLOAT64_IEEE 0 ModelWithControllersOnly_CM_double -1.7E+308 1.7E+308 /end CHARACTERISTIC
/begin CHARACTERISTIC ModelWithControllersOnly_P.Saturation_UpperSat "" VALUE 0x0026E5C0 Scalar_FLOAT64_IEEE 0 ModelWithControllersOnly_CM_double -1.7E+308 1.7E+308 /end CHARACTERISTIC
/begin MEASUREMENT ModelWithControllersOnly_B.AND1 "" UBYTE ModelWithControllersOnly_CM_logical 0 0 0 1 ECU_ADDRESS 0x0026E5AF /end MEASUREMENT
/begin MEASUREMENT ModelWithControllersOnly_B.AND2 "" UBYTE ModelWithControllersOnly_CM_logical 0 0 0 1 ECU_ADDRESS 0x0026E5B4 /end MEASUREMENT
/begin MEASUREMENT ModelWithControllersOnly_B.AND3 "" UBYTE ModelWithControllersOnly_CM_logical 0 0 0 1 ECU_ADDRESS 0x0026E5AC /end MEASUREMENT
/begin MEASUREMENT ModelWithControllersOnly_B.AND3_h "" UBYTE ModelWithControllersOnly_CM_logical 0 0 0 1 ECU_ADDRESS 0x0026E5B9 /end MEASUREMENT
/begin MEASUREMENT ModelWithControllersOnly_B.AND3_k "" UBYTE ModelWithControllersOnly_CM_logical 0 0 0 1 ECU_ADDRESS 0x0026E5BC /end MEASUREMENT
/begin MEASUREMENT ModelWithControllersOnly_B.Abs_k "" FLOAT64_IEEE ModelWithControllersOnly_CM_double 0 0 -1.7E+308 1.7E+308 ECU_ADDRESS 0x0026E590 /end MEASUREMENT
/begin MEASUREMENT ModelWithControllersOnly_B.Add "" FLOAT64_IEEE ModelWithControllersOnly_CM_double 0 0 -1.7E+308 1.7E+308 ECU_ADDRESS 0x0026D1B8 /end MEASUREMENT
/begin MEASUREMENT ModelWithControllersOnly_B.Add1 "" FLOAT64_IEEE ModelWithControllersOnly_CM_double 0 0 -1.7E+308 1.7E+308 LAYOUT COLUMN_DIR MATRIX_DIM 3 ECU_ADDRESS 0x0026D388 /end MEASUREMENT
/begin MEASUREMENT ModelWithControllersOnly_B.Add1_d "" FLOAT64_IEEE ModelWithControllersOnly_CM_double 0 0 -1.7E+308 1.7E+308 LAYOUT COLUMN_DIR MATRIX_DIM 3 ECU_ADDRESS 0x0026D528 /end MEASUREMENT
/begin MEASUREMENT ModelWithControllersOnly_B.Add2 "" FLOAT64_IEEE ModelWithControllersOnly_CM_double 0 0 -1.7E+308 1.7E+308 LAYOUT COLUMN_DIR MATRIX_DIM 3 ECU_ADDRESS 0x0026D4E0 /end MEASUREMENT
/begin MEASUREMENT ModelWithControllersOnly_B.Add_d "" FLOAT64_IEEE ModelWithControllersOnly_CM_double 0 0 -1.7E+308 1.7E+308 LAYOUT COLUMN_DIR MATRIX_DIM 3 ECU_ADDRESS 0x0026D4C8 /end MEASUREMENT
/begin MEASUREMENT ModelWithControllersOnly_B.AngularVelocity "" FLOAT64_IEEE ModelWithControllersOnly_CM_double 0 0 -1.7E+308 1.7E+308 LAYOUT COLUMN_DIR MATRIX_DIM 3 1 ECU_ADDRESS 0x0026E4E8 /end MEASUREMENT
/begin MEASUREMENT ModelWithControllersOnly_B.BrakeSaturation "" FLOAT64_IEEE ModelWithControllersOnly_CM_double 0 0 -1.7E+308 1.7E+308 ECU_ADDRESS 0x0026D210 /end MEASUREMENT
/begin MEASUREMENT ModelWithControllersOnly_B.BusCreator.Acceleration "" FLOAT64_IEEE ModelWithControllersOnly_CM_double 0 0 -1.7E+308 1.7E+308 LAYOUT COLUMN_DIR MATRIX_DIM 3 1 ECU_ADDRESS 0x0026D078 /end MEASUREMENT
/begin MEASUREMENT ModelWithControllersOnly_B.BusCreator.ActorID "" FLOAT64_IEEE ModelWithControllersOnly_CM_double 0 0 -1.7E+308 1.7E+308 ECU_ADDRESS 0x0026D040 /end MEASUREMENT
/begin MEASUREMENT ModelWithControllersOnly_B.BusCreator.AngularVelocity "" FLOAT64_IEEE ModelWithControllersOnly_CM_double 0 0 -1.7E+308 1.7E+308 LAYOUT COLUMN_DIR MATRIX_DIM 3 1 ECU_ADDRESS 0x0026D0A8 /end MEASUREMENT
/begin MEASUREMENT ModelWithControllersOnly_B.BusCreator.Pitch "" FLOAT64_IEEE ModelWithControllersOnly_CM_double 0 0 -1.7E+308 1.7E+308 ECU_ADDRESS 0x0026D098 /end MEASUREMENT
/begin MEASUREMENT ModelWithControllersOnly_B.BusCreator.Position "" FLOAT64_IEEE ModelWithControllersOnly_CM_double 0 0 -1.7E+308 1.7E+308 LAYOUT COLUMN_DIR MATRIX_DIM 3 1 ECU_ADDRESS 0x0026D048 /end MEASUREMENT
/begin MEASUREMENT ModelWithControllersOnly_B.BusCreator.Roll "" FLOAT64_IEEE ModelWithControllersOnly_CM_double 0 0 -1.7E+308 1.7E+308 ECU_ADDRESS 0x0026D090 /end MEASUREMENT
/begin MEASUREMENT ModelWithControllersOnly_B.BusCreator.Velocity "" FLOAT64_IEEE ModelWithControllersOnly_CM_double 0 0 -1.7E+308 1.7E+308 LAYOUT COLUMN_DIR MATRIX_DIM 3 1 ECU_ADDRESS 0x0026D060 /end MEASUREMENT
/begin MEASUREMENT ModelWithControllersOnly_B.BusCreator.Yaw "" FLOAT64_IEEE ModelWithControllersOnly_CM_double 0 0 -1.7E+308 1.7E+308 ECU_ADDRESS 0x0026D0A0 /end MEASUREMENT
/begin MEASUREMENT ModelWithControllersOnly_B.CurvedSteadyYaw "" FLOAT64_IEEE ModelWithControllersOnly_CM_double 0 0 -1.7E+308 1.7E+308 ECU_ADDRESS 0x0026D178 /end MEASUREMENT
/begin MEASUREMENT ModelWithControllersOnly_B.DataTypeConv1 "" SBYTE ModelWithControllersOnly_CM_int8 0 0 -128 127 ECU_ADDRESS 0x0026E5A0 /end MEASUREMENT
/begin MEASUREMENT ModelWithControllersOnly_B.DataTypeConv1_j "" SBYTE ModelWithControllersOnly_CM_int8 0 0 -128 127 ECU_ADDRESS 0x0026E5A2 /end MEASUREMENT
/begin MEASUREMENT ModelWithControllersOnly_B.DataTypeConv2 "" SBYTE ModelWithControllersOnly_CM_int8 0 0 -128 127 ECU_ADDRESS 0x0026E5A1 /end MEASUREMENT
/begin MEASUREMENT ModelWithControllersOnly_B.DataTypeConv2_g "" SBYTE ModelWithControllersOnly_CM_int8 0 0 -128 127 ECU_ADDRESS 0x0026E5A3 /end MEASUREMENT
/begin MEASUREMENT ModelWithControllersOnly_B.DataTypeConversion "" UBYTE ModelWithControllersOnly_CM_logical 0 0 0 1 ECU_ADDRESS 0x0026E5B6 /end MEASUREMENT
/begin MEASUREMENT ModelWithControllersOnly_B.DeadZone_f "" FLOAT64_IEEE ModelWithControllersOnly_CM_double 0 0 -1.7E+308 1.7E+308 ECU_ADDRESS 0x0026E520 /end MEASUREMENT
/begin MEASUREMENT ModelWithControllersOnly_B.DeadZone_o "" FLOAT64_IEEE ModelWithControllersOnly_CM_double 0 0 -1.7E+308 1.7E+308 ECU_ADDRESS 0x0026E568 /end MEASUREMENT
/begin MEASUREMENT ModelWithControllersOnly_B.Derivative "" FLOAT64_IEEE ModelWithControllersOnly_CM_double 0 0 -1.7E+308 1.7E+308 ECU_ADDRESS 0x0026D290 /end MEASUREMENT
/begin MEASUREMENT ModelWithControllersOnly_B.Derivative1 "" FLOAT64_IEEE ModelWithControllersOnly_CM_double 0 0 -1.7E+308 1.7E+308 ECU_ADDRESS 0x0026D2A0 /end MEASUREMENT
/begin MEASUREMENT ModelWithControllersOnly_B.Derivative2 "" FLOAT64_IEEE ModelWithControllersOnly_CM_double 0 0 -1.7E+308 1.7E+308 ECU_ADDRESS 0x0026D2B0 /end MEASUREMENT
/begin MEASUREMENT ModelWithControllersOnly_B.Derivative3 "" FLOAT64_IEEE ModelWithControllersOnly_CM_double 0 0 -1.7E+308 1.7E+308 ECU_ADDRESS 0x0026D2B8 /end MEASUREMENT
/begin MEASUREMENT ModelWithControllersOnly_B.Derivative4 "" FLOAT64_IEEE ModelWithControllersOnly_CM_double 0 0 -1.7E+308 1.7E+308 ECU_ADDRESS 0x0026D2C8 /end MEASUREMENT
/begin MEASUREMENT ModelWithControllersOnly_B.Derivative5 "" FLOAT64_IEEE ModelWithControllersOnly_CM_double 0 0 -1.7E+308 1.7E+308 ECU_ADDRESS 0x0026D2D8 /end MEASUREMENT
/begin MEASUREMENT ModelWithControllersOnly_B.EgoVehLongAcc "" FLOAT64_IEEE ModelWithControllersOnly_CM_double 0 0 -1.7E+308 1.7E+308 ECU_ADDRESS 0x0026D2F0 /end MEASUREMENT
/begin MEASUREMENT ModelWithControllersOnly_B.Equal1 "" UBYTE ModelWithControllersOnly_CM_logical 0 0 0 1 ECU_ADDRESS 0x0026E5AD /end MEASUREMENT
/begin MEASUREMENT ModelWithControllersOnly_B.Equal1_e "" UBYTE ModelWithControllersOnly_CM_logical 0 0 0 1 ECU_ADDRESS 0x0026E5B8 /end MEASUREMENT
/begin MEASUREMENT ModelWithControllersOnly_B.Equal1_j "" UBYTE ModelWithControllersOnly_CM_logical 0 0 0 1 ECU_ADDRESS 0x0026E5BB /end MEASUREMENT
/begin MEASUREMENT ModelWithControllersOnly_B.Equal2 "" UBYTE ModelWithControllersOnly_CM_logical 0 0 0 1 ECU_ADDRESS 0x0026E5AA /end MEASUREMENT
/begin MEASUREMENT ModelWithControllersOnly_B.Equal3 "" UBYTE ModelWithControllersOnly_CM_logical 0 0 0 1 ECU_ADDRESS 0x0026E5AE /end MEASUREMENT
/begin MEASUREMENT ModelWithControllersOnly_B.Equal4 "" UBYTE ModelWithControllersOnly_CM_logical 0 0 0 1 ECU_ADDRESS 0x0026E5B3 /end MEASUREMENT
/begin MEASUREMENT ModelWithControllersOnly_B.Equal5 "" UBYTE ModelWithControllersOnly_CM_logical 0 0 0 1 ECU_ADDRESS 0x0026E5B2 /end MEASUREMENT
/begin MEASUREMENT ModelWithControllersOnly_B.Equal6 "" UBYTE ModelWithControllersOnly_CM_logical 0 0 0 1 ECU_ADDRESS 0x0026E5AB /end MEASUREMENT
/begin MEASUREMENT ModelWithControllersOnly_B.FBody "" FLOAT64_IEEE ModelWithControllersOnly_CM_double_N 0 0 -1.7E+308 1.7E+308 LAYOUT COLUMN_DIR MATRIX_DIM 3 ECU_ADDRESS 0x0026E3C8 /end MEASUREMENT
/begin MEASUREMENT ModelWithControllersOnly_B.FOut "" FLOAT64_IEEE ModelWithControllersOnly_CM_double_N 0 0 -1.7E+308 1.7E+308 LAYOUT COLUMN_DIR MATRIX_DIM 6 ECU_ADDRESS 0x0026E3F8 /end MEASUREMENT
/begin MEASUREMENT ModelWithControllersOnly_B.FTire "" FLOAT64_IEEE ModelWithControllersOnly_CM_double_N 0 0 -1.7E+308 1.7E+308 LAYOUT COLUMN_DIR MATRIX_DIM 6 ECU_ADDRESS 0x0026E428 /end MEASUREMENT
/begin MEASUREMENT ModelWithControllersOnly_B.F_aero "" FLOAT64_IEEE ModelWithControllersOnly_CM_double 0 0 -1.7E+308 1.7E+308 ECU_ADDRESS 0x0026D1E8 /end MEASUREMENT
/begin MEASUREMENT ModelWithControllersOnly_B.F_aero_i "" FLOAT64_IEEE ModelWithControllersOnly_CM_double 0 0 -1.7E+308 1.7E+308 ECU_ADDRESS 0x0026D230 /end MEASUREMENT
/begin MEASUREMENT ModelWithControllersOnly_B.Fg "" FLOAT64_IEEE ModelWithControllersOnly_CM_double_N 0 0 -1.7E+308 1.7E+308 LAYOUT COLUMN_DIR MATRIX_DIM 3 ECU_ADDRESS 0x0026E458 /end MEASUREMENT
/begin MEASUREMENT ModelWithControllersOnly_B.FirstOrderHold "" FLOAT64_IEEE ModelWithControllersOnly_CM_double_rad 0 0 -1.7E+308 1.7E+308 ECU_ADDRESS 0x0026D2F8 /end MEASUREMENT
/begin MEASUREMENT ModelWithControllersOnly_B.Gain "" FLOAT64_IEEE ModelWithControllersOnly_CM_double 0 0 -1.7E+308 1.7E+308 ECU_ADDRESS 0x0026D168 /end MEASUREMENT
/begin MEASUREMENT ModelWithControllersOnly_B.Gain1 "" FLOAT64_IEEE ModelWithControllersOnly_CM_double 0 0 -1.7E+308 1.7E+308 ECU_ADDRESS 0x0026D128 /end MEASUREMENT
/begin MEASUREMENT ModelWithControllersOnly_B.Gain1_g "" FLOAT64_IEEE ModelWithControllersOnly_CM_double 0 0 -1.7E+308 1.7E+308 ECU_ADDRESS 0x0026D180 /end MEASUREMENT
/begin MEASUREMENT ModelWithControllersOnly_B.Gain2 "" FLOAT64_IEEE ModelWithControllersOnly_CM_double 0 0 -1.7E+308 1.7E+308 ECU_ADDRESS 0x0026D1F0 /end MEASUREMENT
/begin MEASUREMENT ModelWithControllersOnly_B.Gain2_d "" FLOAT64_IEEE ModelWithControllersOnly_CM_double 0 0 -1.7E+308 1.7E+308 ECU_ADDRESS 0x0026D238 /end MEASUREMENT
/begin MEASUREMENT ModelWithControllersOnly_B.Gain2_o "" FLOAT64_IEEE ModelWithControllersOnly_CM_double_rad 0 0 -1.7E+308 1.7E+308 ECU_ADDRESS 0x0026E220 /end MEASUREMENT
/begin MEASUREMENT ModelWithControllersOnly_B.Gain3 "" FLOAT64_IEEE ModelWithControllersOnly_CM_double 0 0 -1.7E+308 1.7E+308 ECU_ADDRESS 0x0026D2E0 /end MEASUREMENT
/begin MEASUREMENT ModelWithControllersOnly_B.Gain4 "" FLOAT64_IEEE ModelWithControllersOnly_CM_double 0 0 -1.7E+308 1.7E+308 ECU_ADDRESS 0x0026D2E8 /end MEASUREMENT
/begin MEASUREMENT ModelWithControllersOnly_B.Gain5 "" FLOAT64_IEEE ModelWithControllersOnly_CM_double 0 0 -1.7E+308 1.7E+308 ECU_ADDRESS 0x0026D298 /end MEASUREMENT
/begin MEASUREMENT ModelWithControllersOnly_B.Gain6 "" FLOAT64_IEEE ModelWithControllersOnly_CM_double 0 0 -1.7E+308 1.7E+308 ECU_ADDRESS 0x0026D2A8 /end MEASUREMENT
/begin MEASUREMENT ModelWithControllersOnly_B.Gain_g "" FLOAT64_IEEE ModelWithControllersOnly_CM_double 0 0 -1.7E+308 1.7E+308 ECU_ADDRESS 0x0026E308 /end MEASUREMENT
/begin MEASUREMENT ModelWithControllersOnly_B.Gain_n "" FLOAT64_IEEE ModelWithControllersOnly_CM_double 0 0 -1.7E+308 1.7E+308 ECU_ADDRESS 0x0026D1C8 /end MEASUREMENT
/begin MEASUREMENT ModelWithControllersOnly_B.Gain_ne "" FLOAT64_IEEE ModelWithControllersOnly_CM_double 0 0 -1.7E+308 1.7E+308 ECU_ADDRESS 0x0026E310 /end MEASUREMENT
/begin MEASUREMENT ModelWithControllersOnly_B.IntegralGain "" FLOAT64_IEEE ModelWithControllersOnly_CM_double 0 0 -1.7E+308 1.7E+308 ECU_ADDRESS 0x0026E530 /end MEASUREMENT
/begin MEASUREMENT ModelWithControllersOnly_B.IntegralGain_e "" FLOAT64_IEEE ModelWithControllersOnly_CM_double 0 0 -1.7E+308 1.7E+308 ECU_ADDRESS 0x0026E578 /end MEASUREMENT
/begin MEASUREMENT ModelWithControllersOnly_B.Integrator "" FLOAT64_IEEE ModelWithControllersOnly_CM_double 0 0 -1.7E+308 1.7E+308 LAYOUT COLUMN_DIR MATRIX_DIM 4 ECU_ADDRESS 0x0026D0E0 /end MEASUREMENT
/begin MEASUREMENT ModelWithControllersOnly_B.Integrator_c "" FLOAT64_IEEE ModelWithControllersOnly_CM_double 0 0 -1.7E+308 1.7E+308 ECU_ADDRESS 0x0026E550 /end MEASUREMENT
/begin MEASUREMENT ModelWithControllersOnly_B.Integrator_f "" FLOAT64_IEEE ModelWithControllersOnly_CM_double 0 0 -1.7E+308 1.7E+308 ECU_ADDRESS 0x0026E508 /end MEASUREMENT
/begin MEASUREMENT ModelWithControllersOnly_B.Integrator_m "" FLOAT64_IEEE ModelWithControllersOnly_CM_double_m 0 0 -1.7E+308 1.7E+308 LAYOUT COLUMN_DIR MATRIX_DIM 2 ECU_ADDRESS 0x0026D118 /end MEASUREMENT
/begin MEASUREMENT ModelWithControllersOnly_B.MBody "" FLOAT64_IEEE ModelWithControllersOnly_CM_double_N_into_m 0 0 -1.7E+308 1.7E+308 LAYOUT COLUMN_DIR MATRIX_DIM 3 ECU_ADDRESS 0x0026E3E0 /end MEASUREMENT
/begin MEASUREMENT ModelWithControllersOnly_B.Merge "" FLOAT64_IEEE ModelWithControllersOnly_CM_double 0 0 -1.7E+308 1.7E+308 ECU_ADDRESS 0x0026E2E8 /end MEASUREMENT
/begin MEASUREMENT ModelWithControllersOnly_B.Minus "" FLOAT64_IEEE ModelWithControllersOnly_CM_double 0 0 -1.7E+308 1.7E+308 ECU_ADDRESS 0x0026D188 /end MEASUREMENT
/begin MEASUREMENT ModelWithControllersOnly_B.Minus1 "" FLOAT64_IEEE ModelWithControllersOnly_CM_double 0 0 -1.7E+308 1.7E+308 ECU_ADDRESS 0x0026D1A8 /end MEASUREMENT
/begin MEASUREMENT ModelWithControllersOnly_B.Multiply "" FLOAT64_IEEE ModelWithControllersOnly_CM_double 0 0 -1.7E+308 1.7E+308 ECU_ADDRESS 0x0026D170 /end MEASUREMENT
/begin MEASUREMENT ModelWithControllersOnly_B.Multiply_n "" FLOAT64_IEEE ModelWithControllersOnly_CM_double 0 0 -1.7E+308 1.7E+308 ECU_ADDRESS 0x0026E2F0 /end MEASUREMENT
/begin MEASUREMENT ModelWithControllersOnly_B.NOT "" UBYTE ModelWithControllersOnly_CM_logical 0 0 0 1 ECU_ADDRESS 0x0026E5B5 /end MEASUREMENT
/begin MEASUREMENT ModelWithControllersOnly_B.NOT1 "" UBYTE ModelWithControllersOnly_CM_logical 0 0 0 1 ECU_ADDRESS 0x0026E5B1 /end MEASUREMENT
/begin MEASUREMENT ModelWithControllersOnly_B.NotEqual "" UBYTE ModelWithControllersOnly_CM_logical 0 0 0 1 ECU_ADDRESS 0x0026E5B7 /end MEASUREMENT
/begin MEASUREMENT ModelWithControllersOnly_B.NotEqual_m "" UBYTE ModelWithControllersOnly_CM_logical 0 0 0 1 ECU_ADDRESS 0x0026E5BA /end MEASUREMENT
/begin MEASUREMENT ModelWithControllersOnly_B.OR "" UBYTE ModelWithControllersOnly_CM_logical 0 0 0 1 ECU_ADDRESS 0x0026E5B0 /end MEASUREMENT
/begin MEASUREMENT ModelWithControllersOnly_B.Pitch "" FLOAT64_IEEE ModelWithControllersOnly_CM_double 0 0 -1.7E+308 1.7E+308 ECU_ADDRESS 0x0026D2C0 /end MEASUREMENT
/begin MEASUREMENT ModelWithControllersOnly_B.Product "" FLOAT64_IEEE ModelWithControllersOnly_CM_double 0 0 -1.7E+308 1.7E+308 ECU_ADDRESS 0x0026D160 /end MEASUREMENT
/begin MEASUREMENT ModelWithControllersOnly_B.Product1 "" FLOAT64_IEEE ModelWithControllersOnly_CM_double 0 0 -1.7E+308 1.7E+308 ECU_ADDRESS 0x0026D358 /end MEASUREMENT
/begin MEASUREMENT ModelWithControllersOnly_B.Product1_a "" FLOAT64_IEEE ModelWithControllersOnly_CM_double 0 0 -1.7E+308 1.7E+308 LAYOUT COLUMN_DIR MATRIX_DIM 6 ECU_ADDRESS 0x0026D438 /end MEASUREMENT
/begin MEASUREMENT ModelWithControllersOnly_B.Product2 "" FLOAT64_IEEE ModelWithControllersOnly_CM_double 0 0 -1.7E+308 1.7E+308 ECU_ADDRESS 0x0026D368 /end MEASUREMENT
/begin MEASUREMENT ModelWithControllersOnly_B.Product2_h "" FLOAT64_IEEE ModelWithControllersOnly_CM_double 0 0 -1.7E+308 1.7E+308 ECU_ADDRESS 0x0026D3C8 /end MEASUREMENT
/begin MEASUREMENT ModelWithControllersOnly_B.Product3 "" FLOAT64_IEEE ModelWithControllersOnly_CM_double 0 0 -1.7E+308 1.7E+308 ECU_ADDRESS 0x0026D350 /end MEASUREMENT
/begin MEASUREMENT ModelWithControllersOnly_B.Product3_o "" FLOAT64_IEEE ModelWithControllersOnly_CM_double 0 0 -1.7E+308 1.7E+308 LAYOUT COLUMN_DIR MATRIX_DIM 3 ECU_ADDRESS 0x0026D4F8 /end MEASUREMENT
/begin MEASUREMENT ModelWithControllersOnly_B.Product4 "" FLOAT64_IEEE ModelWithControllersOnly_CM_double 0 0 -1.7E+308 1.7E+308 LAYOUT COLUMN_DIR MATRIX_DIM 3 ECU_ADDRESS 0x0026D498 /end MEASUREMENT
/begin MEASUREMENT ModelWithControllersOnly_B.Product_i "" FLOAT64_IEEE ModelWithControllersOnly_CM_double 0 0 -1.7E+308 1.7E+308 LAYOUT COLUMN_DIR MATRIX_DIM 3 ECU_ADDRESS 0x0026D3A0 /end MEASUREMENT
/begin MEASUREMENT ModelWithControllersOnly_B.Product_k "" FLOAT64_IEEE ModelWithControllersOnly_CM_double 0 0 -1.7E+308 1.7E+308 ECU_ADDRESS 0x0026D360 /end MEASUREMENT
/begin MEASUREMENT ModelWithControllersOnly_B.ProportionalGain "" FLOAT64_IEEE ModelWithControllersOnly_CM_double 0 0 -1.7E+308 1.7E+308 ECU_ADDRESS 0x0026E500 /end MEASUREMENT
/begin MEASUREMENT ModelWithControllersOnly_B.ProportionalGain_o "" FLOAT64_IEEE ModelWithControllersOnly_CM_double 0 0 -1.7E+308 1.7E+308 ECU_ADDRESS 0x0026E548 /end MEASUREMENT
/begin MEASUREMENT ModelWithControllersOnly_B.Roll "" FLOAT64_IEEE ModelWithControllersOnly_CM_double 0 0 -1.7E+308 1.7E+308 ECU_ADDRESS 0x0026D288 /end MEASUREMENT
/begin MEASUREMENT ModelWithControllersOnly_B.Saturation "" FLOAT64_IEEE ModelWithControllersOnly_CM_double 0 0 -1.7E+308 1.7E+308 ECU_ADDRESS 0x0026D100 /end MEASUREMENT
/begin MEASUREMENT ModelWithControllersOnly_B.Saturation_k "" FLOAT64_IEEE ModelWithControllersOnly_CM_double 0 0 -1.7E+308 1.7E+308 ECU_ADDRESS 0x0026D1C0 /end MEASUREMENT
/begin MEASUREMENT ModelWithControllersOnly_B.Sign1 "" FLOAT64_IEEE ModelWithControllersOnly_CM_double 0 0 -1.7E+308 1.7E+308 ECU_ADDRESS 0x0026E2A8 /end MEASUREMENT
/begin MEASUREMENT ModelWithControllersOnly_B.Sign2 "" FLOAT64_IEEE ModelWithControllersOnly_CM_double 0 0 -1.7E+308 1.7E+308 ECU_ADDRESS 0x0026E290 /end MEASUREMENT
/begin MEASUREMENT ModelWithControllersOnly_B.SignPreIntegrator "" FLOAT64_IEEE ModelWithControllersOnly_CM_double 0 0 -1.7E+308 1.7E+308 ECU_ADDRESS 0x0026E538 /end MEASUREMENT
/begin MEASUREMENT ModelWithControllersOnly_B.SignPreIntegrator_k "" FLOAT64_IEEE ModelWithControllersOnly_CM_double 0 0 -1.7E+308 1.7E+308 ECU_ADDRESS 0x0026E580 /end MEASUREMENT
/begin MEASUREMENT ModelWithControllersOnly_B.SignPreSat "" FLOAT64_IEEE ModelWithControllersOnly_CM_double 0 0 -1.7E+308 1.7E+308 ECU_ADDRESS 0x0026E528 /end MEASUREMENT
/begin MEASUREMENT ModelWithControllersOnly_B.SignPreSat_n "" FLOAT64_IEEE ModelWithControllersOnly_CM_double 0 0 -1.7E+308 1.7E+308 ECU_ADDRESS 0x0026E570 /end MEASUREMENT
/begin MEASUREMENT ModelWithControllersOnly_B.Sqrt "" FLOAT64_IEEE ModelWithControllersOnly_CM_double 0 0 -1.7E+308 1.7E+308 ECU_ADDRESS 0x0026D3C0 /end MEASUREMENT
/begin MEASUREMENT ModelWithControllersOnly_B.Square "" FLOAT64_IEEE ModelWithControllersOnly_CM_double 0 0 -1.7E+308 1.7E+308 ECU_ADDRESS 0x0026D1E0 /end MEASUREMENT
/begin MEASUREMENT ModelWithControllersOnly_B.Square_g "" FLOAT64_IEEE ModelWithControllersOnly_CM_double 0 0 -1.7E+308 1.7E+308 ECU_ADDRESS 0x0026D228 /end MEASUREMENT
/begin MEASUREMENT ModelWithControllersOnly_B.SteeringDelay "" FLOAT64_IEEE ModelWithControllersOnly_CM_double 0 0 -1.7E+308 1.7E+308 ECU_ADDRESS 0x0026D1B0 /end MEASUREMENT
/begin MEASUREMENT ModelWithControllersOnly_B.Sum "" FLOAT64_IEEE ModelWithControllersOnly_CM_double 0 0 -1.7E+308 1.7E+308 ECU_ADDRESS 0x0026D200 /end MEASUREMENT
/begin MEASUREMENT ModelWithControllersOnly_B.Sum_gu "" FLOAT64_IEEE ModelWithControllersOnly_CM_double 0 0 -1.7E+308 1.7E+308 ECU_ADDRESS 0x0026E558 /end MEASUREMENT
/begin MEASUREMENT ModelWithControllersOnly_B.Sum_mr "" FLOAT64_IEEE ModelWithControllersOnly_CM_double 0 0 -1.7E+308 1.7E+308 ECU_ADDRESS 0x0026E510 /end MEASUREMENT
/begin MEASUREMENT ModelWithControllersOnly_B.Sum_n "" FLOAT64_IEEE ModelWithControllersOnly_CM_double 0 0 -1.7E+308 1.7E+308 ECU_ADDRESS 0x0026D248 /end MEASUREMENT
/begin MEASUREMENT ModelWithControllersOnly_B.SumofElements "" FLOAT64_IEEE ModelWithControllersOnly_CM_double 0 0 -1.7E+308 1.7E+308 ECU_ADDRESS 0x0026D3B8 /end MEASUREMENT
/begin MEASUREMENT ModelWithControllersOnly_B.Switch "" FLOAT64_IEEE ModelWithControllersOnly_CM_double 0 0 -1.7E+308 1.7E+308 ECU_ADDRESS 0x0026D270 /end MEASUREMENT
/begin MEASUREMENT ModelWithControllersOnly_B.Switch1 "" FLOAT64_IEEE ModelWithControllersOnly_CM_double 0 0 -1.7E+308 1.7E+308 ECU_ADDRESS 0x0026D278 /end MEASUREMENT
/begin MEASUREMENT ModelWithControllersOnly_B.Switch1_l "" FLOAT64_IEEE ModelWithControllersOnly_CM_double 0 0 -1.7E+308 1.7E+308 ECU_ADDRESS 0x0026E300 /end MEASUREMENT
/begin MEASUREMENT ModelWithControllersOnly_B.Switch_a "" FLOAT64_IEEE ModelWithControllersOnly_CM_double 0 0 -1.7E+308 1.7E+308 ECU_ADDRESS 0x0026E588 /end MEASUREMENT
/begin MEASUREMENT ModelWithControllersOnly_B.Switch_l "" FLOAT64_IEEE ModelWithControllersOnly_CM_double 0 0 -1.7E+308 1.7E+308 ECU_ADDRESS 0x0026E2F8 /end MEASUREMENT
/begin MEASUREMENT ModelWithControllersOnly_B.Switch_m "" FLOAT64_IEEE ModelWithControllersOnly_CM_double 0 0 -1.7E+308 1.7E+308 ECU_ADDRESS 0x0026E540 /end MEASUREMENT
/begin MEASUREMENT ModelWithControllersOnly_B.T_eng "" FLOAT64_IEEE ModelWithControllersOnly_CM_double 0 0 -1.7E+308 1.7E+308 ECU_ADDRESS 0x0026D208 /end MEASUREMENT
/begin MEASUREMENT ModelWithControllersOnly_B.T_eng_c "" FLOAT64_IEEE ModelWithControllersOnly_CM_double 0 0 -1.7E+308 1.7E+308 ECU_ADDRESS 0x0026D250 /end MEASUREMENT
/begin MEASUREMENT ModelWithControllersOnly_B.Tanh "" FLOAT64_IEEE ModelWithControllersOnly_CM_double 0 0 -1.7E+308 1.7E+308 LAYOUT COLUMN_DIR MATRIX_DIM 3 ECU_ADDRESS 0x0026D3F0 /end MEASUREMENT
/begin MEASUREMENT ModelWithControllersOnly_B.ThrottleSaturation "" FLOAT64_IEEE ModelWithControllersOnly_CM_double 0 0 -1.7E+308 1.7E+308 ECU_ADDRESS 0x0026D268 /end MEASUREMENT
/begin MEASUREMENT ModelWithControllersOnly_B.TmpRTBAtEqual1Inport1 "" FLOAT64_IEEE ModelWithControllersOnly_CM_double 0 0 -1.7E+308 1.7E+308 ECU_ADDRESS 0x0026E298 /end MEASUREMENT
/begin MEASUREMENT ModelWithControllersOnly_B.TmpRTBAtEqual2Inport1 "" FLOAT64_IEEE ModelWithControllersOnly_CM_double 0 0 -1.7E+308 1.7E+308 ECU_ADDRESS 0x0026E288 /end MEASUREMENT
/begin MEASUREMENT ModelWithControllersOnly_B.TmpRTBAtEqual4Inport2 "" FLOAT64_IEEE ModelWithControllersOnly_CM_double 0 0 -1.7E+308 1.7E+308 ECU_ADDRESS 0x0026E2C0 /end MEASUREMENT
/begin MEASUREMENT ModelWithControllersOnly_B.TmpRTBAtEqual5Inport2 "" FLOAT64_IEEE ModelWithControllersOnly_CM_double 0 0 -1.7E+308 1.7E+308 ECU_ADDRESS 0x0026E2B8 /end MEASUREMENT
/begin MEASUREMENT ModelWithControllersOnly_B.TmpRTBAtIntegratorInport1 "" FLOAT64_IEEE ModelWithControllersOnly_CM_double 0 0 -1.7E+308 1.7E+308 ECU_ADDRESS 0x0026D258 /end MEASUREMENT
/begin MEASUREMENT ModelWithControllersOnly_B.TmpRTBAtIntegratorInport1_c "" FLOAT64_IEEE ModelWithControllersOnly_CM_double 0 0 -1.7E+308 1.7E+308 ECU_ADDRESS 0x0026D260 /end MEASUREMENT
/begin MEASUREMENT ModelWithControllersOnly_B.TmpRTBAtIntegratorInport2 "" FLOAT64_IEEE ModelWithControllersOnly_CM_double 0 0 -1.7E+308 1.7E+308 ECU_ADDRESS 0x0026D1D0 /end MEASUREMENT
/begin MEASUREMENT ModelWithControllersOnly_B.TmpRTBAtIntegratorInport2_e "" FLOAT64_IEEE ModelWithControllersOnly_CM_double 0 0 -1.7E+308 1.7E+308 ECU_ADDRESS 0x0026D218 /end MEASUREMENT
/begin MEASUREMENT ModelWithControllersOnly_B.TmpRTBAtMATLABFunction1Inport2 "" FLOAT64_IEEE ModelWithControllersOnly_CM_double 0 0 -1.7E+308 1.7E+308 ECU_ADDRESS 0x0026E350 /end MEASUREMENT
/begin MEASUREMENT ModelWithControllersOnly_B.TmpRTBAtMATLABFunction1Inport3 "" FLOAT64_IEEE ModelWithControllersOnly_CM_double 0 0 -1.7E+308 1.7E+308 ECU_ADDRESS 0x0026E358 /end MEASUREMENT
/begin MEASUREMENT ModelWithControllersOnly_B.TmpRTBAtMATLABFunction2Inport1 "" FLOAT64_IEEE ModelWithControllersOnly_CM_double 0 0 -1.7E+308 1.7E+308 ECU_ADDRESS 0x0026E360 /end MEASUREMENT
/begin MEASUREMENT ModelWithControllersOnly_B.TmpRTBAtMATLABFunction2Inport2 "" FLOAT64_IEEE ModelWithControllersOnly_CM_double 0 0 -1.7E+308 1.7E+308 ECU_ADDRESS 0x0026E368 /end MEASUREMENT
/begin MEASUREMENT ModelWithControllersOnly_B.TmpRTBAtMATLABFunction2Inport3 "" FLOAT64_IEEE ModelWithControllersOnly_CM_double 0 0 -1.7E+308 1.7E+308 ECU_ADDRESS 0x0026E370 /end MEASUREMENT
/begin MEASUREMENT ModelWithControllersOnly_B.TmpRTBAtMATLABFunction3Inport1 "" FLOAT64_IEEE ModelWithControllersOnly_CM_double 0 0 -1.7E+308 1.7E+308 ECU_ADDRESS 0x0026E318 /end MEASUREMENT
/begin MEASUREMENT ModelWithControllersOnly_B.TmpRTBAtMATLABFunction3Inport2 "" FLOAT64_IEEE ModelWithControllersOnly_CM_double 0 0 -1.7E+308 1.7E+308 ECU_ADDRESS 0x0026E320 /end MEASUREMENT
/begin MEASUREMENT ModelWithControllersOnly_B.TmpRTBAtMATLABFunction3Inport3 "" FLOAT64_IEEE ModelWithControllersOnly_CM_double 0 0 -1.7E+308 1.7E+308 ECU_ADDRESS 0x0026E328 /end MEASUREMENT
/begin MEASUREMENT ModelWithControllersOnly_B.TmpRTBAtMATLABFunctionInport2 "" FLOAT64_IEEE ModelWithControllersOnly_CM_double 0 0 -1.7E+308 1.7E+308 ECU_ADDRESS 0x0026E338 /end MEASUREMENT
/begin MEASUREMENT ModelWithControllersOnly_B.TmpRTBAtMATLABFunctionInport3 "" FLOAT64_IEEE ModelWithControllersOnly_CM_double 0 0 -1.7E+308 1.7E+308 ECU_ADDRESS 0x0026E340 /end MEASUREMENT
/begin MEASUREMENT ModelWithControllersOnly_B.TmpRTBAtMultiplyInport1 "" FLOAT64_IEEE ModelWithControllersOnly_CM_double 0 0 -1.7E+308 1.7E+308 ECU_ADDRESS 0x0026E2C8 /end MEASUREMENT
/begin MEASUREMENT ModelWithControllersOnly_B.TmpRTBAtSumInport3 "" FLOAT64_IEEE ModelWithControllersOnly_CM_double 0 0 -1.7E+308 1.7E+308 ECU_ADDRESS 0x0026D1F8 /end MEASUREMENT
/begin MEASUREMENT ModelWithControllersOnly_B.TmpRTBAtSumInport3_l "" FLOAT64_IEEE ModelWithControllersOnly_CM_double 0 0 -1.7E+308 1.7E+308 ECU_ADDRESS 0x0026D240 /end MEASUREMENT
/begin MEASUREMENT ModelWithControllersOnly_B.TmpRTBAtSwitchCaseInport1 "" FLOAT64_IEEE ModelWithControllersOnly_CM_double 0 0 -1.7E+308 1.7E+308 ECU_ADDRESS 0x0026E2D0 /end MEASUREMENT
/begin MEASUREMENT ModelWithControllersOnly_B.TmpSignalConversionAtTransposeI "" FLOAT64_IEEE ModelWithControllersOnly_CM_double 0 0 -1.7E+308 1.7E+308 LAYOUT COLUMN_DIR MATRIX_DIM 3 ECU_ADDRESS 0x0026D130 /end MEASUREMENT
/begin MEASUREMENT ModelWithControllersOnly_B.TnetNm "" FLOAT64_IEEE ModelWithControllersOnly_CM_double_N 0 0 -1.7E+308 1.7E+308 ECU_ADDRESS 0x0026D300 /end MEASUREMENT
/begin MEASUREMENT ModelWithControllersOnly_B.Transpose "" FLOAT64_IEEE ModelWithControllersOnly_CM_double 0 0 -1.7E+308 1.7E+308 LAYOUT COLUMN_DIR MATRIX_DIM 3 1 ECU_ADDRESS 0x0026D148 /end MEASUREMENT
/begin MEASUREMENT ModelWithControllersOnly_B.TrigonometricFunction "" FLOAT64_IEEE ModelWithControllersOnly_CM_double 0 0 -1.7E+308 1.7E+308 ECU_ADDRESS 0x0026D3D0 /end MEASUREMENT
/begin MEASUREMENT ModelWithControllersOnly_B.TrigonometricFunction_o1 "" FLOAT64_IEEE ModelWithControllersOnly_CM_double 0 0 -1.7E+308 1.7E+308 ECU_ADDRESS 0x0026D328 /end MEASUREMENT
/begin MEASUREMENT ModelWithControllersOnly_B.TrigonometricFunction_o2 "" FLOAT64_IEEE ModelWithControllersOnly_CM_double 0 0 -1.7E+308 1.7E+308 ECU_ADDRESS 0x0026D330 /end MEASUREMENT
/begin MEASUREMENT ModelWithControllersOnly_B.UnaryMinus "" FLOAT64_IEEE ModelWithControllersOnly_CM_double_N 0 0 -1.7E+308 1.7E+308 LAYOUT COLUMN_DIR MATRIX_DIM 3 ECU_ADDRESS 0x0026D510 /end MEASUREMENT
/begin MEASUREMENT ModelWithControllersOnly_B.UnaryMinus1 "" FLOAT64_IEEE ModelWithControllersOnly_CM_double_N_into_m 0 0 -1.7E+308 1.7E+308 LAYOUT COLUMN_DIR MATRIX_DIM 3 ECU_ADDRESS 0x0026D4B0 /end MEASUREMENT
/begin MEASUREMENT ModelWithControllersOnly_B.UnitConversion1 "" FLOAT64_IEEE ModelWithControllersOnly_CM_double_rad 0 0 -1.7E+308 1.7E+308 ECU_ADDRESS 0x0026D540 /end MEASUREMENT
/begin MEASUREMENT ModelWithControllersOnly_B.UnitDelay "" FLOAT64_IEEE ModelWithControllersOnly_CM_double 0 0 -1.7E+308 1.7E+308 ECU_ADDRESS 0x0026D198 /end MEASUREMENT
/begin MEASUREMENT ModelWithControllersOnly_B.UnitDelay_l "" FLOAT64_IEEE ModelWithControllersOnly_CM_double 0 0 -1.7E+308 1.7E+308 ECU_ADDRESS 0x0026D1A0 /end MEASUREMENT
/begin MEASUREMENT ModelWithControllersOnly_B.VectorConcatenate "" FLOAT64_IEEE ModelWithControllersOnly_CM_double 0 0 -1.7E+308 1.7E+308 LAYOUT COLUMN_DIR MATRIX_DIM 4 ECU_ADDRESS 0x0026D0C0 /end MEASUREMENT
/begin MEASUREMENT ModelWithControllersOnly_B.VectorConcatenate1 "" FLOAT64_IEEE ModelWithControllersOnly_CM_double 0 0 -1.7E+308 1.7E+308 LAYOUT COLUMN_DIR MATRIX_DIM 3 ECU_ADDRESS 0x0026D310 /end MEASUREMENT
/begin MEASUREMENT ModelWithControllersOnly_B.VectorConcatenate1_b "" FLOAT64_IEEE ModelWithControllersOnly_CM_double_m_per_s 0 0 -1.7E+308 1.7E+308 LAYOUT COLUMN_DIR MATRIX_DIM 3 ECU_ADDRESS 0x0026D338 /end MEASUREMENT
/begin MEASUREMENT ModelWithControllersOnly_B.VectorConcatenate1_b2 "" FLOAT64_IEEE ModelWithControllersOnly_CM_double_N 0 0 -1.7E+308 1.7E+308 LAYOUT COLUMN_DIR MATRIX_DIM 2 ECU_ADDRESS 0x0026DEF0 /end MEASUREMENT
/begin MEASUREMENT ModelWithControllersOnly_B.VectorConcatenate1_c "" FLOAT64_IEEE ModelWithControllersOnly_CM_double_N 0 0 -1.7E+308 1.7E+308 LAYOUT COLUMN_DIR MATRIX_DIM 2 ECU_ADDRESS 0x0026DF00 /end MEASUREMENT
/begin MEASUREMENT ModelWithControllersOnly_B.VectorConcatenate1_f "" FLOAT64_IEEE ModelWithControllersOnly_CM_double_1 0 0 -1.7E+308 1.7E+308 LAYOUT COLUMN_DIR MATRIX_DIM 2 ECU_ADDRESS 0x0026DEE0 /end MEASUREMENT
/begin MEASUREMENT ModelWithControllersOnly_B.VectorConcatenate2 "" FLOAT64_IEEE ModelWithControllersOnly_CM_double 0 0 -1.7E+308 1.7E+308 LAYOUT COLUMN_DIR MATRIX_DIM 3 ECU_ADDRESS 0x0026D370 /end MEASUREMENT
/begin MEASUREMENT ModelWithControllersOnly_B.VectorConcatenate3 "" FLOAT64_IEEE ModelWithControllersOnly_CM_double 0 0 -1.7E+308 1.7E+308 LAYOUT COLUMN_DIR MATRIX_DIM 2 ECU_ADDRESS 0x0026D108 /end MEASUREMENT
/begin MEASUREMENT ModelWithControllersOnly_B.VectorConcatenate_b "" FLOAT64_IEEE ModelWithControllersOnly_CM_double 0 0 -1.7E+308 1.7E+308 LAYOUT COLUMN_DIR MATRIX_DIM 6 ECU_ADDRESS 0x0026D408 /end MEASUREMENT
/begin MEASUREMENT ModelWithControllersOnly_B.X "" FLOAT64_IEEE ModelWithControllersOnly_CM_double_m 0 0 -1.7E+308 1.7E+308 ECU_ADDRESS 0x0026E330 /end MEASUREMENT
/begin MEASUREMENT ModelWithControllersOnly_B.Xdot "" FLOAT64_IEEE ModelWithControllersOnly_CM_double_m_per_s 0 0 -1.7E+308 1.7E+308 ECU_ADDRESS 0x0026E348 /end MEASUREMENT
/begin MEASUREMENT ModelWithControllersOnly_B.YawRateFeedback "" FLOAT64_IEEE ModelWithControllersOnly_CM_double 0 0 -1.7E+308 1.7E+308 ECU_ADDRESS 0x0026D190 /end MEASUREMENT
/begin MEASUREMENT ModelWithControllersOnly_B.Yawdeg "" FLOAT64_IEEE ModelWithControllersOnly_CM_double 0 0 -1.7E+308 1.7E+308 ECU_ADDRESS 0x0026D2D0 /end MEASUREMENT
/begin MEASUREMENT ModelWithControllersOnly_B.ZeroGain "" FLOAT64_IEEE ModelWithControllersOnly_CM_double 0 0 -1.7E+308 1.7E+308 ECU_ADDRESS 0x0026E518 /end MEASUREMENT
/begin MEASUREMENT ModelWithControllersOnly_B.ZeroGain_p "" FLOAT64_IEEE ModelWithControllersOnly_CM_double 0 0 -1.7E+308 1.7E+308 ECU_ADDRESS 0x0026E560 /end MEASUREMENT
/begin MEASUREMENT ModelWithControllersOnly_B.brake_cmdNm "" FLOAT64_IEEE ModelWithControllersOnly_CM_double 0 0 -1.7E+308 1.7E+308 ECU_ADDRESS 0x0026E250 /end MEASUREMENT
/begin MEASUREMENT ModelWithControllersOnly_B.brake_cmdNm_j "" FLOAT64_IEEE ModelWithControllersOnly_CM_double 0 0 -1.7E+308 1.7E+308 ECU_ADDRESS 0x0026E278 /end MEASUREMENT
/begin MEASUREMENT ModelWithControllersOnly_B.error "" FLOAT64_IEEE ModelWithControllersOnly_CM_double 0 0 -1.7E+308 1.7E+308 ECU_ADDRESS 0x0026E2E0 /end MEASUREMENT
/begin MEASUREMENT ModelWithControllersOnly_B.gear_cmd "" FLOAT64_IEEE ModelWithControllersOnly_CM_double 0 0 -1.7E+308 1.7E+308 ECU_ADDRESS 0x0026D280 /end MEASUREMENT
/begin MEASUREMENT ModelWithControllersOnly_B.gear_cmd_d "" FLOAT64_IEEE ModelWithControllersOnly_CM_double 0 0 -1.7E+308 1.7E+308 ECU_ADDRESS 0x0026E280 /end MEASUREMENT
/begin MEASUREMENT ModelWithControllersOnly_B.gear_cmd_e "" FLOAT64_IEEE ModelWithControllersOnly_CM_double 0 0 -1.7E+308 1.7E+308 ECU_ADDRESS 0x0026E240 /end MEASUREMENT
/begin MEASUREMENT ModelWithControllersOnly_B.gear_cmd_i "" FLOAT64_IEEE ModelWithControllersOnly_CM_double 0 0 -1.7E+308 1.7E+308 ECU_ADDRESS 0x0026E248 /end MEASUREMENT
/begin MEASUREMENT ModelWithControllersOnly_B.stateDer "" FLOAT64_IEEE ModelWithControllersOnly_CM_double 0 0 -1.7E+308 1.7E+308 LAYOUT COLUMN_DIR MATRIX_DIM 4 ECU_ADDRESS 0x0026E490 /end MEASUREMENT
/begin MEASUREMENT ModelWithControllersOnly_B.status "" FLOAT64_IEEE ModelWithControllersOnly_CM_double 0 0 -1.7E+308 1.7E+308 ECU_ADDRESS 0x0026E4B0 /end MEASUREMENT
/begin MEASUREMENT ModelWithControllersOnly_B.steerCmd "" FLOAT64_IEEE ModelWithControllersOnly_CM_double 0 0 -1.7E+308 1.7E+308 ECU_ADDRESS 0x0026E598 /end MEASUREMENT
/begin MEASUREMENT ModelWithControllersOnly_B.steer_cmddeg "" FLOAT64_IEEE ModelWithControllersOnly_CM_double 0 0 -1.7E+308 1.7E+308 ECU_ADDRESS 0x0026E258 /end MEASUREMENT
/begin MEASUREMENT ModelWithControllersOnly_B.steer_cmddeg_n "" FLOAT64_IEEE ModelWithControllersOnly_CM_double 0 0 -1.7E+308 1.7E+308 ECU_ADDRESS 0x0026E268 /end MEASUREMENT
/begin MEASUREMENT ModelWithControllersOnly_B.torque_cmdNm "" FLOAT64_IEEE ModelWithControllersOnly_CM_double 0 0 -1.7E+308 1.7E+308 ECU_ADDRESS 0x0026E260 /end MEASUREMENT
/begin MEASUREMENT ModelWithControllersOnly_B.torque_cmdNm_j "" FLOAT64_IEEE ModelWithControllersOnly_CM_double 0 0 -1.7E+308 1.7E+308 ECU_ADDRESS 0x0026E270 /end MEASUREMENT
/begin MEASUREMENT ModelWithControllersOnly_B.torquetoaccelerationconversion1 "" FLOAT64_IEEE ModelWithControllersOnly_CM_double_N 0 0 -1.7E+308 1.7E+308 ECU_ADDRESS 0x0026E238 /end MEASUREMENT
/begin MEASUREMENT ModelWithControllersOnly_B.u "" FLOAT64_IEEE ModelWithControllersOnly_CM_double 0 0 -1.7E+308 1.7E+308 LAYOUT COLUMN_DIR MATRIX_DIM 3 ECU_ADDRESS 0x0026D3D8 /end MEASUREMENT
/begin MEASUREMENT ModelWithControllersOnly_B.uAPabsRT "" FLOAT64_IEEE ModelWithControllersOnly_CM_double 0 0 -1.7E+308 1.7E+308 LAYOUT COLUMN_DIR MATRIX_DIM 6 ECU_ADDRESS 0x0026D468 /end MEASUREMENT
/begin MEASUREMENT ModelWithControllersOnly_B.v "" FLOAT64_IEEE ModelWithControllersOnly_CM_double 0 0 -1.7E+308 1.7E+308 ECU_ADDRESS 0x0026D1D8 /end MEASUREMENT
/begin MEASUREMENT ModelWithControllersOnly_B.v_g "" FLOAT64_IEEE ModelWithControllersOnly_CM_double 0 0 -1.7E+308 1.7E+308 ECU_ADDRESS 0x0026D220 /end MEASUREMENT
/begin MEASUREMENT ModelWithControllersOnly_B.wheelInfo "" FLOAT64_IEEE ModelWithControllersOnly_CM_double 0 0 -1.7E+308 1.7E+308 LAYOUT COLUMN_DIR MATRIX_DIM 4 ECU_ADDRESS 0x0026E470 /end MEASUREMENT
/begin MEASUREMENT ModelWithControllersOnly_B.wheelspeed "" FLOAT64_IEEE ModelWithControllersOnly_CM_double 0 0 -1.7E+308 1.7E+308 ECU_ADDRESS 0x0026D308 /end MEASUREMENT
/begin MEASUREMENT ModelWithControllersOnly_B.xdot "" FLOAT64_IEEE ModelWithControllersOnly_CM_double 0 0 -1.7E+308 1.7E+308 ECU_ADDRESS 0x0026E2B0 /end MEASUREMENT
/begin MEASUREMENT ModelWithControllersOnly_B.xdot1 "" FLOAT64_IEEE ModelWithControllersOnly_CM_double 0 0 -1.7E+308 1.7E+308 ECU_ADDRESS 0x0026E2A0 /end MEASUREMENT
/begin MEASUREMENT ModelWithControllersOnly_B.xdot_p "" FLOAT64_IEEE ModelWithControllersOnly_CM_double 0 0 -1.7E+308 1.7E+308 ECU_ADDRESS 0x0026E2D8 /end MEASUREMENT
/begin MEASUREMENT ModelWithControllersOnly_B.y "" FLOAT64_IEEE ModelWithControllersOnly_CM_double_m_per_s 0 0 -1.7E+308 1.7E+308 LAYOUT COLUMN_DIR MATRIX_DIM 2 ECU_ADDRESS 0x0026E4B8 /end MEASUREMENT
/begin MEASUREMENT ModelWithControllersOnly_B.yOut "" FLOAT64_IEEE ModelWithControllersOnly_CM_double 0 0 -1.7E+308 1.7E+308 LAYOUT COLUMN_DIR MATRIX_DIM 3 ECU_ADDRESS 0x0026E3B0 /end MEASUREMENT
/begin MEASUREMENT ModelWithControllersOnly_DW.Assertion1_sltestCurrentResult "" SLONG ModelWithControllersOnly_CM_int32 0 0 -2147483648 2147483647 ECU_ADDRESS 0x0026CF6C /end MEASUREMENT
/begin MEASUREMENT ModelWithControllersOnly_DW.Assertion1_sltestFinalResult "" SLONG ModelWithControllersOnly_CM_int32 0 0 -2147483648 2147483647 ECU_ADDRESS 0x0026CF68 /end MEASUREMENT
/begin MEASUREMENT ModelWithControllersOnly_DW.Assertion1_sltestLastResultTime "" FLOAT64_IEEE ModelWithControllersOnly_CM_double 0 0 -1.7E+308 1.7E+308 ECU_ADDRESS 0x0026CE08 /end MEASUREMENT
/begin MEASUREMENT ModelWithControllersOnly_DW.Assertion_sltestCurrentResult "" SLONG ModelWithControllersOnly_CM_int32 0 0 -2147483648 2147483647 ECU_ADDRESS 0x0026CF64 /end MEASUREMENT
/begin MEASUREMENT ModelWithControllersOnly_DW.Assertion_sltestFinalResult "" SLONG ModelWithControllersOnly_CM_int32 0 0 -2147483648 2147483647 ECU_ADDRESS 0x0026CF60 /end MEASUREMENT
/begin MEASUREMENT ModelWithControllersOnly_DW.Assertion_sltestLastResultTime "" FLOAT64_IEEE ModelWithControllersOnly_CM_double 0 0 -1.7E+308 1.7E+308 ECU_ADDRESS 0x0026CE00 /end MEASUREMENT
/begin MEASUREMENT ModelWithControllersOnly_DW.Ck "" FLOAT64_IEEE ModelWithControllersOnly_CM_double 0 0 -1.7E+308 1.7E+308 ECU_ADDRESS 0x0026CD50 /end MEASUREMENT
/begin MEASUREMENT ModelWithControllersOnly_DW.Ck_o "" FLOAT64_IEEE ModelWithControllersOnly_CM_double 0 0 -1.7E+308 1.7E+308 ECU_ADDRESS 0x0026CD70 /end MEASUREMENT
/begin MEASUREMENT ModelWithControllersOnly_DW.Integrator_DSTATE "" FLOAT64_IEEE ModelWithControllersOnly_CM_double 0 0 -1.7E+308 1.7E+308 ECU_ADDRESS 0x0026CA38 /end MEASUREMENT
/begin MEASUREMENT ModelWithControllersOnly_DW.Integrator_DSTATE_o "" FLOAT64_IEEE ModelWithControllersOnly_CM_double 0 0 -1.7E+308 1.7E+308 ECU_ADDRESS 0x0026CA40 /end MEASUREMENT
/begin MEASUREMENT ModelWithControllersOnly_DW.Integrator_PrevResetState "" SBYTE ModelWithControllersOnly_CM_int8 0 0 -128 127 ECU_ADDRESS 0x0026CFC6 /end MEASUREMENT
/begin MEASUREMENT ModelWithControllersOnly_DW.Integrator_PrevResetState_n "" SBYTE ModelWithControllersOnly_CM_int8 0 0 -128 127 ECU_ADDRESS 0x0026CFC8 /end MEASUREMENT
/begin MEASUREMENT ModelWithControllersOnly_DW.LastUAtTimeA "" FLOAT64_IEEE ModelWithControllersOnly_CM_double 0 0 -1.7E+308 1.7E+308 ECU_ADDRESS 0x0026CB70 /end MEASUREMENT
/begin MEASUREMENT ModelWithControllersOnly_DW.LastUAtTimeA_d "" FLOAT64_IEEE ModelWithControllersOnly_CM_double 0 0 -1.7E+308 1.7E+308 ECU_ADDRESS 0x0026CB90 /end MEASUREMENT
/begin MEASUREMENT ModelWithControllersOnly_DW.LastUAtTimeA_h "" FLOAT64_IEEE ModelWithControllersOnly_CM_double 0 0 -1.7E+308 1.7E+308 ECU_ADDRESS 0x0026CC10 /end MEASUREMENT
/begin MEASUREMENT ModelWithControllersOnly_DW.LastUAtTimeA_k "" FLOAT64_IEEE ModelWithControllersOnly_CM_double 0 0 -1.7E+308 1.7E+308 ECU_ADDRESS 0x0026CBF0 /end MEASUREMENT
/begin MEASUREMENT ModelWithControllersOnly_DW.LastUAtTimeA_n "" FLOAT64_IEEE ModelWithControllersOnly_CM_double 0 0 -1.7E+308 1.7E+308 ECU_ADDRESS 0x0026CBB0 /end MEASUREMENT
/begin MEASUREMENT ModelWithControllersOnly_DW.LastUAtTimeA_nv "" FLOAT64_IEEE ModelWithControllersOnly_CM_double 0 0 -1.7E+308 1.7E+308 ECU_ADDRESS 0x0026CBD0 /end MEASUREMENT
/begin MEASUREMENT ModelWithControllersOnly_DW.LastUAtTimeA_o "" FLOAT64_IEEE ModelWithControllersOnly_CM_double 0 0 -1.7E+308 1.7E+308 ECU_ADDRESS 0x0026CD30 /end MEASUREMENT
/begin MEASUREMENT ModelWithControllersOnly_DW.LastUAtTimeB "" FLOAT64_IEEE ModelWithControllersOnly_CM_double 0 0 -1.7E+308 1.7E+308 ECU_ADDRESS 0x0026CB80 /end MEASUREMENT
/begin MEASUREMENT ModelWithControllersOnly_DW.LastUAtTimeB_c "" FLOAT64_IEEE ModelWithControllersOnly_CM_double 0 0 -1.7E+308 1.7E+308 ECU_ADDRESS 0x0026CD40 /end MEASUREMENT
/begin MEASUREMENT ModelWithControllersOnly_DW.LastUAtTimeB_d "" FLOAT64_IEEE ModelWithControllersOnly_CM_double 0 0 -1.7E+308 1.7E+308 ECU_ADDRESS 0x0026CBC0 /end MEASUREMENT
/begin MEASUREMENT ModelWithControllersOnly_DW.LastUAtTimeB_f "" FLOAT64_IEEE ModelWithControllersOnly_CM_double 0 0 -1.7E+308 1.7E+308 ECU_ADDRESS 0x0026CC20 /end MEASUREMENT
/begin MEASUREMENT ModelWithControllersOnly_DW.LastUAtTimeB_g "" FLOAT64_IEEE ModelWithControllersOnly_CM_double 0 0 -1.7E+308 1.7E+308 ECU_ADDRESS 0x0026CBE0 /end MEASUREMENT
/begin MEASUREMENT ModelWithControllersOnly_DW.LastUAtTimeB_o "" FLOAT64_IEEE ModelWithControllersOnly_CM_double 0 0 -1.7E+308 1.7E+308 ECU_ADDRESS 0x0026CBA0 /end MEASUREMENT
/begin MEASUREMENT ModelWithControllersOnly_DW.LastUAtTimeB_p "" FLOAT64_IEEE ModelWithControllersOnly_CM_double 0 0 -1.7E+308 1.7E+308 ECU_ADDRESS 0x0026CC00 /end MEASUREMENT
/begin MEASUREMENT ModelWithControllersOnly_DW.Mk "" FLOAT64_IEEE ModelWithControllersOnly_CM_double 0 0 -1.7E+308 1.7E+308 ECU_ADDRESS 0x0026CD58 /end MEASUREMENT
/begin MEASUREMENT ModelWithControllersOnly_DW.Mk_n "" FLOAT64_IEEE ModelWithControllersOnly_CM_double 0 0 -1.7E+308 1.7E+308 ECU_ADDRESS 0x0026CD78 /end MEASUREMENT
/begin MEASUREMENT ModelWithControllersOnly_DW.RateTransition1_Buf "" FLOAT64_IEEE ModelWithControllersOnly_CM_double 0 0 -1.7E+308 1.7E+308 LAYOUT COLUMN_DIR MATRIX_DIM 2 ECU_ADDRESS 0x0026CC38 /end MEASUREMENT
/begin MEASUREMENT ModelWithControllersOnly_DW.RateTransition1_RdBufIdx "" SBYTE ModelWithControllersOnly_CM_int8 0 0 -128 127 ECU_ADDRESS 0x0026CFA8 /end MEASUREMENT
/begin MEASUREMENT ModelWithControllersOnly_DW.RateTransition1_WrBufIdx "" SBYTE ModelWithControllersOnly_CM_int8 0 0 -128 127 ECU_ADDRESS 0x0026CFA9 /end MEASUREMENT
/begin MEASUREMENT ModelWithControllersOnly_DW.RateTransition2_Buf "" FLOAT64_IEEE ModelWithControllersOnly_CM_double 0 0 -1.7E+308 1.7E+308 LAYOUT COLUMN_DIR MATRIX_DIM 2 ECU_ADDRESS 0x0026CC48 /end MEASUREMENT
/begin MEASUREMENT ModelWithControllersOnly_DW.RateTransition2_RdBufIdx "" SBYTE ModelWithControllersOnly_CM_int8 0 0 -128 127 ECU_ADDRESS 0x0026CFAA /end MEASUREMENT
/begin MEASUREMENT ModelWithControllersOnly_DW.RateTransition2_WrBufIdx "" SBYTE ModelWithControllersOnly_CM_int8 0 0 -128 127 ECU_ADDRESS 0x0026CFAB /end MEASUREMENT
/begin MEASUREMENT ModelWithControllersOnly_DW.RateTransition_Buf "" FLOAT64_IEEE ModelWithControllersOnly_CM_double 0 0 -1.7E+308 1.7E+308 LAYOUT COLUMN_DIR MATRIX_DIM 2 ECU_ADDRESS 0x0026CC28 /end MEASUREMENT
/begin MEASUREMENT ModelWithControllersOnly_DW.RateTransition_RdBufIdx "" SBYTE ModelWithControllersOnly_CM_int8 0 0 -128 127 ECU_ADDRESS 0x0026CFA6 /end MEASUREMENT
/begin MEASUREMENT ModelWithControllersOnly_DW.RateTransition_WrBufIdx "" SBYTE ModelWithControllersOnly_CM_int8 0 0 -128 127 ECU_ADDRESS 0x0026CFA7 /end MEASUREMENT
/begin MEASUREMENT ModelWithControllersOnly_DW.SwitchCase_ActiveSubsystem "" SBYTE ModelWithControllersOnly_CM_int8 0 0 -128 127 ECU_ADDRESS 0x0026CFC4 /end MEASUREMENT
/begin MEASUREMENT ModelWithControllersOnly_DW.TimeStampA "" FLOAT64_IEEE ModelWithControllersOnly_CM_double 0 0 -1.7E+308 1.7E+308 ECU_ADDRESS 0x0026CB68 /end MEASUREMENT
/begin MEASUREMENT ModelWithControllersOnly_DW.TimeStampA_e "" FLOAT64_IEEE ModelWithControllersOnly_CM_double 0 0 -1.7E+308 1.7E+308 ECU_ADDRESS 0x0026CBA8 /end MEASUREMENT
/begin MEASUREMENT ModelWithControllersOnly_DW.TimeStampA_h "" FLOAT64_IEEE ModelWithControllersOnly_CM_double 0 0 -1.7E+308 1.7E+308 ECU_ADDRESS 0x0026CD28 /end MEASUREMENT
/begin MEASUREMENT ModelWithControllersOnly_DW.TimeStampA_k "" FLOAT64_IEEE ModelWithControllersOnly_CM_double 0 0 -1.7E+308 1.7E+308 ECU_ADDRESS 0x0026CC08 /end MEASUREMENT
/begin MEASUREMENT ModelWithControllersOnly_DW.TimeStampA_l "" FLOAT64_IEEE ModelWithControllersOnly_CM_double 0 0 -1.7E+308 1.7E+308 ECU_ADDRESS 0x0026CB88 /end MEASUREMENT
/begin MEASUREMENT ModelWithControllersOnly_DW.TimeStampA_l5 "" FLOAT64_IEEE ModelWithControllersOnly_CM_double 0 0 -1.7E+308 1.7E+308 ECU_ADDRESS 0x0026CBE8 /end MEASUREMENT
/begin MEASUREMENT ModelWithControllersOnly_DW.TimeStampA_o "" FLOAT64_IEEE ModelWithControllersOnly_CM_double 0 0 -1.7E+308 1.7E+308 ECU_ADDRESS 0x0026CBC8 /end MEASUREMENT
/begin MEASUREMENT ModelWithControllersOnly_DW.TimeStampB "" FLOAT64_IEEE ModelWithControllersOnly_CM_double 0 0 -1.7E+308 1.7E+308 ECU_ADDRESS 0x0026CB78 /end MEASUREMENT
/begin MEASUREMENT ModelWithControllersOnly_DW.TimeStampB_e "" FLOAT64_IEEE ModelWithControllersOnly_CM_double 0 0 -1.7E+308 1.7E+308 ECU_ADDRESS 0x0026CBF8 /end MEASUREMENT
/begin MEASUREMENT ModelWithControllersOnly_DW.TimeStampB_h "" FLOAT64_IEEE ModelWithControllersOnly_CM_double 0 0 -1.7E+308 1.7E+308 ECU_ADDRESS 0x0026CD38 /end MEASUREMENT
/begin MEASUREMENT ModelWithControllersOnly_DW.TimeStampB_k "" FLOAT64_IEEE ModelWithControllersOnly_CM_double 0 0 -1.7E+308 1.7E+308 ECU_ADDRESS 0x0026CBB8 /end MEASUREMENT
/begin MEASUREMENT ModelWithControllersOnly_DW.TimeStampB_l "" FLOAT64_IEEE ModelWithControllersOnly_CM_double 0 0 -1.7E+308 1.7E+308 ECU_ADDRESS 0x0026CB98 /end MEASUREMENT
/begin MEASUREMENT ModelWithControllersOnly_DW.TimeStampB_l4 "" FLOAT64_IEEE ModelWithControllersOnly_CM_double 0 0 -1.7E+308 1.7E+308 ECU_ADDRESS 0x0026CC18 /end MEASUREMENT
/begin MEASUREMENT ModelWithControllersOnly_DW.TimeStampB_lf "" FLOAT64_IEEE ModelWithControllersOnly_CM_double 0 0 -1.7E+308 1.7E+308 ECU_ADDRESS 0x0026CBD8 /end MEASUREMENT
/begin MEASUREMENT ModelWithControllersOnly_DW.Tk "" FLOAT64_IEEE ModelWithControllersOnly_CM_double 0 0 -1.7E+308 1.7E+308 ECU_ADDRESS 0x0026CD48 /end MEASUREMENT
/begin MEASUREMENT ModelWithControllersOnly_DW.Tk_d "" FLOAT64_IEEE ModelWithControllersOnly_CM_double 0 0 -1.7E+308 1.7E+308 ECU_ADDRESS 0x0026CD68 /end MEASUREMENT
/begin MEASUREMENT ModelWithControllersOnly_DW.Uk "" FLOAT64_IEEE ModelWithControllersOnly_CM_double 0 0 -1.7E+308 1.7E+308 ECU_ADDRESS 0x0026CD60 /end MEASUREMENT
/begin MEASUREMENT ModelWithControllersOnly_DW.Uk_d "" FLOAT64_IEEE ModelWithControllersOnly_CM_double 0 0 -1.7E+308 1.7E+308 ECU_ADDRESS 0x0026CD80 /end MEASUREMENT
/begin MEASUREMENT ModelWithControllersOnly_DW.UnitDelay_DSTATE "" FLOAT64_IEEE ModelWithControllersOnly_CM_double 0 0 -1.7E+308 1.7E+308 ECU_ADDRESS 0x0026C9F0 /end MEASUREMENT
/begin MEASUREMENT ModelWithControllersOnly_DW.UnitDelay_DSTATE_e "" FLOAT64_IEEE ModelWithControllersOnly_CM_double 0 0 -1.7E+308 1.7E+308 ECU_ADDRESS 0x0026C9F8 /end MEASUREMENT
/begin COMPU_METHOD ModelWithControllersOnly_CM_double "" IDENTICAL "%15.10" "" /end COMPU_METHOD
/begin COMPU_METHOD ModelWithControllersOnly_CM_double_1 "" IDENTICAL "%15.10" "1" /end COMPU_METHOD
/begin COMPU_METHOD ModelWithControllersOnly_CM_double_N "" IDENTICAL "%15.10" "N" /end COMPU_METHOD
/begin COMPU_METHOD ModelWithControllersOnly_CM_double_N_into_m "" IDENTICAL "%15.10" "N*m" /end COMPU_METHOD
/begin COMPU_METHOD ModelWithControllersOnly_CM_double_m "" IDENTICAL "%15.10" "m" /end COMPU_METHOD
/begin COMPU_METHOD ModelWithControllersOnly_CM_double_m_per_s "" IDENTICAL "%15.10" "m/s" /end COMPU_METHOD
/begin COMPU_METHOD ModelWithControllersOnly_CM_double_rad "" IDENTICAL "%15.10" "rad" /end COMPU_METHOD
/begin COMPU_METHOD ModelWithControllersOnly_CM_int32 "" IDENTICAL "%10.0" "" /end COMPU_METHOD
/begin COMPU_METHOD ModelWithControllersOnly_CM_int8 "" IDENTICAL "%3.0" "" /end COMPU_METHOD
/begin COMPU_METHOD ModelWithControllersOnly_CM_logical "" IDENTICAL "%1.0" "" /end COMPU_METHOD
/begin RECORD_LAYOUT FixLookup_FLOAT64_IEEE FNC_VALUES 1 FLOAT64_IEEE COLUMN_DIR DIRECT /end RECORD_LAYOUT
/begin RECORD_LAYOUT Scalar_FLOAT64_IEEE FNC_VALUES 1 FLOAT64_IEEE COLUMN_DIR DIRECT /end RECORD_LAYOUT
/begin GROUP ModelWithControllersOnly "ModelWithControllersOnly" ROOT
 /begin SUB_GROUP ModelWithControllersOnly_Lateral_Controller_Stanley ModelWithControllersOnly_Longitudinal_Controller_Stanley ModelWithControllersOnly_Subsystem1 ModelWithControllersOnly_Subsystem3 ModelWithControllersOnly_Vehicle_Dynamics1 /end SUB_GROUP
 /begin REF_CHARACTERISTIC ModelWithControllersOn_cal_impl.Constant1_Value_k ModelWithControllersOn_cal_impl.Constant2_Value_e ModelWithControllersOn_cal_impl.Constant3_Value_j2 ModelWithControllersOn_cal_impl.Constant4_Value ModelWithControllersOn_cal_impl.Constant_Value ModelWithControllersOn_cal_impl.Gain1_Gain_a ModelWithControllersOn_cal_impl.UnitDelay_InitialCondition_g /end REF_CHARACTERISTIC
 /begin REF_MEASUREMENT ModelWithControllersOnly_B.Gain1_g ModelWithControllersOnly_B.Gain_n ModelWithControllersOnly_B.Integrator ModelWithControllersOnly_B.Saturation ModelWithControllersOnly_B.Saturation_k ModelWithControllersOnly_B.UnitDelay_l ModelWithControllersOnly_DW.Scope_PWORK ModelWithControllersOnly_DW.UnitDelay_DSTATE_e /end REF_MEASUREMENT
/end GROUP
/begin GROUP ModelWithControllersOnly_B.BusCreator ""
 /begin REF_MEASUREMENT ModelWithControllersOnly_B.BusCreator.ActorID ModelWithControllersOnly_B.BusCreator.Position ModelWithControllersOnly_B.BusCreator.Velocity ModelWithControllersOnly_B.BusCreator.Acceleration ModelWithControllersOnly_B.BusCreator.Roll ModelWithControllersOnly_B.BusCreator.Pitch ModelWithControllersOnly_B.BusCreator.Yaw ModelWithControllersOnly_B.BusCreator.AngularVelocity /end REF_MEASUREMENT
/end GROUP
/begin GROUP ModelWithControllersOnly_Lateral_Controller_Stanley "ModelWithControllersOnly/Lateral Controller Stanley"
 /begin SUB_GROUP ModelWithControllersOnly_Lateral_Controller_Stanley_Dynamic /end SUB_GROUP
 /begin REF_CHARACTERISTIC ModelWithControllersOn_cal_impl.Kinematic_MaxSteeringAngle ModelWithControllersOn_cal_impl.Kinematic_Wheelbase ModelWithControllersOn_cal_impl.LateralControllerStanley_Posi_i ModelWithControllersOn_cal_impl.LateralControllerStanley_Positi /end REF_CHARACTERISTIC
 /begin REF_MEASUREMENT ModelWithControllersOnly_B.Saturation ModelWithControllersOnly_B.Transpose ModelWithControllersOnly_B.steerCmd /end REF_MEASUREMENT
/end GROUP
/begin GROUP ModelWithControllersOnly_Lateral_Controller_Stanley_Dynamic "ModelWithControllersOnly/Lateral Controller Stanley/Dynamic"
 /begin SUB_GROUP ModelWithControllersOnly_Lateral_Controller_Stanley_Dynamic_Dynamic_Enabled /end SUB_GROUP
/end GROUP
/begin GROUP ModelWithControllersOnly_Lateral_Controller_Stanley_Dynamic_Dynamic_Enabled "ModelWithControllersOnly/Lateral Controller Stanley/Dynamic/Dynamic Enabled"
 /begin SUB_GROUP ModelWithControllersOnly_Lateral_Controller_Stanley_Dynamic_Dynamic_Enabled_Radians_to_Degrees /end SUB_GROUP
 /begin REF_CHARACTERISTIC ModelWithControllersOn_cal_impl.Gain1_Gain_o ModelWithControllersOn_cal_impl.LateralControllerStanley_DelayG ModelWithControllersOn_cal_impl.LateralControllerStanley_YawRat ModelWithControllersOn_cal_impl.Saturation_LowerSat_f ModelWithControllersOn_cal_impl.Saturation_UpperSat_n ModelWithControllersOn_cal_impl.UnitDelay_InitialCondition /end REF_CHARACTERISTIC
 /begin REF_MEASUREMENT ModelWithControllersOnly_B.Add ModelWithControllersOnly_B.CurvedSteadyYaw ModelWithControllersOnly_B.Gain ModelWithControllersOnly_B.Gain1_g ModelWithControllersOnly_B.Minus ModelWithControllersOnly_B.Minus1 ModelWithControllersOnly_B.Multiply ModelWithControllersOnly_B.Product ModelWithControllersOnly_B.Saturation ModelWithControllersOnly_B.Saturation_k ModelWithControllersOnly_B.SteeringDelay ModelWithControllersOnly_B.UnitDelay ModelWithControllersOnly_B.UnitDelay_l ModelWithControllersOnly_B.YawRateFeedback ModelWithControllersOnly_B.steerCmd ModelWithControllersOnly_DW.UnitDelay_DSTATE /end REF_MEASUREMENT
/end GROUP
/begin GROUP ModelWithControllersOnly_Lateral_Controller_Stanley_Dynamic_Dynamic_Enabled_Radians_to_Degrees "ModelWithControllersOnly/Lateral Controller Stanley/Dynamic/Dynamic Enabled/Radians
to Degrees" /begin REF_CHARACTERISTIC ModelWithControllersOn_cal_impl.Gain_Gain /end REF_CHARACTERISTIC
 /begin REF_MEASUREMENT ModelWithControllersOnly_B.Gain ModelWithControllersOnly_B.Product /end REF_MEASUREMENT
/end GROUP
/begin GROUP ModelWithControllersOnly_Longitudinal_Controller_Stanley "ModelWithControllersOnly/Longitudinal Controller Stanley"
 /begin SUB_GROUP ModelWithControllersOnly_Longitudinal_Controller_Stanley_Convert_Command_ ModelWithControllersOnly_Longitudinal_Controller_Stanley_PI_Controller ModelWithControllersOnly_Longitudinal_Controller_Stanley_Verify_Direction /end SUB_GROUP
 /begin REF_MEASUREMENT ModelWithControllersOnly_B.error ModelWithControllersOnly_B.xdot_p /end REF_MEASUREMENT
/end GROUP
/begin GROUP ModelWithControllersOnly_Longitudinal_Controller_Stanley_Convert_Command_ "ModelWithControllersOnly/Longitudinal Controller Stanley/Convert Command "
 /begin REF_CHARACTERISTIC ModelWithControllersOn_cal_impl.Constant_Value_c ModelWithControllersOn_cal_impl.Switch1_Threshold_i ModelWithControllersOn_cal_impl.Switch_Threshold_l /end REF_CHARACTERISTIC
 /begin REF_MEASUREMENT ModelWithControllersOnly_B.Abs_k ModelWithControllersOnly_B.Merge ModelWithControllersOnly_B.Multiply_n ModelWithControllersOnly_B.Switch1_l ModelWithControllersOnly_B.Switch_l ModelWithControllersOnly_B.TmpRTBAtMultiplyInport1 /end REF_MEASUREMENT
/end GROUP
/begin GROUP ModelWithControllersOnly_Longitudinal_Controller_Stanley_PI_Controller "ModelWithControllersOnly/Longitudinal Controller Stanley/PI Controller"
 /begin SUB_GROUP ModelWithControllersOnly_Longitudinal_Controller_Stanley_PI_Controller_Forward ModelWithControllersOnly_Longitudinal_Controller_Stanley_PI_Controller_Reverse /end SUB_GROUP
 /begin REF_CHARACTERISTIC ModelWithControllersOn_cal_impl.Merge_InitialOutput /end REF_CHARACTERISTIC
 /begin REF_MEASUREMENT ModelWithControllersOnly_B.DataTypeConversion ModelWithControllersOnly_B.Merge ModelWithControllersOnly_B.TmpRTBAtSwitchCaseInport1 ModelWithControllersOnly_DW.SwitchCase_ActiveSubsystem /end REF_MEASUREMENT
/end GROUP
/begin GROUP ModelWithControllersOnly_Longitudinal_Controller_Stanley_PI_Controller_Forward "ModelWithControllersOnly/Longitudinal Controller Stanley/PI Controller/Forward"
 /begin SUB_GROUP ModelWithControllersOnly_Longitudinal_Controller_Stanley_PI_Controller_Forward_PI_Forward_ /end SUB_GROUP
/end GROUP
/begin GROUP ModelWithControllersOnly_Longitudinal_Controller_Stanley_PI_Controller_Forward_PI_Forward_ "ModelWithControllersOnly/Longitudinal Controller Stanley/PI Controller/Forward/PI Forward
"
 /begin SUB_GROUP ModelWithControllersOnly_Longitudinal_Controller_Stanley_PI_Controller_Forward_PI_Forward__Anti_windup ModelWithControllersOnly_Longitudinal_Controller_Stanley_PI_Controller_Forward_PI_Forward__D_Gain ModelWithControllersOnly_Longitudinal_Controller_Stanley_PI_Controller_Forward_PI_Forward__Filter ModelWithControllersOnly_Longitudinal_Controller_Stanley_PI_Controller_Forward_PI_Forward__Filter_ICs ModelWithControllersOnly_Longitudinal_Controller_Stanley_PI_Controller_Forward_PI_Forward__I_Gain ModelWithControllersOnly_Longitudinal_Controller_Stanley_PI_Controller_Forward_PI_Forward__Ideal_P_Gain ModelWithControllersOnly_Longitudinal_Controller_Stanley_PI_Controller_Forward_PI_Forward__Ideal_P_Gain_Fdbk ModelWithControllersOnly_Longitudinal_Controller_Stanley_PI_Controller_Forward_PI_Forward__Integrator ModelWithControllersOnly_Longitudinal_Controller_Stanley_PI_Controller_Forward_PI_Forward__Integrator_ICs ModelWithControllersOnly_Longitudinal_Controller_Stanley_PI_Controller_Forward_PI_Forward__N_Copy ModelWithControllersOnly_Longitudinal_Controller_Stanley_PI_Controller_Forward_PI_Forward__N_Gain ModelWithControllersOnly_Longitudinal_Controller_Stanley_PI_Controller_Forward_PI_Forward__PID_Compensator_Formula ModelWithControllersOnly_Longitudinal_Controller_Stanley_PI_Controller_Forward_PI_Forward__P_Copy ModelWithControllersOnly_Longitudinal_Controller_Stanley_PI_Controller_Forward_PI_Forward__Parallel_P_Gain ModelWithControllersOnly_Longitudinal_Controller_Stanley_PI_Controller_Forward_PI_Forward__Reset_Signal ModelWithControllersOnly_Longitudinal_Controller_Stanley_PI_Controller_Forward_PI_Forward__Saturation ModelWithControllersOnly_Longitudinal_Controller_Stanley_PI_Controller_Forward_PI_Forward__Saturation_Fdbk ModelWithControllersOnly_Longitudinal_Controller_Stanley_PI_Controller_Forward_PI_Forward__Sum /end SUB_GROUP
/end GROUP
/begin GROUP ModelWithControllersOnly_Longitudinal_Controller_Stanley_PI_Controller_Forward_PI_Forward__Anti_windup "ModelWithControllersOnly/Longitudinal Controller Stanley/PI Controller/Forward/PI Forward
/Anti-windup"
 /begin SUB_GROUP ModelWithControllersOnly_Longitudinal_Controller_Stanley_PI_Controller_Forward_PI_Forward__Anti_windup_Disc__Clamping_Parallel /end SUB_GROUP
/end GROUP
/begin GROUP ModelWithControllersOnly_Longitudinal_Controller_Stanley_PI_Controller_Forward_PI_Forward__Anti_windup_Disc__Clamping_Parallel "ModelWithControllersOnly/Longitudinal Controller Stanley/PI Controller/Forward/PI Forward
/Anti-windup/Disc. Clamping Parallel"
 /begin SUB_GROUP ModelWithControllersOnly_Longitudinal_Controller_Stanley_PI_Controller_Forward_PI_Forward__Anti_windup_Disc__Clamping_Parallel_Dead_Zone /end SUB_GROUP
 /begin REF_CHARACTERISTIC ModelWithControllersOn_cal_impl.Constant1_Value ModelWithControllersOn_cal_impl.ZeroGain_Gain /end REF_CHARACTERISTIC
 /begin REF_MEASUREMENT ModelWithControllersOnly_B.AND3_k ModelWithControllersOnly_B.DataTypeConv1_j ModelWithControllersOnly_B.DataTypeConv2_g ModelWithControllersOnly_B.DeadZone_o ModelWithControllersOnly_B.Equal1_j ModelWithControllersOnly_B.IntegralGain_e ModelWithControllersOnly_B.NotEqual_m ModelWithControllersOnly_B.SignPreIntegrator_k ModelWithControllersOnly_B.SignPreSat_n ModelWithControllersOnly_B.Sum_gu ModelWithControllersOnly_B.Switch_a ModelWithControllersOnly_B.ZeroGain_p /end REF_MEASUREMENT
/end GROUP
/begin GROUP ModelWithControllersOnly_Longitudinal_Controller_Stanley_PI_Controller_Forward_PI_Forward__Anti_windup_Disc__Clamping_Parallel_Dead_Zone "ModelWithControllersOnly/Longitudinal Controller Stanley/PI Controller/Forward/PI Forward
/Anti-windup/Disc. Clamping Parallel/Dead Zone"
 /begin SUB_GROUP ModelWithControllersOnly_Longitudinal_Controller_Stanley_PI_Controller_Forward_PI_Forward__Anti_windup_Disc__Clamping_Parallel_Dead_Zone_Enabled /end SUB_GROUP
/end GROUP
/begin GROUP ModelWithControllersOnly_Longitudinal_Controller_Stanley_PI_Controller_Forward_PI_Forward__Anti_windup_Disc__Clamping_Parallel_Dead_Zone_Enabled "ModelWithControllersOnly/Longitudinal Controller Stanley/PI Controller/Forward/PI Forward
/Anti-windup/Disc. Clamping Parallel/Dead Zone/Enabled"
 /begin REF_CHARACTERISTIC ModelWithControllersOn_cal_impl.PIForward_LowerSaturationLimit ModelWithControllersOn_cal_impl.PIForward_UpperSaturationLimit /end REF_CHARACTERISTIC
 /begin REF_MEASUREMENT ModelWithControllersOnly_B.DeadZone_o ModelWithControllersOnly_B.Sum_gu /end REF_MEASUREMENT
/end GROUP
/begin GROUP ModelWithControllersOnly_Longitudinal_Controller_Stanley_PI_Controller_Forward_PI_Forward__I_Gain "ModelWithControllersOnly/Longitudinal Controller Stanley/PI Controller/Forward/PI Forward
/I Gain"
 /begin SUB_GROUP ModelWithControllersOnly_Longitudinal_Controller_Stanley_PI_Controller_Forward_PI_Forward__I_Gain_Internal_Parameters /end SUB_GROUP
/end GROUP
/begin GROUP ModelWithControllersOnly_Longitudinal_Controller_Stanley_PI_Controller_Forward_PI_Forward__I_Gain_Internal_Parameters "ModelWithControllersOnly/Longitudinal Controller Stanley/PI Controller/Forward/PI Forward
/I Gain/Internal Parameters"
 /begin REF_CHARACTERISTIC ModelWithControllersOn_cal_impl.LongitudinalControllerStanley_K /end REF_CHARACTERISTIC
 /begin REF_MEASUREMENT ModelWithControllersOnly_B.IntegralGain_e ModelWithControllersOnly_B.error /end REF_MEASUREMENT
/end GROUP
/begin GROUP ModelWithControllersOnly_Longitudinal_Controller_Stanley_PI_Controller_Forward_PI_Forward__Integrator "ModelWithControllersOnly/Longitudinal Controller Stanley/PI Controller/Forward/PI Forward
/Integrator"
 /begin SUB_GROUP ModelWithControllersOnly_Longitudinal_Controller_Stanley_PI_Controller_Forward_PI_Forward__Integrator_Discrete /end SUB_GROUP
/end GROUP
/begin GROUP ModelWithControllersOnly_Longitudinal_Controller_Stanley_PI_Controller_Forward_PI_Forward__Integrator_Discrete "ModelWithControllersOnly/Longitudinal Controller Stanley/PI Controller/Forward/PI Forward
/Integrator/Discrete"
 /begin REF_CHARACTERISTIC ModelWithControllersOn_cal_impl.Integrator_gainval ModelWithControllersOn_cal_impl.PIForward_InitialConditionForIn /end REF_CHARACTERISTIC
 /begin REF_MEASUREMENT ModelWithControllersOnly_B.DataTypeConversion ModelWithControllersOnly_B.Integrator_c ModelWithControllersOnly_B.Switch_a ModelWithControllersOnly_DW.Integrator_DSTATE_o ModelWithControllersOnly_DW.Integrator_PrevResetState_n /end REF_MEASUREMENT
/end GROUP
/begin GROUP ModelWithControllersOnly_Longitudinal_Controller_Stanley_PI_Controller_Forward_PI_Forward__Parallel_P_Gain "ModelWithControllersOnly/Longitudinal Controller Stanley/PI Controller/Forward/PI Forward
/Parallel P Gain"
 /begin SUB_GROUP ModelWithControllersOnly_Longitudinal_Controller_Stanley_PI_Controller_Forward_PI_Forward__Parallel_P_Gain_Internal_Parameters /end SUB_GROUP
/end GROUP
/begin GROUP ModelWithControllersOnly_Longitudinal_Controller_Stanley_PI_Controller_Forward_PI_Forward__Parallel_P_Gain_Internal_Parameters "ModelWithControllersOnly/Longitudinal Controller Stanley/PI Controller/Forward/PI Forward
/Parallel P Gain/Internal Parameters"
 /begin REF_CHARACTERISTIC ModelWithControllersOn_cal_impl.LongitudinalControllerStanley_g /end REF_CHARACTERISTIC
 /begin REF_MEASUREMENT ModelWithControllersOnly_B.ProportionalGain_o ModelWithControllersOnly_B.error /end REF_MEASUREMENT
/end GROUP
/begin GROUP ModelWithControllersOnly_Longitudinal_Controller_Stanley_PI_Controller_Forward_PI_Forward__Saturation "ModelWithControllersOnly/Longitudinal Controller Stanley/PI Controller/Forward/PI Forward
/Saturation"
 /begin SUB_GROUP ModelWithControllersOnly_Longitudinal_Controller_Stanley_PI_Controller_Forward_PI_Forward__Saturation_Enabled /end SUB_GROUP
/end GROUP
/begin GROUP ModelWithControllersOnly_Longitudinal_Controller_Stanley_PI_Controller_Forward_PI_Forward__Saturation_Enabled "ModelWithControllersOnly/Longitudinal Controller Stanley/PI Controller/Forward/PI Forward
/Saturation/Enabled"
 /begin REF_CHARACTERISTIC ModelWithControllersOn_cal_impl.PIForward_LowerSaturationLimit ModelWithControllersOn_cal_impl.PIForward_UpperSaturationLimit /end REF_CHARACTERISTIC
 /begin REF_MEASUREMENT ModelWithControllersOnly_B.Merge ModelWithControllersOnly_B.Sum_gu /end REF_MEASUREMENT
/end GROUP
/begin GROUP ModelWithControllersOnly_Longitudinal_Controller_Stanley_PI_Controller_Forward_PI_Forward__Sum "ModelWithControllersOnly/Longitudinal Controller Stanley/PI Controller/Forward/PI Forward
/Sum"
 /begin SUB_GROUP ModelWithControllersOnly_Longitudinal_Controller_Stanley_PI_Controller_Forward_PI_Forward__Sum_Sum_PI /end SUB_GROUP
/end GROUP
/begin GROUP ModelWithControllersOnly_Longitudinal_Controller_Stanley_PI_Controller_Forward_PI_Forward__Sum_Sum_PI "ModelWithControllersOnly/Longitudinal Controller Stanley/PI Controller/Forward/PI Forward
/Sum/Sum_PI"
 /begin REF_MEASUREMENT ModelWithControllersOnly_B.Integrator_c ModelWithControllersOnly_B.ProportionalGain_o ModelWithControllersOnly_B.Sum_gu /end REF_MEASUREMENT
/end GROUP
/begin GROUP ModelWithControllersOnly_Longitudinal_Controller_Stanley_PI_Controller_Reverse "ModelWithControllersOnly/Longitudinal Controller Stanley/PI Controller/Reverse"
 /begin SUB_GROUP ModelWithControllersOnly_Longitudinal_Controller_Stanley_PI_Controller_Reverse_PI_Reverse /end SUB_GROUP
/end GROUP
/begin GROUP ModelWithControllersOnly_Longitudinal_Controller_Stanley_PI_Controller_Reverse_PI_Reverse "ModelWithControllersOnly/Longitudinal Controller Stanley/PI Controller/Reverse/PI Reverse"
 /begin SUB_GROUP ModelWithControllersOnly_Longitudinal_Controller_Stanley_PI_Controller_Reverse_PI_Reverse_Anti_windup ModelWithControllersOnly_Longitudinal_Controller_Stanley_PI_Controller_Reverse_PI_Reverse_D_Gain ModelWithControllersOnly_Longitudinal_Controller_Stanley_PI_Controller_Reverse_PI_Reverse_Filter ModelWithControllersOnly_Longitudinal_Controller_Stanley_PI_Controller_Reverse_PI_Reverse_Filter_ICs ModelWithControllersOnly_Longitudinal_Controller_Stanley_PI_Controller_Reverse_PI_Reverse_I_Gain ModelWithControllersOnly_Longitudinal_Controller_Stanley_PI_Controller_Reverse_PI_Reverse_Ideal_P_Gain ModelWithControllersOnly_Longitudinal_Controller_Stanley_PI_Controller_Reverse_PI_Reverse_Ideal_P_Gain_Fdbk ModelWithControllersOnly_Longitudinal_Controller_Stanley_PI_Controller_Reverse_PI_Reverse_Integrator ModelWithControllersOnly_Longitudinal_Controller_Stanley_PI_Controller_Reverse_PI_Reverse_Integrator_ICs ModelWithControllersOnly_Longitudinal_Controller_Stanley_PI_Controller_Reverse_PI_Reverse_N_Copy ModelWithControllersOnly_Longitudinal_Controller_Stanley_PI_Controller_Reverse_PI_Reverse_N_Gain ModelWithControllersOnly_Longitudinal_Controller_Stanley_PI_Controller_Reverse_PI_Reverse_PID_Compensator_Formula ModelWithControllersOnly_Longitudinal_Controller_Stanley_PI_Controller_Reverse_PI_Reverse_P_Copy ModelWithControllersOnly_Longitudinal_Controller_Stanley_PI_Controller_Reverse_PI_Reverse_Parallel_P_Gain ModelWithControllersOnly_Longitudinal_Controller_Stanley_PI_Controller_Reverse_PI_Reverse_Reset_Signal ModelWithControllersOnly_Longitudinal_Controller_Stanley_PI_Controller_Reverse_PI_Reverse_Saturation ModelWithControllersOnly_Longitudinal_Controller_Stanley_PI_Controller_Reverse_PI_Reverse_Saturation_Fdbk ModelWithControllersOnly_Longitudinal_Controller_Stanley_PI_Controller_Reverse_PI_Reverse_Sum /end SUB_GROUP
/end GROUP
/begin GROUP ModelWithControllersOnly_Longitudinal_Controller_Stanley_PI_Controller_Reverse_PI_Reverse_Anti_windup "ModelWithControllersOnly/Longitudinal Controller Stanley/PI Controller/Reverse/PI Reverse/Anti-windup"
 /begin SUB_GROUP ModelWithControllersOnly_Longitudinal_Controller_Stanley_PI_Controller_Reverse_PI_Reverse_Anti_windup_Disc__Clamping_Parallel /end SUB_GROUP
/end GROUP
/begin GROUP ModelWithControllersOnly_Longitudinal_Controller_Stanley_PI_Controller_Reverse_PI_Reverse_Anti_windup_Disc__Clamping_Parallel "ModelWithControllersOnly/Longitudinal Controller Stanley/PI Controller/Reverse/PI Reverse/Anti-windup/Disc. Clamping Parallel"
 /begin SUB_GROUP ModelWithControllersOnly_Longitudinal_Controller_Stanley_PI_Controller_Reverse_PI_Reverse_Anti_windup_Disc__Clamping_Parallel_Dead_Zone /end SUB_GROUP
 /begin REF_CHARACTERISTIC ModelWithControllersOn_cal_impl.Constant1_Value_f ModelWithControllersOn_cal_impl.ZeroGain_Gain_i /end REF_CHARACTERISTIC
 /begin REF_MEASUREMENT ModelWithControllersOnly_B.AND3_h ModelWithControllersOnly_B.DataTypeConv1 ModelWithControllersOnly_B.DataTypeConv2 ModelWithControllersOnly_B.DeadZone_f ModelWithControllersOnly_B.Equal1_e ModelWithControllersOnly_B.IntegralGain ModelWithControllersOnly_B.NotEqual ModelWithControllersOnly_B.SignPreIntegrator ModelWithControllersOnly_B.SignPreSat ModelWithControllersOnly_B.Sum_mr ModelWithControllersOnly_B.Switch_m ModelWithControllersOnly_B.ZeroGain /end REF_MEASUREMENT
/end GROUP
/begin GROUP ModelWithControllersOnly_Longitudinal_Controller_Stanley_PI_Controller_Reverse_PI_Reverse_Anti_windup_Disc__Clamping_Parallel_Dead_Zone "ModelWithControllersOnly/Longitudinal Controller Stanley/PI Controller/Reverse/PI Reverse/Anti-windup/Disc. Clamping Parallel/Dead Zone"
 /begin SUB_GROUP ModelWithControllersOnly_Longitudinal_Controller_Stanley_PI_Controller_Reverse_PI_Reverse_Anti_windup_Disc__Clamping_Parallel_Dead_Zone_Enabled /end SUB_GROUP
/end GROUP
/begin GROUP ModelWithControllersOnly_Longitudinal_Controller_Stanley_PI_Controller_Reverse_PI_Reverse_Anti_windup_Disc__Clamping_Parallel_Dead_Zone_Enabled "ModelWithControllersOnly/Longitudinal Controller Stanley/PI Controller/Reverse/PI Reverse/Anti-windup/Disc. Clamping Parallel/Dead Zone/Enabled"
 /begin REF_CHARACTERISTIC ModelWithControllersOn_cal_impl.PIReverse_LowerSaturationLimit ModelWithControllersOn_cal_impl.PIReverse_UpperSaturationLimit /end REF_CHARACTERISTIC
 /begin REF_MEASUREMENT ModelWithControllersOnly_B.DeadZone_f ModelWithControllersOnly_B.Sum_mr /end REF_MEASUREMENT
/end GROUP
/begin GROUP ModelWithControllersOnly_Longitudinal_Controller_Stanley_PI_Controller_Reverse_PI_Reverse_I_Gain "ModelWithControllersOnly/Longitudinal Controller Stanley/PI Controller/Reverse/PI Reverse/I Gain"
 /begin SUB_GROUP ModelWithControllersOnly_Longitudinal_Controller_Stanley_PI_Controller_Reverse_PI_Reverse_I_Gain_Internal_Parameters /end SUB_GROUP
/end GROUP
/begin GROUP ModelWithControllersOnly_Longitudinal_Controller_Stanley_PI_Controller_Reverse_PI_Reverse_I_Gain_Internal_Parameters "ModelWithControllersOnly/Longitudinal Controller Stanley/PI Controller/Reverse/PI Reverse/I Gain/Internal Parameters"
 /begin REF_CHARACTERISTIC ModelWithControllersOn_cal_impl.LongitudinalControllerStanley_K /end REF_CHARACTERISTIC
 /begin REF_MEASUREMENT ModelWithControllersOnly_B.IntegralGain ModelWithControllersOnly_B.error /end REF_MEASUREMENT
/end GROUP
/begin GROUP ModelWithControllersOnly_Longitudinal_Controller_Stanley_PI_Controller_Reverse_PI_Reverse_Integrator "ModelWithControllersOnly/Longitudinal Controller Stanley/PI Controller/Reverse/PI Reverse/Integrator"
 /begin SUB_GROUP ModelWithControllersOnly_Longitudinal_Controller_Stanley_PI_Controller_Reverse_PI_Reverse_Integrator_Discrete /end SUB_GROUP
/end GROUP
/begin GROUP ModelWithControllersOnly_Longitudinal_Controller_Stanley_PI_Controller_Reverse_PI_Reverse_Integrator_Discrete "ModelWithControllersOnly/Longitudinal Controller Stanley/PI Controller/Reverse/PI Reverse/Integrator/Discrete"
 /begin REF_CHARACTERISTIC ModelWithControllersOn_cal_impl.Integrator_gainval_e ModelWithControllersOn_cal_impl.PIReverse_InitialConditionForIn /end REF_CHARACTERISTIC
 /begin REF_MEASUREMENT ModelWithControllersOnly_B.DataTypeConversion ModelWithControllersOnly_B.Integrator_f ModelWithControllersOnly_B.Switch_m ModelWithControllersOnly_DW.Integrator_DSTATE ModelWithControllersOnly_DW.Integrator_PrevResetState /end REF_MEASUREMENT
/end GROUP
/begin GROUP ModelWithControllersOnly_Longitudinal_Controller_Stanley_PI_Controller_Reverse_PI_Reverse_Parallel_P_Gain "ModelWithControllersOnly/Longitudinal Controller Stanley/PI Controller/Reverse/PI Reverse/Parallel P Gain"
 /begin SUB_GROUP ModelWithControllersOnly_Longitudinal_Controller_Stanley_PI_Controller_Reverse_PI_Reverse_Parallel_P_Gain_Internal_Parameters /end SUB_GROUP
/end GROUP
/begin GROUP ModelWithControllersOnly_Longitudinal_Controller_Stanley_PI_Controller_Reverse_PI_Reverse_Parallel_P_Gain_Internal_Parameters "ModelWithControllersOnly/Longitudinal Controller Stanley/PI Controller/Reverse/PI Reverse/Parallel P Gain/Internal Parameters"
 /begin REF_CHARACTERISTIC ModelWithControllersOn_cal_impl.LongitudinalControllerStanley_g /end REF_CHARACTERISTIC
 /begin REF_MEASUREMENT ModelWithControllersOnly_B.ProportionalGain ModelWithControllersOnly_B.error /end REF_MEASUREMENT
/end GROUP
/begin GROUP ModelWithControllersOnly_Longitudinal_Controller_Stanley_PI_Controller_Reverse_PI_Reverse_Saturation "ModelWithControllersOnly/Longitudinal Controller Stanley/PI Controller/Reverse/PI Reverse/Saturation"
 /begin SUB_GROUP ModelWithControllersOnly_Longitudinal_Controller_Stanley_PI_Controller_Reverse_PI_Reverse_Saturation_Enabled /end SUB_GROUP
/end GROUP
/begin GROUP ModelWithControllersOnly_Longitudinal_Controller_Stanley_PI_Controller_Reverse_PI_Reverse_Saturation_Enabled "ModelWithControllersOnly/Longitudinal Controller Stanley/PI Controller/Reverse/PI Reverse/Saturation/Enabled"
 /begin REF_CHARACTERISTIC ModelWithControllersOn_cal_impl.PIReverse_LowerSaturationLimit ModelWithControllersOn_cal_impl.PIReverse_UpperSaturationLimit /end REF_CHARACTERISTIC
 /begin REF_MEASUREMENT ModelWithControllersOnly_B.Merge ModelWithControllersOnly_B.Sum_mr /end REF_MEASUREMENT
/end GROUP
/begin GROUP ModelWithControllersOnly_Longitudinal_Controller_Stanley_PI_Controller_Reverse_PI_Reverse_Sum "ModelWithControllersOnly/Longitudinal Controller Stanley/PI Controller/Reverse/PI Reverse/Sum"
 /begin SUB_GROUP ModelWithControllersOnly_Longitudinal_Controller_Stanley_PI_Controller_Reverse_PI_Reverse_Sum_Sum_PI /end SUB_GROUP
/end GROUP
/begin GROUP ModelWithControllersOnly_Longitudinal_Controller_Stanley_PI_Controller_Reverse_PI_Reverse_Sum_Sum_PI "ModelWithControllersOnly/Longitudinal Controller Stanley/PI Controller/Reverse/PI Reverse/Sum/Sum_PI"
 /begin REF_MEASUREMENT ModelWithControllersOnly_B.Integrator_f ModelWithControllersOnly_B.ProportionalGain ModelWithControllersOnly_B.Sum_mr /end REF_MEASUREMENT
/end GROUP
/begin GROUP ModelWithControllersOnly_Longitudinal_Controller_Stanley_Verify_Direction "ModelWithControllersOnly/Longitudinal Controller Stanley/Verify Direction"
 /begin REF_CHARACTERISTIC ModelWithControllersOn_cal_impl.Constant1_Value_ks ModelWithControllersOn_cal_impl.Constant2_Value_i ModelWithControllersOn_cal_impl.Constant3_Value_n ModelWithControllersOn_cal_impl.Constant4_Value_i /end REF_CHARACTERISTIC
 /begin REF_MEASUREMENT ModelWithControllersOnly_B.AND1 ModelWithControllersOnly_B.AND2 ModelWithControllersOnly_B.AND3 ModelWithControllersOnly_B.Equal1 ModelWithControllersOnly_B.Equal2 ModelWithControllersOnly_B.Equal3 ModelWithControllersOnly_B.Equal4 ModelWithControllersOnly_B.Equal5 ModelWithControllersOnly_B.Equal6 ModelWithControllersOnly_B.NOT ModelWithControllersOnly_B.NOT1 ModelWithControllersOnly_B.OR ModelWithControllersOnly_B.Sign1 ModelWithControllersOnly_B.Sign2 ModelWithControllersOnly_B.TmpRTBAtEqual1Inport1 ModelWithControllersOnly_B.TmpRTBAtEqual2Inport1 ModelWithControllersOnly_B.TmpRTBAtEqual4Inport2 ModelWithControllersOnly_B.TmpRTBAtEqual5Inport2 ModelWithControllersOnly_B.xdot ModelWithControllersOnly_B.xdot1 ModelWithControllersOnly_DW.Assertion1_sltestCurrentResult ModelWithControllersOnly_DW.Assertion1_sltestFinalResult ModelWithControllersOnly_DW.Assertion1_sltestLastResultTime ModelWithControllersOnly_DW.Assertion_sltestCurrentResult ModelWithControllersOnly_DW.Assertion_sltestFinalResult ModelWithControllersOnly_DW.Assertion_sltestLastResultTime /end REF_MEASUREMENT
/end GROUP
/begin GROUP ModelWithControllersOnly_Subsystem1 "ModelWithControllersOnly/Subsystem1" /begin REF_CHARACTERISTIC ModelWithControllersOn_cal_impl.Gain1_Gain /end REF_CHARACTERISTIC
 /begin REF_MEASUREMENT ModelWithControllersOnly_B.Gain1 ModelWithControllersOnly_B.Integrator ModelWithControllersOnly_B.TmpSignalConversionAtTransposeI ModelWithControllersOnly_B.Transpose /end REF_MEASUREMENT
/end GROUP
/begin GROUP ModelWithControllersOnly_Subsystem3 "ModelWithControllersOnly/Subsystem3" /begin SUB_GROUP ModelWithControllersOnly_Subsystem3_Subsystem2 /end SUB_GROUP
 /begin REF_CHARACTERISTIC ModelWithControllersOn_cal_impl.Constant_Value_d ModelWithControllersOn_cal_impl.Switch1_Threshold ModelWithControllersOn_cal_impl.Switch_Threshold /end REF_CHARACTERISTIC
 /begin REF_MEASUREMENT ModelWithControllersOnly_B.BrakeSaturation ModelWithControllersOnly_B.Switch ModelWithControllersOnly_B.Switch1 ModelWithControllersOnly_B.T_eng ModelWithControllersOnly_B.T_eng_c ModelWithControllersOnly_B.ThrottleSaturation /end REF_MEASUREMENT
/end GROUP
/begin GROUP ModelWithControllersOnly_Subsystem3_Subsystem2 "ModelWithControllersOnly/Subsystem3/Subsystem2"
 /begin SUB_GROUP ModelWithControllersOnly_Subsystem3_Subsystem2_Subsystem ModelWithControllersOnly_Subsystem3_Subsystem2_Subsystem1 /end SUB_GROUP
/end GROUP
/begin GROUP ModelWithControllersOnly_Subsystem3_Subsystem2_Subsystem "ModelWithControllersOnly/Subsystem3/Subsystem2/Subsystem"
 /begin REF_CHARACTERISTIC ModelWithControllersOn_cal_impl.Gain1_Gain_p ModelWithControllersOn_cal_impl.Gain2_Gain_h ModelWithControllersOn_cal_impl.Integrator_IC_g /end REF_CHARACTERISTIC
 /begin REF_MEASUREMENT ModelWithControllersOnly_B.F_aero_i ModelWithControllersOnly_B.Gain2_d ModelWithControllersOnly_B.Gain_g ModelWithControllersOnly_B.Square_g ModelWithControllersOnly_B.Sum_n ModelWithControllersOnly_B.Switch_l ModelWithControllersOnly_B.T_eng_c ModelWithControllersOnly_B.TmpRTBAtIntegratorInport1 ModelWithControllersOnly_B.TmpRTBAtIntegratorInport2_e ModelWithControllersOnly_B.TmpRTBAtSumInport3_l ModelWithControllersOnly_B.v_g /end REF_MEASUREMENT
/end GROUP
/begin GROUP ModelWithControllersOnly_Subsystem3_Subsystem2_Subsystem1 "ModelWithControllersOnly/Subsystem3/Subsystem2/Subsystem1"
 /begin REF_CHARACTERISTIC ModelWithControllersOn_cal_impl.Gain1_Gain_d ModelWithControllersOn_cal_impl.Gain2_Gain ModelWithControllersOn_cal_impl.Integrator_IC /end REF_CHARACTERISTIC
 /begin REF_MEASUREMENT ModelWithControllersOnly_B.F_aero ModelWithControllersOnly_B.Gain2 ModelWithControllersOnly_B.Gain_ne ModelWithControllersOnly_B.Square ModelWithControllersOnly_B.Sum ModelWithControllersOnly_B.Switch1_l ModelWithControllersOnly_B.T_eng ModelWithControllersOnly_B.TmpRTBAtIntegratorInport1_c ModelWithControllersOnly_B.TmpRTBAtIntegratorInport2 ModelWithControllersOnly_B.TmpRTBAtSumInport3 ModelWithControllersOnly_B.v /end REF_MEASUREMENT
/end GROUP
/begin GROUP ModelWithControllersOnly_Vehicle_Dynamics1 "ModelWithControllersOnly/Vehicle Dynamics1"
 /begin SUB_GROUP ModelWithControllersOnly_Vehicle_Dynamics1_Info2ActorState ModelWithControllersOnly_Vehicle_Dynamics1_VehicleDynamics /end SUB_GROUP
 /begin REF_CHARACTERISTIC ModelWithControllersOn_cal_impl.Constant1_Value_b ModelWithControllersOn_cal_impl.Constant2_Value_o ModelWithControllersOn_cal_impl.Constant3_Value_g ModelWithControllersOn_cal_impl.Constant4_Value_ad ModelWithControllersOn_cal_impl.Constant5_Value_h ModelWithControllersOn_cal_impl.Constant9_Value ModelWithControllersOn_cal_impl.Constant_Value_h ModelWithControllersOn_cal_impl.Saturation_LowerSat ModelWithControllersOnly_P.Saturation_UpperSat /end REF_CHARACTERISTIC
 /begin REF_MEASUREMENT ModelWithControllersOnly_B.Integrator ModelWithControllersOnly_B.Saturation ModelWithControllersOnly_B.brake_cmdNm ModelWithControllersOnly_B.brake_cmdNm_j ModelWithControllersOnly_B.gear_cmd ModelWithControllersOnly_B.gear_cmd_d ModelWithControllersOnly_B.gear_cmd_e ModelWithControllersOnly_B.gear_cmd_i ModelWithControllersOnly_B.steer_cmddeg ModelWithControllersOnly_B.steer_cmddeg_n ModelWithControllersOnly_B.torque_cmdNm ModelWithControllersOnly_B.torque_cmdNm_j ModelWithControllersOnly_DW.FromWorkspace1_PWORK ModelWithControllersOnly_DW.FromWorkspace4_PWORK ModelWithControllersOnly_DW.FromWorkspace_PWORK /end REF_MEASUREMENT
/end GROUP
/begin GROUP ModelWithControllersOnly_Vehicle_Dynamics1_Info2ActorState "ModelWithControllersOnly/Vehicle Dynamics1/Info2ActorState"
 /begin REF_CHARACTERISTIC ModelWithControllersOn_cal_impl.Constant_Value_ke ModelWithControllersOn_cal_impl.Gain1_Gain_b ModelWithControllersOn_cal_impl.Gain2_Gain_c ModelWithControllersOn_cal_impl.Gain3_Gain ModelWithControllersOn_cal_impl.Gain4_Gain ModelWithControllersOn_cal_impl.Gain5_Gain ModelWithControllersOn_cal_impl.Gain6_Gain ModelWithControllersOn_cal_impl.Gain_Gain_l ModelWithControllersOn_cal_impl.RateTransition1_InitialConditio ModelWithControllersOn_cal_impl.RateTransition2_InitialConditio ModelWithControllersOn_cal_impl.RateTransition_InitialCondition /end REF_CHARACTERISTIC
 /begin REF_MEASUREMENT ModelWithControllersOnly_B.AngularVelocity ModelWithControllersOnly_B.Derivative ModelWithControllersOnly_B.Derivative1 ModelWithControllersOnly_B.Derivative2 ModelWithControllersOnly_B.Derivative3 ModelWithControllersOnly_B.Derivative4 ModelWithControllersOnly_B.Derivative5 ModelWithControllersOnly_B.Gain3 ModelWithControllersOnly_B.Gain4 ModelWithControllersOnly_B.Gain5 ModelWithControllersOnly_B.Gain6 ModelWithControllersOnly_B.Integrator ModelWithControllersOnly_B.Integrator_m ModelWithControllersOnly_B.Pitch ModelWithControllersOnly_B.Roll ModelWithControllersOnly_B.TmpRTBAtMATLABFunction1Inport2 ModelWithControllersOnly_B.TmpRTBAtMATLABFunction1Inport3 ModelWithControllersOnly_B.TmpRTBAtMATLABFunction2Inport1 ModelWithControllersOnly_B.TmpRTBAtMATLABFunction2Inport2 ModelWithControllersOnly_B.TmpRTBAtMATLABFunction2Inport3 ModelWithControllersOnly_B.TmpRTBAtMATLABFunction3Inport1 ModelWithControllersOnly_B.TmpRTBAtMATLABFunction3Inport2 ModelWithControllersOnly_B.TmpRTBAtMATLABFunction3Inport3 ModelWithControllersOnly_B.TmpRTBAtMATLABFunctionInport2 ModelWithControllersOnly_B.TmpRTBAtMATLABFunctionInport3 ModelWithControllersOnly_B.X ModelWithControllersOnly_B.Xdot ModelWithControllersOnly_B.Yawdeg ModelWithControllersOnly_B.y ModelWithControllersOnly_DW.LastUAtTimeA ModelWithControllersOnly_DW.LastUAtTimeA_d ModelWithControllersOnly_DW.LastUAtTimeA_h ModelWithControllersOnly_DW.LastUAtTimeA_k ModelWithControllersOnly_DW.LastUAtTimeA_n ModelWithControllersOnly_DW.LastUAtTimeA_nv ModelWithControllersOnly_DW.LastUAtTimeB ModelWithControllersOnly_DW.LastUAtTimeB_d ModelWithControllersOnly_DW.LastUAtTimeB_f ModelWithControllersOnly_DW.LastUAtTimeB_g ModelWithControllersOnly_DW.LastUAtTimeB_o ModelWithControllersOnly_DW.LastUAtTimeB_p ModelWithControllersOnly_DW.RateTransition1_Buf ModelWithControllersOnly_DW.RateTransition1_RdBufIdx ModelWithControllersOnly_DW.RateTransition1_WrBufIdx ModelWithControllersOnly_DW.RateTransition2_Buf ModelWithControllersOnly_DW.RateTransition2_RdBufIdx ModelWithControllersOnly_DW.RateTransition2_WrBufIdx ModelWithControllersOnly_DW.RateTransition_Buf ModelWithControllersOnly_DW.RateTransition_RdBufIdx ModelWithControllersOnly_DW.RateTransition_WrBufIdx ModelWithControllersOnly_DW.Scope1_PWORK ModelWithControllersOnly_DW.Scope_PWORK_c ModelWithControllersOnly_DW.TimeStampA ModelWithControllersOnly_DW.TimeStampA_e ModelWithControllersOnly_DW.TimeStampA_k ModelWithControllersOnly_DW.TimeStampA_l ModelWithControllersOnly_DW.TimeStampA_l5 ModelWithControllersOnly_DW.TimeStampA_o ModelWithControllersOnly_DW.TimeStampB ModelWithControllersOnly_DW.TimeStampB_e ModelWithControllersOnly_DW.TimeStampB_k ModelWithControllersOnly_DW.TimeStampB_l ModelWithControllersOnly_DW.TimeStampB_l4 ModelWithControllersOnly_DW.TimeStampB_lf /end REF_MEASUREMENT
/end GROUP
/begin GROUP ModelWithControllersOnly_Vehicle_Dynamics1_VehicleDynamics "ModelWithControllersOnly/Vehicle Dynamics1/VehicleDynamics"
 /begin SUB_GROUP ModelWithControllersOnly_Vehicle_Dynamics1_VehicleDynamics_Vehicle_Body_3DOF_Single_Track ModelWithControllersOnly_Vehicle_Dynamics1_VehicleDynamics_engine_steer_brake_dynamics /end SUB_GROUP
 /begin REF_CHARACTERISTIC ModelWithControllersOn_cal_impl.Constant2_Value_g ModelWithControllersOn_cal_impl.FirstOrderHold1_IniOut ModelWithControllersOn_cal_impl.FirstOrderHold_IniOut ModelWithControllersOnly_P.FirstOrderHold1_ErrTol ModelWithControllersOnly_P.FirstOrderHold_ErrTol /end REF_CHARACTERISTIC
 /begin REF_MEASUREMENT ModelWithControllersOnly_B.EgoVehLongAcc ModelWithControllersOnly_B.FirstOrderHold ModelWithControllersOnly_B.Gain2_o ModelWithControllersOnly_B.Integrator ModelWithControllersOnly_B.TnetNm ModelWithControllersOnly_B.VectorConcatenate ModelWithControllersOnly_B.VectorConcatenate3 ModelWithControllersOnly_B.torquetoaccelerationconversion1 ModelWithControllersOnly_B.wheelspeed ModelWithControllersOnly_DW.Ck ModelWithControllersOnly_DW.Ck_o ModelWithControllersOnly_DW.LastUAtTimeA_o ModelWithControllersOnly_DW.LastUAtTimeB_c ModelWithControllersOnly_DW.Mk ModelWithControllersOnly_DW.Mk_n ModelWithControllersOnly_DW.TimeStampA_h ModelWithControllersOnly_DW.TimeStampB_h ModelWithControllersOnly_DW.Tk ModelWithControllersOnly_DW.Tk_d ModelWithControllersOnly_DW.Uk ModelWithControllersOnly_DW.Uk_d /end REF_MEASUREMENT
/end GROUP
/begin GROUP ModelWithControllersOnly_Vehicle_Dynamics1_VehicleDynamics_Vehicle_Body_3DOF_Single_Track "ModelWithControllersOnly/Vehicle Dynamics1/VehicleDynamics/Vehicle Body 3DOF Single Track"
 /begin SUB_GROUP ModelWithControllersOnly_Vehicle_Dynamics1_VehicleDynamics_Vehicle_Body_3DOF_Single_Track_Cy ModelWithControllersOnly_Vehicle_Dynamics1_VehicleDynamics_Vehicle_Body_3DOF_Single_Track_Drag ModelWithControllersOnly_Vehicle_Dynamics1_VehicleDynamics_Vehicle_Body_3DOF_Single_Track_Signal_Routing ModelWithControllersOnly_Vehicle_Dynamics1_VehicleDynamics_Vehicle_Body_3DOF_Single_Track_friction ModelWithControllersOnly_Vehicle_Dynamics1_VehicleDynamics_Vehicle_Body_3DOF_Single_Track_front_forces ModelWithControllersOnly_Vehicle_Dynamics1_VehicleDynamics_Vehicle_Body_3DOF_Single_Track_front_steer ModelWithControllersOnly_Vehicle_Dynamics1_VehicleDynamics_Vehicle_Body_3DOF_Single_Track_hitch_geometry_parameters ModelWithControllersOnly_Vehicle_Dynamics1_VehicleDynamics_Vehicle_Body_3DOF_Single_Track_rear_forces ModelWithControllersOnly_Vehicle_Dynamics1_VehicleDynamics_Vehicle_Body_3DOF_Single_Track_rear_steer ModelWithControllersOnly_Vehicle_Dynamics1_VehicleDynamics_Vehicle_Body_3DOF_Single_Track_sigma ModelWithControllersOnly_Vehicle_Dynamics1_VehicleDynamics_Vehicle_Body_3DOF_Single_Track_state ModelWithControllersOnly_Vehicle_Dynamics1_VehicleDynamics_Vehicle_Body_3DOF_Single_Track_wind /end SUB_GROUP
 /begin REF_CHARACTERISTIC ModelWithControllersOn_cal_impl.VehicleBody3DOFSingleTrack_Fzno ModelWithControllersOn_cal_impl.VehicleBody3DOFSingleTrack_Izz ModelWithControllersOn_cal_impl.VehicleBody3DOFSingleTrack_NF ModelWithControllersOn_cal_impl.VehicleBody3DOFSingleTrack_NR ModelWithControllersOn_cal_impl.VehicleBody3DOFSingleTrack_Tair ModelWithControllersOn_cal_impl.VehicleBody3DOFSingleTrack_g ModelWithControllersOn_cal_impl.VehicleBody3DOFSingleTrack_h ModelWithControllersOn_cal_impl.VehicleBody3DOFSingleTrack_r_o ModelWithControllersOn_cal_impl.VehicleBody3DOFSingleTrack_xdot ModelWithControllersOn_cal_impl.VehicleBody3DOFSingleTrack_ydot ModelWithControllersOn_cal_impl.VehicleDynamics_InitSpeed ModelWithControllersOn_cal_impl.vehiclemodel_Fxtire_sat ModelWithControllersOn_cal_impl.vehiclemodel_Fytire_sat ModelWithControllersOn_cal_impl.vehiclemodel_d ModelWithControllersOn_cal_impl.vehiclemodel_w /end REF_CHARACTERISTIC
 /begin REF_MEASUREMENT ModelWithControllersOnly_B.Add1_d ModelWithControllersOnly_B.Add_d ModelWithControllersOnly_B.FBody ModelWithControllersOnly_B.FOut ModelWithControllersOnly_B.FTire ModelWithControllersOnly_B.Fg ModelWithControllersOnly_B.Integrator ModelWithControllersOnly_B.MBody ModelWithControllersOnly_B.UnaryMinus ModelWithControllersOnly_B.UnaryMinus1 ModelWithControllersOnly_B.UnitConversion1 ModelWithControllersOnly_B.VectorConcatenate ModelWithControllersOnly_B.VectorConcatenate1_b2 ModelWithControllersOnly_B.VectorConcatenate1_c ModelWithControllersOnly_B.VectorConcatenate1_f ModelWithControllersOnly_B.VectorConcatenate3 ModelWithControllersOnly_B.stateDer ModelWithControllersOnly_B.status ModelWithControllersOnly_B.wheelInfo ModelWithControllersOnly_B.yOut /end REF_MEASUREMENT
/end GROUP
/begin GROUP ModelWithControllersOnly_Vehicle_Dynamics1_VehicleDynamics_Vehicle_Body_3DOF_Single_Track_Cy "ModelWithControllersOnly/Vehicle Dynamics1/VehicleDynamics/Vehicle Body 3DOF Single Track/Cy"
 /begin SUB_GROUP ModelWithControllersOnly_Vehicle_Dynamics1_VehicleDynamics_Vehicle_Body_3DOF_Single_Track_Cy_Cy_const /end SUB_GROUP
/end GROUP
/begin GROUP ModelWithControllersOnly_Vehicle_Dynamics1_VehicleDynamics_Vehicle_Body_3DOF_Single_Track_Cy_Cy_const "ModelWithControllersOnly/Vehicle Dynamics1/VehicleDynamics/Vehicle Body 3DOF Single Track/Cy/Cy const"
 /begin REF_CHARACTERISTIC ModelWithControllersOn_cal_impl.VehicleBody3DOFSingleTrack_Cy_f ModelWithControllersOn_cal_impl.VehicleBody3DOFSingleTrack_Cy_r /end REF_CHARACTERISTIC
/end GROUP
/begin GROUP ModelWithControllersOnly_Vehicle_Dynamics1_VehicleDynamics_Vehicle_Body_3DOF_Single_Track_Drag "ModelWithControllersOnly/Vehicle Dynamics1/VehicleDynamics/Vehicle Body 3DOF Single Track/Drag"
 /begin SUB_GROUP ModelWithControllersOnly_Vehicle_Dynamics1_VehicleDynamics_Vehicle_Body_3DOF_Single_Track_Drag_Drag_Force ModelWithControllersOnly_Vehicle_Dynamics1_VehicleDynamics_Vehicle_Body_3DOF_Single_Track_Drag_inertial2body /end SUB_GROUP
 /begin REF_CHARACTERISTIC ModelWithControllersOn_cal_impl.Constant_Value_k /end REF_CHARACTERISTIC
 /begin REF_MEASUREMENT ModelWithControllersOnly_B.Product3_o ModelWithControllersOnly_B.Product4 ModelWithControllersOnly_B.UnaryMinus ModelWithControllersOnly_B.UnaryMinus1 ModelWithControllersOnly_B.VectorConcatenate1 /end REF_MEASUREMENT
/end GROUP
/begin GROUP ModelWithControllersOnly_Vehicle_Dynamics1_VehicleDynamics_Vehicle_Body_3DOF_Single_Track_Drag_Drag_Force "ModelWithControllersOnly/Vehicle Dynamics1/VehicleDynamics/Vehicle Body 3DOF Single Track/Drag/Drag Force"
 /begin REF_CHARACTERISTIC ModelWithControllersOn_cal_impl.Constant4_Value_a ModelWithControllersOn_cal_impl.Crm_tableData ModelWithControllersOn_cal_impl.DragForce_R ModelWithControllersOn_cal_impl.VehicleBody3DOFSingleTrack_Af ModelWithControllersOn_cal_impl.VehicleBody3DOFSingleTrack_Cd ModelWithControllersOn_cal_impl.VehicleBody3DOFSingleTrack_Cl ModelWithControllersOn_cal_impl.VehicleBody3DOFSingleTrack_Cpm ModelWithControllersOn_cal_impl.VehicleBody3DOFSingleTrack_Cs ModelWithControllersOn_cal_impl.VehicleBody3DOFSingleTrack_Cym ModelWithControllersOn_cal_impl.VehicleBody3DOFSingleTrack_Pabs ModelWithControllersOn_cal_impl.u_Gain /end REF_CHARACTERISTIC
 /begin REF_MEASUREMENT ModelWithControllersOnly_B.Add1 ModelWithControllersOnly_B.Add2 ModelWithControllersOnly_B.Product1_a ModelWithControllersOnly_B.Product2_h ModelWithControllersOnly_B.Product3_o ModelWithControllersOnly_B.Product4 ModelWithControllersOnly_B.Product_i ModelWithControllersOnly_B.Sqrt ModelWithControllersOnly_B.SumofElements ModelWithControllersOnly_B.Tanh ModelWithControllersOnly_B.TrigonometricFunction ModelWithControllersOnly_B.VectorConcatenate1 ModelWithControllersOnly_B.VectorConcatenate2 ModelWithControllersOnly_B.VectorConcatenate_b ModelWithControllersOnly_B.u ModelWithControllersOnly_B.uAPabsRT /end REF_MEASUREMENT
/end GROUP
/begin GROUP ModelWithControllersOnly_Vehicle_Dynamics1_VehicleDynamics_Vehicle_Body_3DOF_Single_Track_Drag_inertial2body "ModelWithControllersOnly/Vehicle Dynamics1/VehicleDynamics/Vehicle Body 3DOF Single Track/Drag/inertial2body"
 /begin REF_MEASUREMENT ModelWithControllersOnly_B.Integrator ModelWithControllersOnly_B.Product1 ModelWithControllersOnly_B.Product2 ModelWithControllersOnly_B.Product3 ModelWithControllersOnly_B.Product_k ModelWithControllersOnly_B.TrigonometricFunction_o1 ModelWithControllersOnly_B.TrigonometricFunction_o2 ModelWithControllersOnly_B.VectorConcatenate1_b ModelWithControllersOnly_B.VectorConcatenate2 /end REF_MEASUREMENT
/end GROUP
/begin GROUP ModelWithControllersOnly_Vehicle_Dynamics1_VehicleDynamics_Vehicle_Body_3DOF_Single_Track_Signal_Routing "ModelWithControllersOnly/Vehicle Dynamics1/VehicleDynamics/Vehicle Body 3DOF Single Track/Signal Routing"
 /begin SUB_GROUP ModelWithControllersOnly_Vehicle_Dynamics1_VehicleDynamics_Vehicle_Body_3DOF_Single_Track_Signal_Routing_Signal_Routing /end SUB_GROUP
/end GROUP
/begin GROUP ModelWithControllersOnly_Vehicle_Dynamics1_VehicleDynamics_Vehicle_Body_3DOF_Single_Track_Signal_Routing_Signal_Routing_Lateral_3DOF_Hard_Point_Coordinate_Transform_Front "ModelWithControllersOnly/Vehicle Dynamics1/VehicleDynamics/Vehicle Body 3DOF Single Track/Signal Routing/Signal Routing/Lateral 3DOF/Hard Point Coordinate Transform Front"
 /begin REF_CHARACTERISTIC ModelWithControllersOn_cal_impl.VehicleBody3DOFSingleTrack_h /end REF_CHARACTERISTIC
 /begin REF_MEASUREMENT ModelWithControllersOnly_B.Integrator ModelWithControllersOnly_B.Integrator_m ModelWithControllersOnly_B.y /end REF_MEASUREMENT
/end GROUP
/begin GROUP ModelWithControllersOnly_Vehicle_Dynamics1_VehicleDynamics_Vehicle_Body_3DOF_Single_Track_Signal_Routing_Signal_Routing_Lateral_3DOF_Hard_Point_Coordinate_Transform_Front_wxR_Subsystem "ModelWithControllersOnly/Vehicle Dynamics1/VehicleDynamics/Vehicle Body 3DOF Single Track/Signal Routing/Signal Routing/Lateral 3DOF/Hard Point Coordinate Transform Front/wxR/Subsystem" /begin REF_MEASUREMENT ModelWithControllersOnly_B.Integrator /end REF_MEASUREMENT /end GROUP
/begin GROUP ModelWithControllersOnly_Vehicle_Dynamics1_VehicleDynamics_Vehicle_Body_3DOF_Single_Track_Signal_Routing_Signal_Routing_Lateral_3DOF_Hard_Point_Coordinate_Transform_Front_wxR_Subsystem1 "ModelWithControllersOnly/Vehicle Dynamics1/VehicleDynamics/Vehicle Body 3DOF Single Track/Signal Routing/Signal Routing/Lateral 3DOF/Hard Point Coordinate Transform Front/wxR/Subsystem1" /begin REF_MEASUREMENT ModelWithControllersOnly_B.Integrator /end REF_MEASUREMENT /end GROUP
/begin GROUP ModelWithControllersOnly_Vehicle_Dynamics1_VehicleDynamics_Vehicle_Body_3DOF_Single_Track_Signal_Routing_Signal_Routing_Lateral_3DOF_Hard_Point_Coordinate_Transform_Geometric_Hard_Point_Coordinate_Transform_External_Displacement_Beta "ModelWithControllersOnly/Vehicle Dynamics1/VehicleDynamics/Vehicle Body 3DOF Single Track/Signal Routing/Signal Routing/Lateral 3DOF/Hard Point Coordinate Transform Geometric/Hard Point Coordinate Transform
External Displacement Beta"
 /begin REF_MEASUREMENT ModelWithControllersOnly_B.Integrator ModelWithControllersOnly_B.Integrator_m ModelWithControllersOnly_B.y /end REF_MEASUREMENT
/end GROUP
/begin GROUP ModelWithControllersOnly_Vehicle_Dynamics1_VehicleDynamics_Vehicle_Body_3DOF_Single_Track_Signal_Routing_Signal_Routing_Lateral_3DOF_Hard_Point_Coordinate_Transform_Geometric_Hard_Point_Coordinate_Transform_External_Displacement_Beta_Body_Slip_div0protect___abs_poly_Compare_To_Constant "ModelWithControllersOnly/Vehicle Dynamics1/VehicleDynamics/Vehicle Body 3DOF Single Track/Signal Routing/Signal Routing/Lateral 3DOF/Hard Point Coordinate Transform Geometric/Hard Point Coordinate Transform
External Displacement Beta/Body Slip/div0protect - abs poly/Compare
To Constant"
 /begin REF_CHARACTERISTIC ModelWithControllersOn_cal_impl.VehicleBody3DOFSingleTrack_xdot /end REF_CHARACTERISTIC
/end GROUP
/begin GROUP ModelWithControllersOnly_Vehicle_Dynamics1_VehicleDynamics_Vehicle_Body_3DOF_Single_Track_Signal_Routing_Signal_Routing_Lateral_3DOF_Hard_Point_Coordinate_Transform_Geometric_Hard_Point_Coordinate_Transform_External_Displacement_Beta_Body_Slip_div0protect___abs_poly_Compare_To_Constant1 "ModelWithControllersOnly/Vehicle Dynamics1/VehicleDynamics/Vehicle Body 3DOF Single Track/Signal Routing/Signal Routing/Lateral 3DOF/Hard Point Coordinate Transform Geometric/Hard Point Coordinate Transform
External Displacement Beta/Body Slip/div0protect - abs poly/Compare
To Constant1"
 /begin REF_CHARACTERISTIC ModelWithControllersOn_cal_impl.VehicleBody3DOFSingleTrack_xdot /end REF_CHARACTERISTIC
/end GROUP
/begin GROUP ModelWithControllersOnly_Vehicle_Dynamics1_VehicleDynamics_Vehicle_Body_3DOF_Single_Track_Signal_Routing_Signal_Routing_Lateral_3DOF_Hard_Point_Coordinate_Transform_Geometric_Hard_Point_Coordinate_Transform_External_Displacement_Beta_wxR_Subsystem "ModelWithControllersOnly/Vehicle Dynamics1/VehicleDynamics/Vehicle Body 3DOF Single Track/Signal Routing/Signal Routing/Lateral 3DOF/Hard Point Coordinate Transform Geometric/Hard Point Coordinate Transform
External Displacement Beta/wxR/Subsystem" /begin REF_MEASUREMENT ModelWithControllersOnly_B.Integrator /end REF_MEASUREMENT /end GROUP
/begin GROUP ModelWithControllersOnly_Vehicle_Dynamics1_VehicleDynamics_Vehicle_Body_3DOF_Single_Track_Signal_Routing_Signal_Routing_Lateral_3DOF_Hard_Point_Coordinate_Transform_Geometric_Hard_Point_Coordinate_Transform_External_Displacement_Beta_wxR_Subsystem1 "ModelWithControllersOnly/Vehicle Dynamics1/VehicleDynamics/Vehicle Body 3DOF Single Track/Signal Routing/Signal Routing/Lateral 3DOF/Hard Point Coordinate Transform Geometric/Hard Point Coordinate Transform
External Displacement Beta/wxR/Subsystem1" /begin REF_MEASUREMENT ModelWithControllersOnly_B.Integrator /end REF_MEASUREMENT /end GROUP
/begin GROUP ModelWithControllersOnly_Vehicle_Dynamics1_VehicleDynamics_Vehicle_Body_3DOF_Single_Track_Signal_Routing_Signal_Routing_Lateral_3DOF_Hard_Point_Coordinate_Transform_Rear "ModelWithControllersOnly/Vehicle Dynamics1/VehicleDynamics/Vehicle Body 3DOF Single Track/Signal Routing/Signal Routing/Lateral 3DOF/Hard Point Coordinate Transform Rear"
 /begin REF_CHARACTERISTIC ModelWithControllersOn_cal_impl.VehicleBody3DOFSingleTrack_h /end REF_CHARACTERISTIC
 /begin REF_MEASUREMENT ModelWithControllersOnly_B.Integrator ModelWithControllersOnly_B.Integrator_m ModelWithControllersOnly_B.y /end REF_MEASUREMENT
/end GROUP
/begin GROUP ModelWithControllersOnly_Vehicle_Dynamics1_VehicleDynamics_Vehicle_Body_3DOF_Single_Track_Signal_Routing_Signal_Routing_Lateral_3DOF_Hard_Point_Coordinate_Transform_Rear_wxR_Subsystem "ModelWithControllersOnly/Vehicle Dynamics1/VehicleDynamics/Vehicle Body 3DOF Single Track/Signal Routing/Signal Routing/Lateral 3DOF/Hard Point Coordinate Transform Rear/wxR/Subsystem" /begin REF_MEASUREMENT ModelWithControllersOnly_B.Integrator /end REF_MEASUREMENT /end GROUP
/begin GROUP ModelWithControllersOnly_Vehicle_Dynamics1_VehicleDynamics_Vehicle_Body_3DOF_Single_Track_Signal_Routing_Signal_Routing_Lateral_3DOF_Hard_Point_Coordinate_Transform_Rear_wxR_Subsystem1 "ModelWithControllersOnly/Vehicle Dynamics1/VehicleDynamics/Vehicle Body 3DOF Single Track/Signal Routing/Signal Routing/Lateral 3DOF/Hard Point Coordinate Transform Rear/wxR/Subsystem1" /begin REF_MEASUREMENT ModelWithControllersOnly_B.Integrator /end REF_MEASUREMENT /end GROUP
/begin GROUP ModelWithControllersOnly_Vehicle_Dynamics1_VehicleDynamics_Vehicle_Body_3DOF_Single_Track_Signal_Routing_Signal_Routing_Lateral_3DOF_Hitch_Coordinate_Transform "ModelWithControllersOnly/Vehicle Dynamics1/VehicleDynamics/Vehicle Body 3DOF Single Track/Signal Routing/Signal Routing/Lateral 3DOF/Hitch Coordinate Transform"
 /begin REF_CHARACTERISTIC ModelWithControllersOn_cal_impl.VehicleBody3DOFSingleTrack_h /end REF_CHARACTERISTIC
/end GROUP
/begin GROUP ModelWithControllersOnly_Vehicle_Dynamics1_VehicleDynamics_Vehicle_Body_3DOF_Single_Track_Signal_Routing_Signal_Routing_Lateral_3DOF_Hitch_Coordinate_Transform_Hard_Point_Coordinate_Transform_External_Displacement "ModelWithControllersOnly/Vehicle Dynamics1/VehicleDynamics/Vehicle Body 3DOF Single Track/Signal Routing/Signal Routing/Lateral 3DOF/Hitch Coordinate Transform/Hard Point Coordinate Transform
External Displacement"
 /begin REF_MEASUREMENT ModelWithControllersOnly_B.Integrator ModelWithControllersOnly_B.Integrator_m ModelWithControllersOnly_B.y /end REF_MEASUREMENT
/end GROUP
/begin GROUP ModelWithControllersOnly_Vehicle_Dynamics1_VehicleDynamics_Vehicle_Body_3DOF_Single_Track_Signal_Routing_Signal_Routing_Lateral_3DOF_Hitch_Coordinate_Transform_Hard_Point_Coordinate_Transform_External_Displacement_wxR_Subsystem "ModelWithControllersOnly/Vehicle Dynamics1/VehicleDynamics/Vehicle Body 3DOF Single Track/Signal Routing/Signal Routing/Lateral 3DOF/Hitch Coordinate Transform/Hard Point Coordinate Transform
External Displacement/wxR/Subsystem" /begin REF_MEASUREMENT ModelWithControllersOnly_B.Integrator /end REF_MEASUREMENT /end GROUP
/begin GROUP ModelWithControllersOnly_Vehicle_Dynamics1_VehicleDynamics_Vehicle_Body_3DOF_Single_Track_Signal_Routing_Signal_Routing_Lateral_3DOF_Hitch_Coordinate_Transform_Hard_Point_Coordinate_Transform_External_Displacement_wxR_Subsystem1 "ModelWithControllersOnly/Vehicle Dynamics1/VehicleDynamics/Vehicle Body 3DOF Single Track/Signal Routing/Signal Routing/Lateral 3DOF/Hitch Coordinate Transform/Hard Point Coordinate Transform
External Displacement/wxR/Subsystem1" /begin REF_MEASUREMENT ModelWithControllersOnly_B.Integrator /end REF_MEASUREMENT /end GROUP
/begin GROUP ModelWithControllersOnly_Vehicle_Dynamics1_VehicleDynamics_Vehicle_Body_3DOF_Single_Track_Signal_Routing_Signal_Routing_Power "ModelWithControllersOnly/Vehicle Dynamics1/VehicleDynamics/Vehicle Body 3DOF Single Track/Signal Routing/Signal Routing/Power"
 /begin REF_CHARACTERISTIC ModelWithControllersOn_cal_impl.VehicleBody3DOFSingleTrack_Izz ModelWithControllersOn_cal_impl.VehicleBody3DOFSingleTrack_g /end REF_CHARACTERISTIC
 /begin REF_MEASUREMENT ModelWithControllersOnly_B.FOut ModelWithControllersOnly_B.Integrator ModelWithControllersOnly_B.UnaryMinus ModelWithControllersOnly_B.UnaryMinus1 ModelWithControllersOnly_B.yOut /end REF_MEASUREMENT
/end GROUP
/begin GROUP ModelWithControllersOnly_Vehicle_Dynamics1_VehicleDynamics_Vehicle_Body_3DOF_Single_Track_Signal_Routing_Signal_Routing_state2bus "ModelWithControllersOnly/Vehicle Dynamics1/VehicleDynamics/Vehicle Body 3DOF Single Track/Signal Routing/Signal Routing/state2bus"
 /begin REF_MEASUREMENT ModelWithControllersOnly_B.Integrator ModelWithControllersOnly_B.Integrator_m ModelWithControllersOnly_B.VectorConcatenate3 ModelWithControllersOnly_B.y /end REF_MEASUREMENT
/end GROUP
/begin GROUP ModelWithControllersOnly_Vehicle_Dynamics1_VehicleDynamics_Vehicle_Body_3DOF_Single_Track_Signal_Routing_Signal_Routing_state2bus_Body_Slip "ModelWithControllersOnly/Vehicle Dynamics1/VehicleDynamics/Vehicle Body 3DOF Single Track/Signal Routing/Signal Routing/state2bus/Body Slip" /begin REF_MEASUREMENT ModelWithControllersOnly_B.Integrator /end REF_MEASUREMENT /end GROUP
/begin GROUP ModelWithControllersOnly_Vehicle_Dynamics1_VehicleDynamics_Vehicle_Body_3DOF_Single_Track_Signal_Routing_Signal_Routing_state2bus_Body_Slip_div0protect___abs_poly "ModelWithControllersOnly/Vehicle Dynamics1/VehicleDynamics/Vehicle Body 3DOF Single Track/Signal Routing/Signal Routing/state2bus/Body Slip/div0protect - abs poly" /begin REF_MEASUREMENT ModelWithControllersOnly_B.Integrator /end REF_MEASUREMENT /end GROUP
/begin GROUP ModelWithControllersOnly_Vehicle_Dynamics1_VehicleDynamics_Vehicle_Body_3DOF_Single_Track_Signal_Routing_Signal_Routing_state2bus_Body_Slip_div0protect___abs_poly_Compare_To_Constant "ModelWithControllersOnly/Vehicle Dynamics1/VehicleDynamics/Vehicle Body 3DOF Single Track/Signal Routing/Signal Routing/state2bus/Body Slip/div0protect - abs poly/Compare
To Constant"
 /begin REF_CHARACTERISTIC ModelWithControllersOn_cal_impl.VehicleBody3DOFSingleTrack_xdot /end REF_CHARACTERISTIC
 /begin REF_MEASUREMENT ModelWithControllersOnly_B.Integrator /end REF_MEASUREMENT
/end GROUP
/begin GROUP ModelWithControllersOnly_Vehicle_Dynamics1_VehicleDynamics_Vehicle_Body_3DOF_Single_Track_Signal_Routing_Signal_Routing_state2bus_Body_Slip_div0protect___abs_poly_Compare_To_Constant1 "ModelWithControllersOnly/Vehicle Dynamics1/VehicleDynamics/Vehicle Body 3DOF Single Track/Signal Routing/Signal Routing/state2bus/Body Slip/div0protect - abs poly/Compare
To Constant1"
 /begin REF_CHARACTERISTIC ModelWithControllersOn_cal_impl.VehicleBody3DOFSingleTrack_xdot /end REF_CHARACTERISTIC
 /begin REF_MEASUREMENT ModelWithControllersOnly_B.Integrator /end REF_MEASUREMENT
/end GROUP
/begin GROUP ModelWithControllersOnly_Vehicle_Dynamics1_VehicleDynamics_Vehicle_Body_3DOF_Single_Track_Signal_Routing_Signal_Routing_state2bus_xddot2ax "ModelWithControllersOnly/Vehicle Dynamics1/VehicleDynamics/Vehicle Body 3DOF Single Track/Signal Routing/Signal Routing/state2bus/xddot2ax"
 /begin REF_MEASUREMENT ModelWithControllersOnly_B.Integrator ModelWithControllersOnly_B.yOut /end REF_MEASUREMENT
/end GROUP
/begin GROUP ModelWithControllersOnly_Vehicle_Dynamics1_VehicleDynamics_Vehicle_Body_3DOF_Single_Track_friction_mu_int "ModelWithControllersOnly/Vehicle Dynamics1/VehicleDynamics/Vehicle Body 3DOF Single Track/friction/mu int" /begin REF_MEASUREMENT ModelWithControllersOnly_B.VectorConcatenate1_f /end REF_MEASUREMENT /end GROUP
/begin GROUP ModelWithControllersOnly_Vehicle_Dynamics1_VehicleDynamics_Vehicle_Body_3DOF_Single_Track_front_forces_ext_long "ModelWithControllersOnly/Vehicle Dynamics1/VehicleDynamics/Vehicle Body 3DOF Single Track/front forces/ext long"
 /begin REF_MEASUREMENT ModelWithControllersOnly_B.TnetNm ModelWithControllersOnly_B.VectorConcatenate1_b2 /end REF_MEASUREMENT
/end GROUP
/begin GROUP ModelWithControllersOnly_Vehicle_Dynamics1_VehicleDynamics_Vehicle_Body_3DOF_Single_Track_front_steer_delta_ext "ModelWithControllersOnly/Vehicle Dynamics1/VehicleDynamics/Vehicle Body 3DOF Single Track/front steer/delta ext"
 /begin REF_MEASUREMENT ModelWithControllersOnly_B.FirstOrderHold ModelWithControllersOnly_B.UnitConversion1 /end REF_MEASUREMENT
/end GROUP
/begin GROUP ModelWithControllersOnly_Vehicle_Dynamics1_VehicleDynamics_Vehicle_Body_3DOF_Single_Track_rear_forces_ext_long "ModelWithControllersOnly/Vehicle Dynamics1/VehicleDynamics/Vehicle Body 3DOF Single Track/rear forces/ext long" /begin REF_MEASUREMENT ModelWithControllersOnly_B.VectorConcatenate1_c /end REF_MEASUREMENT /end GROUP
/begin GROUP ModelWithControllersOnly_Vehicle_Dynamics1_VehicleDynamics_Vehicle_Body_3DOF_Single_Track_sigma_sigma_relaxation_front "ModelWithControllersOnly/Vehicle Dynamics1/VehicleDynamics/Vehicle Body 3DOF Single Track/sigma/sigma/relaxation front" /begin REF_MEASUREMENT ModelWithControllersOnly_B.wheelInfo /end REF_MEASUREMENT /end GROUP
/begin GROUP ModelWithControllersOnly_Vehicle_Dynamics1_VehicleDynamics_Vehicle_Body_3DOF_Single_Track_sigma_sigma_relaxation_rear "ModelWithControllersOnly/Vehicle Dynamics1/VehicleDynamics/Vehicle Body 3DOF Single Track/sigma/sigma/relaxation rear" /begin REF_MEASUREMENT ModelWithControllersOnly_B.wheelInfo /end REF_MEASUREMENT /end GROUP
/begin GROUP ModelWithControllersOnly_Vehicle_Dynamics1_VehicleDynamics_Vehicle_Body_3DOF_Single_Track_state_xdot_int "ModelWithControllersOnly/Vehicle Dynamics1/VehicleDynamics/Vehicle Body 3DOF Single Track/state/xdot int"
 /begin REF_MEASUREMENT ModelWithControllersOnly_B.Integrator ModelWithControllersOnly_B.VectorConcatenate ModelWithControllersOnly_B.stateDer /end REF_MEASUREMENT
/end GROUP
/begin GROUP ModelWithControllersOnly_Vehicle_Dynamics1_VehicleDynamics_Vehicle_Body_3DOF_Single_Track_wind_wind_int "ModelWithControllersOnly/Vehicle Dynamics1/VehicleDynamics/Vehicle Body 3DOF Single Track/wind/wind int" /begin REF_MEASUREMENT ModelWithControllersOnly_B.VectorConcatenate1_b /end REF_MEASUREMENT /end GROUP
/begin GROUP ModelWithControllersOnly_Vehicle_Dynamics1_VehicleDynamics_engine_steer_brake_dynamics "ModelWithControllersOnly/Vehicle Dynamics1/VehicleDynamics/engine-steer-brake dynamics"
 /begin REF_MEASUREMENT ModelWithControllersOnly_B.Gain2_o ModelWithControllersOnly_B.Gain_n ModelWithControllersOnly_B.Integrator ModelWithControllersOnly_B.Switch ModelWithControllersOnly_B.Switch1 ModelWithControllersOnly_B.gear_cmd ModelWithControllersOnly_B.torquetoaccelerationconversion1 /end REF_MEASUREMENT
/end GROUP
/end MODULE
/end PROJECT
