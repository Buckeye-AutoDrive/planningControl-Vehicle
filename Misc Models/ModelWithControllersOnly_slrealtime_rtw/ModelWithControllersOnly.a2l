ASAP2_VERSION 1 71
/begin PROJECT ProjectName "Project Comment Goes Here"
/begin HEADER "Header Comments go here" /end HEADER
/begin MODULE ModuleName "Module Comment Goes Here"
/begin MOD_COMMON "Mod Common Comment Here" BYTE_ORDER MSB_LAST ALIGNMENT_BYTE 1 ALIGNMENT_WORD 2 ALIGNMENT_LONG 4 ALIGNMENT_FLOAT32_IEEE 4 ALIGNMENT_FLOAT64_IEEE 8 ALIGNMENT_INT64 8 /end MOD_COMMON
/begin CHARACTERISTIC ModelWithControllersOn_cal_impl.Constant10_Value "" VALUE 0x0026C3A8 Scalar_FLOAT64_IEEE 0 ModelWithControllersOnly_CM_double -1.7E+308 1.7E+308 /end CHARACTERISTIC
/begin CHARACTERISTIC ModelWithControllersOn_cal_impl.Constant1_Value_o "" VALUE 0x0026C3A0 Scalar_FLOAT64_IEEE 0 ModelWithControllersOnly_CM_double -1.7E+308 1.7E+308 /end CHARACTERISTIC
/begin CHARACTERISTIC ModelWithControllersOn_cal_impl.Constant2_Value "" VALUE 0x0026C280 Scalar_FLOAT64_IEEE 0 ModelWithControllersOnly_CM_double -1.7E+308 1.7E+308 /end CHARACTERISTIC
/begin CHARACTERISTIC ModelWithControllersOn_cal_impl.Constant3_Value "" VALUE 0x0026C390 Scalar_FLOAT64_IEEE 0 ModelWithControllersOnly_CM_double -1.7E+308 1.7E+308 /end CHARACTERISTIC
/begin CHARACTERISTIC ModelWithControllersOn_cal_impl.Constant3_Value_j "" VALUE 0x0026C3B0 Scalar_FLOAT64_IEEE 0 ModelWithControllersOnly_CM_double -1.7E+308 1.7E+308 /end CHARACTERISTIC
/begin CHARACTERISTIC ModelWithControllersOn_cal_impl.Constant4_Value_b "" VALUE 0x0026C398 Scalar_FLOAT64_IEEE 0 ModelWithControllersOnly_CM_double -1.7E+308 1.7E+308 /end CHARACTERISTIC
/begin CHARACTERISTIC ModelWithControllersOn_cal_impl.Constant4_Value_g "" VALUE 0x0026C378 Scalar_FLOAT64_IEEE 0 ModelWithControllersOnly_CM_double -1.7E+308 1.7E+308 /end CHARACTERISTIC
/begin CHARACTERISTIC ModelWithControllersOn_cal_impl.Constant5_Value "" VALUE 0x0026C370 Scalar_FLOAT64_IEEE 0 ModelWithControllersOnly_CM_double -1.7E+308 1.7E+308 /end CHARACTERISTIC
/begin CHARACTERISTIC ModelWithControllersOn_cal_impl.Constant6_Value "" VALUE 0x0026C380 Scalar_FLOAT64_IEEE 0 ModelWithControllersOnly_CM_double -1.7E+308 1.7E+308 /end CHARACTERISTIC
/begin CHARACTERISTIC ModelWithControllersOn_cal_impl.Constant7_Value "" VALUE 0x0026C2A8 Scalar_FLOAT64_IEEE 0 ModelWithControllersOnly_CM_double -1.7E+308 1.7E+308 /end CHARACTERISTIC
/begin CHARACTERISTIC ModelWithControllersOn_cal_impl.Constant8_Value "" VALUE 0x0026C298 Scalar_FLOAT64_IEEE 0 ModelWithControllersOnly_CM_double -1.7E+308 1.7E+308 /end CHARACTERISTIC
/begin CHARACTERISTIC ModelWithControllersOn_cal_impl.Constant9_Value_n "" VALUE 0x0026C3B8 Scalar_FLOAT64_IEEE 0 ModelWithControllersOnly_CM_double -1.7E+308 1.7E+308 /end CHARACTERISTIC
/begin CHARACTERISTIC ModelWithControllersOn_cal_impl.Constant_Value_a "" VALUE 0x0026C2C8 Scalar_FLOAT64_IEEE 0 ModelWithControllersOnly_CM_double -1.7E+308 1.7E+308 /end CHARACTERISTIC
/begin CHARACTERISTIC ModelWithControllersOn_cal_impl.Constant_Value_dz "" VALUE 0x0026C388 Scalar_FLOAT64_IEEE 0 ModelWithControllersOnly_CM_double -1.7E+308 1.7E+308 /end CHARACTERISTIC
/begin CHARACTERISTIC ModelWithControllersOn_cal_impl.Gain2_Gain_h0 "" VALUE 0x0026C3F8 Scalar_FLOAT64_IEEE 0 ModelWithControllersOnly_CM_double -1.7E+308 1.7E+308 /end CHARACTERISTIC
/begin CHARACTERISTIC ModelWithControllersOn_cal_impl.HardPointCoordinateTransformFro "" VALUE 0x0026C080 Scalar_FLOAT64_IEEE 0 ModelWithControllersOnly_CM_double -1.7E+308 1.7E+308 /end CHARACTERISTIC
/begin CHARACTERISTIC ModelWithControllersOn_cal_impl.HardPointCoordinateTransformRea "" VALUE 0x0026C088 Scalar_FLOAT64_IEEE 0 ModelWithControllersOnly_CM_double -1.7E+308 1.7E+308 /end CHARACTERISTIC
/begin CHARACTERISTIC ModelWithControllersOn_cal_impl.LookupGain_tbl "" CURVE 0x0026BF28 FixLookup_FLOAT64_IEEE 0 ModelWithControllersOnly_CM_double -1.7E+308 1.7E+308
 /begin AXIS_DESCR FIX_AXIS NO_INPUT_QUANTITY ModelWithControllersOnly_CM_double 2 -5000.000000 5000.000000 FIX_AXIS_PAR_DIST -5000 10000 2 /end AXIS_DESCR
/end CHARACTERISTIC
/begin CHARACTERISTIC ModelWithControllersOn_cal_impl.TmpRTBAtEqual1Inport1_InitialCo "" VALUE 0x0026C1B8 Scalar_FLOAT64_IEEE 0 ModelWithControllersOnly_CM_double -1.7E+308 1.7E+308 /end CHARACTERISTIC
/begin CHARACTERISTIC ModelWithControllersOn_cal_impl.TmpRTBAtEqual2Inport1_InitialCo "" VALUE 0x0026C1C0 Scalar_FLOAT64_IEEE 0 ModelWithControllersOnly_CM_double -1.7E+308 1.7E+308 /end CHARACTERISTIC
/begin CHARACTERISTIC ModelWithControllersOn_cal_impl.TmpRTBAtEqual4Inport2_InitialCo "" VALUE 0x0026C1C8 Scalar_FLOAT64_IEEE 0 ModelWithControllersOnly_CM_double -1.7E+308 1.7E+308 /end CHARACTERISTIC
/begin CHARACTERISTIC ModelWithControllersOn_cal_impl.TmpRTBAtEqual5Inport2_InitialCo "" VALUE 0x0026C1D0 Scalar_FLOAT64_IEEE 0 ModelWithControllersOnly_CM_double -1.7E+308 1.7E+308 /end CHARACTERISTIC
/begin CHARACTERISTIC ModelWithControllersOn_cal_impl.TmpRTBAtIntegratorInport1_Ini_j "" VALUE 0x0026C260 Scalar_FLOAT64_IEEE 0 ModelWithControllersOnly_CM_double -1.7E+308 1.7E+308 /end CHARACTERISTIC
/begin CHARACTERISTIC ModelWithControllersOn_cal_impl.TmpRTBAtIntegratorInport1_Initi "" VALUE 0x0026C258 Scalar_FLOAT64_IEEE 0 ModelWithControllersOnly_CM_double -1.7E+308 1.7E+308 /end CHARACTERISTIC
/begin CHARACTERISTIC ModelWithControllersOn_cal_impl.TmpRTBAtIntegratorInport2_Ini_j "" VALUE 0x0026C230 Scalar_FLOAT64_IEEE 0 ModelWithControllersOnly_CM_double -1.7E+308 1.7E+308 /end CHARACTERISTIC
/begin CHARACTERISTIC ModelWithControllersOn_cal_impl.TmpRTBAtIntegratorInport2_Initi "" VALUE 0x0026C200 Scalar_FLOAT64_IEEE 0 ModelWithControllersOnly_CM_double -1.7E+308 1.7E+308 /end CHARACTERISTIC
/begin CHARACTERISTIC ModelWithControllersOn_cal_impl.TmpRTBAtMATLABFunction1Inport1_ "" VALUE 0x0026C2F0 Scalar_FLOAT64_IEEE 0 ModelWithControllersOnly_CM_double -1.7E+308 1.7E+308 /end CHARACTERISTIC
/begin CHARACTERISTIC ModelWithControllersOn_cal_impl.TmpRTBAtMATLABFunction1Inport2_ "" VALUE 0x0026C2F8 Scalar_FLOAT64_IEEE 0 ModelWithControllersOnly_CM_double -1.7E+308 1.7E+308 /end CHARACTERISTIC
/begin CHARACTERISTIC ModelWithControllersOn_cal_impl.TmpRTBAtMATLABFunction1Inport3_ "" VALUE 0x0026C300 Scalar_FLOAT64_IEEE 0 ModelWithControllersOnly_CM_double -1.7E+308 1.7E+308 /end CHARACTERISTIC
/begin CHARACTERISTIC ModelWithControllersOn_cal_impl.TmpRTBAtMATLABFunction2Inport1_ "" VALUE 0x0026C308 Scalar_FLOAT64_IEEE 0 ModelWithControllersOnly_CM_double -1.7E+308 1.7E+308 /end CHARACTERISTIC
/begin CHARACTERISTIC ModelWithControllersOn_cal_impl.TmpRTBAtMATLABFunction2Inport2_ "" VALUE 0x0026C310 Scalar_FLOAT64_IEEE 0 ModelWithControllersOnly_CM_double -1.7E+308 1.7E+308 /end CHARACTERISTIC
/begin CHARACTERISTIC ModelWithControllersOn_cal_impl.TmpRTBAtMATLABFunction2Inport3_ "" VALUE 0x0026C318 Scalar_FLOAT64_IEEE 0 ModelWithControllersOnly_CM_double -1.7E+308 1.7E+308 /end CHARACTERISTIC
/begin CHARACTERISTIC ModelWithControllersOn_cal_impl.TmpRTBAtMATLABFunction3Inport1_ "" VALUE 0x0026C320 Scalar_FLOAT64_IEEE 0 ModelWithControllersOnly_CM_double -1.7E+308 1.7E+308 /end CHARACTERISTIC
/begin CHARACTERISTIC ModelWithControllersOn_cal_impl.TmpRTBAtMATLABFunction3Inport2_ "" VALUE 0x0026C328 Scalar_FLOAT64_IEEE 0 ModelWithControllersOnly_CM_double -1.7E+308 1.7E+308 /end CHARACTERISTIC
/begin CHARACTERISTIC ModelWithControllersOn_cal_impl.TmpRTBAtMATLABFunction3Inport3_ "" VALUE 0x0026C330 Scalar_FLOAT64_IEEE 0 ModelWithControllersOnly_CM_double -1.7E+308 1.7E+308 /end CHARACTERISTIC
/begin CHARACTERISTIC ModelWithControllersOn_cal_impl.TmpRTBAtMATLABFunctionInport1_I "" VALUE 0x0026C338 Scalar_FLOAT64_IEEE 0 ModelWithControllersOnly_CM_double -1.7E+308 1.7E+308 /end CHARACTERISTIC
/begin CHARACTERISTIC ModelWithControllersOn_cal_impl.TmpRTBAtMATLABFunctionInport2_I "" VALUE 0x0026C340 Scalar_FLOAT64_IEEE 0 ModelWithControllersOnly_CM_double -1.7E+308 1.7E+308 /end CHARACTERISTIC
/begin CHARACTERISTIC ModelWithControllersOn_cal_impl.TmpRTBAtMATLABFunctionInport3_I "" VALUE 0x0026C348 Scalar_FLOAT64_IEEE 0 ModelWithControllersOnly_CM_double -1.7E+308 1.7E+308 /end CHARACTERISTIC
/begin CHARACTERISTIC ModelWithControllersOn_cal_impl.TmpRTBAtMultiplyInport1_Initial "" VALUE 0x0026C1E8 Scalar_FLOAT64_IEEE 0 ModelWithControllersOnly_CM_double -1.7E+308 1.7E+308 /end CHARACTERISTIC
/begin CHARACTERISTIC ModelWithControllersOn_cal_impl.TmpRTBAtSumInport3_InitialCon_j "" VALUE 0x0026C250 Scalar_FLOAT64_IEEE 0 ModelWithControllersOnly_CM_double -1.7E+308 1.7E+308 /end CHARACTERISTIC
/begin CHARACTERISTIC ModelWithControllersOn_cal_impl.TmpRTBAtSumInport3_InitialCondi "" VALUE 0x0026C220 Scalar_FLOAT64_IEEE 0 ModelWithControllersOnly_CM_double -1.7E+308 1.7E+308 /end CHARACTERISTIC
/begin CHARACTERISTIC ModelWithControllersOn_cal_impl.TmpRTBAtSwitchCaseInport1_Initi "" VALUE 0x0026C1F0 Scalar_FLOAT64_IEEE 0 ModelWithControllersOnly_CM_double -1.7E+308 1.7E+308 /end CHARACTERISTIC
/begin CHARACTERISTIC ModelWithControllersOn_cal_impl.UnitDelay_InitialCondition_f "" VALUE 0x0026C3E0 Scalar_FLOAT64_IEEE 0 ModelWithControllersOnly_CM_double -1.7E+308 1.7E+308 /end CHARACTERISTIC
/begin CHARACTERISTIC ModelWithControllersOn_cal_impl.VehicleBody3DOFSingleTrack_latO "" VALUE 0x0026C0C0 Scalar_FLOAT64_IEEE 0 ModelWithControllersOnly_CM_double -1.7E+308 1.7E+308 /end CHARACTERISTIC
/begin CHARACTERISTIC ModelWithControllersOn_cal_impl.VehicleBody3DOFSingleTrack_long "" VALUE 0x0026C0C8 Scalar_FLOAT64_IEEE 0 ModelWithControllersOnly_CM_double -1.7E+308 1.7E+308 /end CHARACTERISTIC
/begin CHARACTERISTIC ModelWithControllersOn_cal_impl.VehicleBody3DOFSingleTrack_mu "" VALUE 0x0026C0D0 Scalar_FLOAT64_IEEE 0 ModelWithControllersOnly_CM_double -1.7E+308 1.7E+308 /end CHARACTERISTIC
/begin CHARACTERISTIC ModelWithControllersOn_cal_impl.VehicleBody3DOFSingleTrack_si_n "" VALUE 0x0026C0E8 Scalar_FLOAT64_IEEE 0 ModelWithControllersOnly_CM_double -1.7E+308 1.7E+308 /end CHARACTERISTIC
/begin CHARACTERISTIC ModelWithControllersOn_cal_impl.VehicleBody3DOFSingleTrack_sigm "" VALUE 0x0026C0E0 Scalar_FLOAT64_IEEE 0 ModelWithControllersOnly_CM_double -1.7E+308 1.7E+308 /end CHARACTERISTIC
/begin CHARACTERISTIC ModelWithControllersOn_cal_impl.VehicleBody3DOFSingleTrack_vert "" VALUE 0x0026C0F0 Scalar_FLOAT64_IEEE 0 ModelWithControllersOnly_CM_double -1.7E+308 1.7E+308 /end CHARACTERISTIC
/begin CHARACTERISTIC ModelWithControllersOn_cal_impl.degtorad1_Gain "" VALUE 0x0026C3F0 Scalar_FLOAT64_IEEE 0 ModelWithControllersOnly_CM_double -1.7E+308 1.7E+308 /end CHARACTERISTIC
/begin CHARACTERISTIC ModelWithControllersOn_cal_impl.lateral_IC "" VALUE 0x0026C3C0 Scalar_FLOAT64_IEEE 0 ModelWithControllersOnly_CM_double -1.7E+308 1.7E+308 /end CHARACTERISTIC
/begin CHARACTERISTIC ModelWithControllersOn_cal_impl.lateral_IC_a "" VALUE 0x0026C3C8 Scalar_FLOAT64_IEEE 0 ModelWithControllersOnly_CM_double -1.7E+308 1.7E+308 /end CHARACTERISTIC
/begin CHARACTERISTIC ModelWithControllersOn_cal_impl.secondorderlowpassbrakemodel_In "" VALUE 0x0026C3D8 Scalar_FLOAT64_IEEE 0 ModelWithControllersOnly_CM_double -1.7E+308 1.7E+308 /end CHARACTERISTIC
/begin CHARACTERISTIC ModelWithControllersOn_cal_impl.secondorderlowpasssteeringmodel "" VALUE 0x0026C3E8 Scalar_FLOAT64_IEEE 0 ModelWithControllersOnly_CM_double -1.7E+308 1.7E+308 /end CHARACTERISTIC
/begin CHARACTERISTIC ModelWithControllersOn_cal_impl.secondorderlowpasstorquemodel_I "" VALUE 0x0026C3D0 Scalar_FLOAT64_IEEE 0 ModelWithControllersOnly_CM_double -1.7E+308 1.7E+308 /end CHARACTERISTIC
/begin CHARACTERISTIC ModelWithControllersOn_cal_impl.uDLookupTable1_tableData "" CURVE 0x0026BFB0 FixLookup_FLOAT64_IEEE 0 ModelWithControllersOnly_CM_double -1.7E+308 1.7E+308
 /begin AXIS_DESCR FIX_AXIS ModelWithControllersOnly_B.Product_kk ModelWithControllersOnly_CM_double 2 -4.712389 4.712389 FIX_AXIS_PAR_DIST -4.7124 9.4248 2 /end AXIS_DESCR
/end CHARACTERISTIC
/begin CHARACTERISTIC ModelWithControllersOn_cal_impl.uDLookupTable_dimSizes "" VALUE 0x0026C494 Scalar_ULONG 0 ModelWithControllersOnly_CM_uint32 0 2147483646 /end CHARACTERISTIC
/begin CHARACTERISTIC ModelWithControllersOn_cal_impl.uDLookupTable_maxIndex "" VALUE 0x0026C490 Scalar_ULONG 0 ModelWithControllersOnly_CM_uint32 0 2147483646 /end CHARACTERISTIC
/begin CHARACTERISTIC ModelWithControllersOn_cal_impl.uDLookupTable_numYWorkElts "" VAL_BLK 0x0026C488 Scalar_ULONG 0 ModelWithControllersOnly_CM_uint32 0 2147483646 MATRIX_DIM 2 /end CHARACTERISTIC
/begin CHARACTERISTIC ModelWithControllersOn_cal_impl.uDLookupTable_tableData "" CURVE 0x0026BFC0 FixLookup_FLOAT64_IEEE 0 ModelWithControllersOnly_CM_double -1.7E+308 1.7E+308
 /begin AXIS_DESCR FIX_AXIS ModelWithControllersOnly_B.Product_kk ModelWithControllersOnly_CM_double 2 -4.712389 4.712389 FIX_AXIS_PAR_DIST -4.7124 9.4248 2 /end AXIS_DESCR
/end CHARACTERISTIC
/begin CHARACTERISTIC ModelWithControllersOn_cal_impl.xdot1_InitialCondition "" VALUE 0x0026C1E0 Scalar_FLOAT64_IEEE 0 ModelWithControllersOnly_CM_double -1.7E+308 1.7E+308 /end CHARACTERISTIC
/begin CHARACTERISTIC ModelWithControllersOn_cal_impl.xdot_InitialCondition "" VALUE 0x0026C1D8 Scalar_FLOAT64_IEEE 0 ModelWithControllersOnly_CM_double -1.7E+308 1.7E+308 /end CHARACTERISTIC
/begin CHARACTERISTIC ModelWithControllersOn_cal_impl.xdot_InitialCondition_b "" VALUE 0x0026C1F8 Scalar_FLOAT64_IEEE 0 ModelWithControllersOnly_CM_double -1.7E+308 1.7E+308 /end CHARACTERISTIC
/begin CHARACTERISTIC RTE_Param_Service.DEND_B "" VAL_BLK 0x0026C4A0 Scalar_FLOAT64_IEEE 0 ModelWithControllersOnly_CM_double -1.7E+308 1.7E+308 MATRIX_DIM 3 1 /end CHARACTERISTIC
/begin CHARACTERISTIC RTE_Param_Service.DEND_S "" VAL_BLK 0x0026C4B8 Scalar_FLOAT64_IEEE 0 ModelWithControllersOnly_CM_double -1.7E+308 1.7E+308 MATRIX_DIM 3 1 /end CHARACTERISTIC
/begin CHARACTERISTIC RTE_Param_Service.DEND_T "" VAL_BLK 0x0026C4D0 Scalar_FLOAT64_IEEE 0 ModelWithControllersOnly_CM_double -1.7E+308 1.7E+308 MATRIX_DIM 3 1 /end CHARACTERISTIC
/begin CHARACTERISTIC RTE_Param_Service.LF "" VALUE 0x0026C4E8 Scalar_FLOAT64_IEEE 0 ModelWithControllersOnly_CM_double -1.7E+308 1.7E+308 /end CHARACTERISTIC
/begin CHARACTERISTIC RTE_Param_Service.LR "" VALUE 0x0026C4F0 Scalar_FLOAT64_IEEE 0 ModelWithControllersOnly_CM_double -1.7E+308 1.7E+308 /end CHARACTERISTIC
/begin CHARACTERISTIC RTE_Param_Service.MAX_BRAKE "" VALUE 0x0026C4F8 Scalar_FLOAT64_IEEE 0 ModelWithControllersOnly_CM_double -1.7E+308 1.7E+308 /end CHARACTERISTIC
/begin CHARACTERISTIC RTE_Param_Service.MAX_STEER "" VALUE 0x0026C500 Scalar_FLOAT64_IEEE 0 ModelWithControllersOnly_CM_double -1.7E+308 1.7E+308 /end CHARACTERISTIC
/begin CHARACTERISTIC RTE_Param_Service.MAX_TORQUE "" VALUE 0x0026C508 Scalar_FLOAT64_IEEE 0 ModelWithControllersOnly_CM_double -1.7E+308 1.7E+308 /end CHARACTERISTIC
/begin CHARACTERISTIC RTE_Param_Service.MCAR "" VALUE 0x0026C510 Scalar_FLOAT64_IEEE 0 ModelWithControllersOnly_CM_double -1.7E+308 1.7E+308 /end CHARACTERISTIC
/begin CHARACTERISTIC RTE_Param_Service.MIN_BRAKE "" VALUE 0x0026C518 Scalar_FLOAT64_IEEE 0 ModelWithControllersOnly_CM_double -1.7E+308 1.7E+308 /end CHARACTERISTIC
/begin CHARACTERISTIC RTE_Param_Service.MIN_STEER "" VALUE 0x0026C520 Scalar_FLOAT64_IEEE 0 ModelWithControllersOnly_CM_double -1.7E+308 1.7E+308 /end CHARACTERISTIC
/begin CHARACTERISTIC RTE_Param_Service.MIN_TORQUE "" VALUE 0x0026C528 Scalar_FLOAT64_IEEE 0 ModelWithControllersOnly_CM_double -1.7E+308 1.7E+308 /end CHARACTERISTIC
/begin CHARACTERISTIC RTE_Param_Service.NUMD_B "" VAL_BLK 0x0026C530 Scalar_FLOAT64_IEEE 0 ModelWithControllersOnly_CM_double -1.7E+308 1.7E+308 MATRIX_DIM 3 1 /end CHARACTERISTIC
/begin CHARACTERISTIC RTE_Param_Service.NUMD_S "" VAL_BLK 0x0026C548 Scalar_FLOAT64_IEEE 0 ModelWithControllersOnly_CM_double -1.7E+308 1.7E+308 MATRIX_DIM 3 1 /end CHARACTERISTIC
/begin CHARACTERISTIC RTE_Param_Service.NUMD_T "" VAL_BLK 0x0026C560 Scalar_FLOAT64_IEEE 0 ModelWithControllersOnly_CM_double -1.7E+308 1.7E+308 MATRIX_DIM 3 1 /end CHARACTERISTIC
/begin CHARACTERISTIC RTE_Param_Service.R "" VALUE 0x0026C578 Scalar_FLOAT64_IEEE 0 ModelWithControllersOnly_CM_double -1.7E+308 1.7E+308 /end CHARACTERISTIC
/begin CHARACTERISTIC RTE_Param_Service.RRdamp "" VALUE 0x0026C580 Scalar_FLOAT64_IEEE 0 ModelWithControllersOnly_CM_double -1.7E+308 1.7E+308 /end CHARACTERISTIC
/begin CHARACTERISTIC RTE_Param_Service.STEER_RATIO "" VALUE 0x0026C588 Scalar_FLOAT64_IEEE 0 ModelWithControllersOnly_CM_double -1.7E+308 1.7E+308 /end CHARACTERISTIC
/begin CHARACTERISTIC RTE_Param_Service.Tdead "" VALUE 0x0026C590 Scalar_FLOAT64_IEEE 0 ModelWithControllersOnly_CM_double -1.7E+308 1.7E+308 /end CHARACTERISTIC
/begin CHARACTERISTIC RTE_Param_Service.Vdead "" VALUE 0x0026C598 Scalar_FLOAT64_IEEE 0 ModelWithControllersOnly_CM_double -1.7E+308 1.7E+308 /end CHARACTERISTIC
/begin CHARACTERISTIC RTE_Param_Service.X_o "" VALUE 0x0026C5A0 Scalar_FLOAT64_IEEE 0 ModelWithControllersOnly_CM_double -1.7E+308 1.7E+308 /end CHARACTERISTIC
/begin CHARACTERISTIC RTE_Param_Service.Y_o "" VALUE 0x0026C5A8 Scalar_FLOAT64_IEEE 0 ModelWithControllersOnly_CM_double -1.7E+308 1.7E+308 /end CHARACTERISTIC
/begin CHARACTERISTIC RTE_Param_Service.psi_o "" VALUE 0x0026C5B0 Scalar_FLOAT64_IEEE 0 ModelWithControllersOnly_CM_double -1.7E+308 1.7E+308 /end CHARACTERISTIC
/begin MEASUREMENT ModelWithControllersOnl_PrevZCX.Integrator_Reset_ZCE "" UBYTE ModelWithControllersOnly_CM_ZCSigState 0 0 0 255 ECU_ADDRESS 0x0026C998 /end MEASUREMENT
/begin MEASUREMENT ModelWithControllersOnl_PrevZCX.Integrator_Reset_ZCE_c "" UBYTE ModelWithControllersOnly_CM_ZCSigState 0 0 0 255 ECU_ADDRESS 0x0026C999 /end MEASUREMENT
/begin MEASUREMENT ModelWithControllersOnly_B.Abs "" FLOAT64_IEEE ModelWithControllersOnly_CM_double 0 0 -1.7E+308 1.7E+308 ECU_ADDRESS 0x0026E4C8 /end MEASUREMENT
/begin MEASUREMENT ModelWithControllersOnly_B.Abs_d "" FLOAT64_IEEE ModelWithControllersOnly_CM_double 0 0 -1.7E+308 1.7E+308 ECU_ADDRESS 0x0026E4D8 /end MEASUREMENT
/begin MEASUREMENT ModelWithControllersOnly_B.Add1_f "" FLOAT64_IEEE ModelWithControllersOnly_CM_double_m_per_s 0 0 -1.7E+308 1.7E+308 LAYOUT COLUMN_DIR MATRIX_DIM 3 ECU_ADDRESS 0x0026D728 /end MEASUREMENT
/begin MEASUREMENT ModelWithControllersOnly_B.Add1_h "" FLOAT64_IEEE ModelWithControllersOnly_CM_double_m_per_s 0 0 -1.7E+308 1.7E+308 LAYOUT COLUMN_DIR MATRIX_DIM 3 ECU_ADDRESS 0x0026DE00 /end MEASUREMENT
/begin MEASUREMENT ModelWithControllersOnly_B.Add1_o "" FLOAT64_IEEE ModelWithControllersOnly_CM_double_m_per_s 0 0 -1.7E+308 1.7E+308 LAYOUT COLUMN_DIR MATRIX_DIM 3 ECU_ADDRESS 0x0026D968 /end MEASUREMENT
/begin MEASUREMENT ModelWithControllersOnly_B.Add1_o0 "" FLOAT64_IEEE ModelWithControllersOnly_CM_double_m_per_s 0 0 -1.7E+308 1.7E+308 LAYOUT COLUMN_DIR MATRIX_DIM 3 ECU_ADDRESS 0x0026DBC0 /end MEASUREMENT
/begin MEASUREMENT ModelWithControllersOnly_B.Add_c "" FLOAT64_IEEE ModelWithControllersOnly_CM_double_m 0 0 -1.7E+308 1.7E+308 LAYOUT COLUMN_DIR MATRIX_DIM 3 ECU_ADDRESS 0x0026DDA0 /end MEASUREMENT
/begin MEASUREMENT ModelWithControllersOnly_B.Add_e "" FLOAT64_IEEE ModelWithControllersOnly_CM_double_m 0 0 -1.7E+308 1.7E+308 LAYOUT COLUMN_DIR MATRIX_DIM 3 ECU_ADDRESS 0x0026D6C8 /end MEASUREMENT
/begin MEASUREMENT ModelWithControllersOnly_B.Add_p "" FLOAT64_IEEE ModelWithControllersOnly_CM_double_m 0 0 -1.7E+308 1.7E+308 LAYOUT COLUMN_DIR MATRIX_DIM 3 ECU_ADDRESS 0x0026D908 /end MEASUREMENT
/begin MEASUREMENT ModelWithControllersOnly_B.Add_p3 "" FLOAT64_IEEE ModelWithControllersOnly_CM_double 0 0 -1.7E+308 1.7E+308 ECU_ADDRESS 0x0026E218 /end MEASUREMENT
/begin MEASUREMENT ModelWithControllersOnly_B.Add_pa "" FLOAT64_IEEE ModelWithControllersOnly_CM_double_m 0 0 -1.7E+308 1.7E+308 LAYOUT COLUMN_DIR MATRIX_DIM 3 ECU_ADDRESS 0x0026DB60 /end MEASUREMENT
/begin MEASUREMENT ModelWithControllersOnly_B.Beta "" FLOAT64_IEEE ModelWithControllersOnly_CM_double_rad 0 0 -1.7E+308 1.7E+308 ECU_ADDRESS 0x0026D9F0 /end MEASUREMENT
/begin MEASUREMENT ModelWithControllersOnly_B.Beta_n "" FLOAT64_IEEE ModelWithControllersOnly_CM_double_rad 0 0 -1.7E+308 1.7E+308 ECU_ADDRESS 0x0026E090 /end MEASUREMENT
/begin MEASUREMENT ModelWithControllersOnly_B.BrakeSaturation_m "" FLOAT64_IEEE ModelWithControllersOnly_CM_double 0 0 -1.7E+308 1.7E+308 ECU_ADDRESS 0x0026E1C0 /end MEASUREMENT
/begin MEASUREMENT ModelWithControllersOnly_B.Compare "" UBYTE ModelWithControllersOnly_CM_logical 0 0 0 1 ECU_ADDRESS 0x0026E5A4 /end MEASUREMENT
/begin MEASUREMENT ModelWithControllersOnly_B.Compare_f "" UBYTE ModelWithControllersOnly_CM_logical 0 0 0 1 ECU_ADDRESS 0x0026E5A5 /end MEASUREMENT
/begin MEASUREMENT ModelWithControllersOnly_B.Compare_i "" UBYTE ModelWithControllersOnly_CM_logical 0 0 0 1 ECU_ADDRESS 0x0026E5A7 /end MEASUREMENT
/begin MEASUREMENT ModelWithControllersOnly_B.Compare_p "" UBYTE ModelWithControllersOnly_CM_logical 0 0 0 1 ECU_ADDRESS 0x0026E5A8 /end MEASUREMENT
/begin MEASUREMENT ModelWithControllersOnly_B.Constant10 "" FLOAT64_IEEE ModelWithControllersOnly_CM_double_rad_per_s_2 0 0 -1.7E+308 1.7E+308 ECU_ADDRESS 0x0026E0A0 /end MEASUREMENT
/begin MEASUREMENT ModelWithControllersOnly_B.Constant9 "" FLOAT64_IEEE ModelWithControllersOnly_CM_double_rad_per_s_2 0 0 -1.7E+308 1.7E+308 ECU_ADDRESS 0x0026E0B0 /end MEASUREMENT
/begin MEASUREMENT ModelWithControllersOnly_B.DeadZone "" FLOAT64_IEEE ModelWithControllersOnly_CM_double 0 0 -1.7E+308 1.7E+308 ECU_ADDRESS 0x0026E1D8 /end MEASUREMENT
/begin MEASUREMENT ModelWithControllersOnly_B.DeadZone1 "" FLOAT64_IEEE ModelWithControllersOnly_CM_double 0 0 -1.7E+308 1.7E+308 ECU_ADDRESS 0x0026E1B8 /end MEASUREMENT
/begin MEASUREMENT ModelWithControllersOnly_B.Divide "" FLOAT64_IEEE ModelWithControllersOnly_CM_double 0 0 -1.7E+308 1.7E+308 ECU_ADDRESS 0x0026D9E8 /end MEASUREMENT
/begin MEASUREMENT ModelWithControllersOnly_B.Divide1 "" FLOAT64_IEEE ModelWithControllersOnly_CM_double 0 0 -1.7E+308 1.7E+308 ECU_ADDRESS 0x0026DF40 /end MEASUREMENT
/begin MEASUREMENT ModelWithControllersOnly_B.Divide_c "" FLOAT64_IEEE ModelWithControllersOnly_CM_double 0 0 -1.7E+308 1.7E+308 ECU_ADDRESS 0x0026DF68 /end MEASUREMENT
/begin MEASUREMENT ModelWithControllersOnly_B.Divide_p "" FLOAT64_IEEE ModelWithControllersOnly_CM_double 0 0 -1.7E+308 1.7E+308 ECU_ADDRESS 0x0026E088 /end MEASUREMENT
/begin MEASUREMENT ModelWithControllersOnly_B.Fcn "" FLOAT64_IEEE ModelWithControllersOnly_CM_double 0 0 -1.7E+308 1.7E+308 ECU_ADDRESS 0x0026E4D0 /end MEASUREMENT
/begin MEASUREMENT ModelWithControllersOnly_B.Fcn_g "" FLOAT64_IEEE ModelWithControllersOnly_CM_double 0 0 -1.7E+308 1.7E+308 ECU_ADDRESS 0x0026E4E0 /end MEASUREMENT
/begin MEASUREMENT ModelWithControllersOnly_B.LogicalOperator "" UBYTE ModelWithControllersOnly_CM_logical 0 0 0 1 ECU_ADDRESS 0x0026E5A6 /end MEASUREMENT
/begin MEASUREMENT ModelWithControllersOnly_B.LogicalOperator_e "" UBYTE ModelWithControllersOnly_CM_logical 0 0 0 1 ECU_ADDRESS 0x0026E5A9 /end MEASUREMENT
/begin MEASUREMENT ModelWithControllersOnly_B.Product12 "" FLOAT64_IEEE ModelWithControllersOnly_CM_double 0 0 -1.7E+308 1.7E+308 LAYOUT COLUMN_DIR MATRIX_DIM 3 ECU_ADDRESS 0x0026DF10 /end MEASUREMENT
/begin MEASUREMENT ModelWithControllersOnly_B.Product13 "" FLOAT64_IEEE ModelWithControllersOnly_CM_double 0 0 -1.7E+308 1.7E+308 LAYOUT COLUMN_DIR MATRIX_DIM 3 ECU_ADDRESS 0x0026DF28 /end MEASUREMENT
/begin MEASUREMENT ModelWithControllersOnly_B.Product14 "" FLOAT64_IEEE ModelWithControllersOnly_CM_double 0 0 -1.7E+308 1.7E+308 LAYOUT COLUMN_DIR MATRIX_DIM 3 ECU_ADDRESS 0x0026DEA8 /end MEASUREMENT
/begin MEASUREMENT ModelWithControllersOnly_B.Product1_af "" FLOAT64_IEEE ModelWithControllersOnly_CM_double 0 0 -1.7E+308 1.7E+308 ECU_ADDRESS 0x0026E1A0 /end MEASUREMENT
/begin MEASUREMENT ModelWithControllersOnly_B.Product1_h "" FLOAT64_IEEE ModelWithControllersOnly_CM_double 0 0 -1.7E+308 1.7E+308 ECU_ADDRESS 0x0026E188 /end MEASUREMENT
/begin MEASUREMENT ModelWithControllersOnly_B.Product2_m "" FLOAT64_IEEE ModelWithControllersOnly_CM_double 0 0 -1.7E+308 1.7E+308 LAYOUT COLUMN_DIR MATRIX_DIM 3 ECU_ADDRESS 0x0026DE90 /end MEASUREMENT
/begin MEASUREMENT ModelWithControllersOnly_B.Product3_b "" FLOAT64_IEEE ModelWithControllersOnly_CM_double 0 0 -1.7E+308 1.7E+308 LAYOUT COLUMN_DIR MATRIX_DIM 3 ECU_ADDRESS 0x0026DEC0 /end MEASUREMENT
/begin MEASUREMENT ModelWithControllersOnly_B.Product5 "" FLOAT64_IEEE ModelWithControllersOnly_CM_double_W 0 0 -1.7E+308 1.7E+308 ECU_ADDRESS 0x0026DF60 /end MEASUREMENT
/begin MEASUREMENT ModelWithControllersOnly_B.Product6 "" FLOAT64_IEEE ModelWithControllersOnly_CM_double_W 0 0 -1.7E+308 1.7E+308 ECU_ADDRESS 0x0026DF88 /end MEASUREMENT
/begin MEASUREMENT ModelWithControllersOnly_B.Product7 "" FLOAT64_IEEE ModelWithControllersOnly_CM_double_W 0 0 -1.7E+308 1.7E+308 ECU_ADDRESS 0x0026DF90 /end MEASUREMENT
/begin MEASUREMENT ModelWithControllersOnly_B.Product8 "" FLOAT64_IEEE ModelWithControllersOnly_CM_double 0 0 -1.7E+308 1.7E+308 LAYOUT COLUMN_DIR MATRIX_DIM 3 ECU_ADDRESS 0x0026DE78 /end MEASUREMENT
/begin MEASUREMENT ModelWithControllersOnly_B.Product_a "" FLOAT64_IEEE ModelWithControllersOnly_CM_double 0 0 -1.7E+308 1.7E+308 LAYOUT COLUMN_DIR MATRIX_DIM 1 3 ECU_ADDRESS 0x0026DD70 /end MEASUREMENT
/begin MEASUREMENT ModelWithControllersOnly_B.Product_f "" FLOAT64_IEEE ModelWithControllersOnly_CM_double 0 0 -1.7E+308 1.7E+308 LAYOUT COLUMN_DIR MATRIX_DIM 1 3 ECU_ADDRESS 0x0026D698 /end MEASUREMENT
/begin MEASUREMENT ModelWithControllersOnly_B.Product_g "" FLOAT64_IEEE ModelWithControllersOnly_CM_double 0 0 -1.7E+308 1.7E+308 LAYOUT COLUMN_DIR MATRIX_DIM 1 3 ECU_ADDRESS 0x0026DB30 /end MEASUREMENT
/begin MEASUREMENT ModelWithControllersOnly_B.Product_iz "" FLOAT64_IEEE ModelWithControllersOnly_CM_double 0 0 -1.7E+308 1.7E+308 LAYOUT COLUMN_DIR MATRIX_DIM 1 3 ECU_ADDRESS 0x0026DE30 /end MEASUREMENT
/begin MEASUREMENT ModelWithControllersOnly_B.Product_kk "" FLOAT64_IEEE ModelWithControllersOnly_CM_double 0 0 -1.7E+308 1.7E+308 ECU_ADDRESS 0x0026E200 /end MEASUREMENT
/begin MEASUREMENT ModelWithControllersOnly_B.Product_ky "" FLOAT64_IEEE ModelWithControllersOnly_CM_double 0 0 -1.7E+308 1.7E+308 LAYOUT COLUMN_DIR MATRIX_DIM 1 3 ECU_ADDRESS 0x0026DBF0 /end MEASUREMENT
/begin MEASUREMENT ModelWithControllersOnly_B.Product_m "" FLOAT64_IEEE ModelWithControllersOnly_CM_double 0 0 -1.7E+308 1.7E+308 LAYOUT COLUMN_DIR MATRIX_DIM 1 3 ECU_ADDRESS 0x0026D758 /end MEASUREMENT
/begin MEASUREMENT ModelWithControllersOnly_B.Product_n "" FLOAT64_IEEE ModelWithControllersOnly_CM_double 0 0 -1.7E+308 1.7E+308 LAYOUT COLUMN_DIR MATRIX_DIM 1 3 ECU_ADDRESS 0x0026D8D8 /end MEASUREMENT
/begin MEASUREMENT ModelWithControllersOnly_B.Product_p "" FLOAT64_IEEE ModelWithControllersOnly_CM_double 0 0 -1.7E+308 1.7E+308 LAYOUT COLUMN_DIR MATRIX_DIM 1 3 ECU_ADDRESS 0x0026D998 /end MEASUREMENT
/begin MEASUREMENT ModelWithControllersOnly_B.Product_po "" FLOAT64_IEEE ModelWithControllersOnly_CM_double 0 0 -1.7E+308 1.7E+308 ECU_ADDRESS 0x0026DED8 /end MEASUREMENT
/begin MEASUREMENT ModelWithControllersOnly_B.Reshape1 "" FLOAT64_IEEE ModelWithControllersOnly_CM_double 0 0 -1.7E+308 1.7E+308 LAYOUT COLUMN_DIR MATRIX_DIM 1 3 ECU_ADDRESS 0x0026D680 /end MEASUREMENT
/begin MEASUREMENT ModelWithControllersOnly_B.Reshape1_e "" FLOAT64_IEEE ModelWithControllersOnly_CM_double 0 0 -1.7E+308 1.7E+308 LAYOUT COLUMN_DIR MATRIX_DIM 1 3 ECU_ADDRESS 0x0026D8C0 /end MEASUREMENT
/begin MEASUREMENT ModelWithControllersOnly_B.Reshape1_f "" FLOAT64_IEEE ModelWithControllersOnly_CM_double 0 0 -1.7E+308 1.7E+308 LAYOUT COLUMN_DIR MATRIX_DIM 1 3 ECU_ADDRESS 0x0026DD58 /end MEASUREMENT
/begin MEASUREMENT ModelWithControllersOnly_B.Reshape1_j "" FLOAT64_IEEE ModelWithControllersOnly_CM_double 0 0 -1.7E+308 1.7E+308 LAYOUT COLUMN_DIR MATRIX_DIM 1 3 ECU_ADDRESS 0x0026D980 /end MEASUREMENT
/begin MEASUREMENT ModelWithControllersOnly_B.Reshape1_k "" FLOAT64_IEEE ModelWithControllersOnly_CM_double 0 0 -1.7E+308 1.7E+308 LAYOUT COLUMN_DIR MATRIX_DIM 1 3 ECU_ADDRESS 0x0026DBD8 /end MEASUREMENT
/begin MEASUREMENT ModelWithControllersOnly_B.Reshape1_m "" FLOAT64_IEEE ModelWithControllersOnly_CM_double 0 0 -1.7E+308 1.7E+308 LAYOUT COLUMN_DIR MATRIX_DIM 1 3 ECU_ADDRESS 0x0026D740 /end MEASUREMENT
/begin MEASUREMENT ModelWithControllersOnly_B.Reshape1_n "" FLOAT64_IEEE ModelWithControllersOnly_CM_double 0 0 -1.7E+308 1.7E+308 LAYOUT COLUMN_DIR MATRIX_DIM 1 3 ECU_ADDRESS 0x0026DB18 /end MEASUREMENT
/begin MEASUREMENT ModelWithControllersOnly_B.Reshape1_nq "" FLOAT64_IEEE ModelWithControllersOnly_CM_double 0 0 -1.7E+308 1.7E+308 LAYOUT COLUMN_DIR MATRIX_DIM 1 3 ECU_ADDRESS 0x0026DE18 /end MEASUREMENT
/begin MEASUREMENT ModelWithControllersOnly_B.Reshape2 "" FLOAT64_IEEE ModelWithControllersOnly_CM_double 0 0 -1.7E+308 1.7E+308 LAYOUT COLUMN_DIR MATRIX_DIM 3 ECU_ADDRESS 0x0026D6B0 /end MEASUREMENT
/begin MEASUREMENT ModelWithControllersOnly_B.Reshape2_c "" FLOAT64_IEEE ModelWithControllersOnly_CM_double 0 0 -1.7E+308 1.7E+308 LAYOUT COLUMN_DIR MATRIX_DIM 3 ECU_ADDRESS 0x0026D9B0 /end MEASUREMENT
/begin MEASUREMENT ModelWithControllersOnly_B.Reshape2_e "" FLOAT64_IEEE ModelWithControllersOnly_CM_double 0 0 -1.7E+308 1.7E+308 LAYOUT COLUMN_DIR MATRIX_DIM 3 ECU_ADDRESS 0x0026DE48 /end MEASUREMENT
/begin MEASUREMENT ModelWithControllersOnly_B.Reshape2_f "" FLOAT64_IEEE ModelWithControllersOnly_CM_double 0 0 -1.7E+308 1.7E+308 LAYOUT COLUMN_DIR MATRIX_DIM 3 ECU_ADDRESS 0x0026DC08 /end MEASUREMENT
/begin MEASUREMENT ModelWithControllersOnly_B.Reshape2_g "" FLOAT64_IEEE ModelWithControllersOnly_CM_double 0 0 -1.7E+308 1.7E+308 LAYOUT COLUMN_DIR MATRIX_DIM 3 ECU_ADDRESS 0x0026DB48 /end MEASUREMENT
/begin MEASUREMENT ModelWithControllersOnly_B.Reshape2_m "" FLOAT64_IEEE ModelWithControllersOnly_CM_double 0 0 -1.7E+308 1.7E+308 LAYOUT COLUMN_DIR MATRIX_DIM 3 ECU_ADDRESS 0x0026D8F0 /end MEASUREMENT
/begin MEASUREMENT ModelWithControllersOnly_B.Reshape2_mj "" FLOAT64_IEEE ModelWithControllersOnly_CM_double 0 0 -1.7E+308 1.7E+308 LAYOUT COLUMN_DIR MATRIX_DIM 3 ECU_ADDRESS 0x0026DD88 /end MEASUREMENT
/begin MEASUREMENT ModelWithControllersOnly_B.Reshape2_p "" FLOAT64_IEEE ModelWithControllersOnly_CM_double 0 0 -1.7E+308 1.7E+308 LAYOUT COLUMN_DIR MATRIX_DIM 3 ECU_ADDRESS 0x0026D770 /end MEASUREMENT
/begin MEASUREMENT ModelWithControllersOnly_B.Reshape9to3x3columnmajor "" FLOAT64_IEEE ModelWithControllersOnly_CM_double_1 0 0 -1.7E+308 1.7E+308 LAYOUT COLUMN_DIR MATRIX_DIM 3 3 ECU_ADDRESS 0x0026D5D8 /end MEASUREMENT
/begin MEASUREMENT ModelWithControllersOnly_B.Reshape9to3x3columnmajor_e "" FLOAT64_IEEE ModelWithControllersOnly_CM_double_1 0 0 -1.7E+308 1.7E+308 LAYOUT COLUMN_DIR MATRIX_DIM 3 3 ECU_ADDRESS 0x0026D818 /end MEASUREMENT
/begin MEASUREMENT ModelWithControllersOnly_B.Reshape9to3x3columnmajor_h "" FLOAT64_IEEE ModelWithControllersOnly_CM_double_1 0 0 -1.7E+308 1.7E+308 LAYOUT COLUMN_DIR MATRIX_DIM 3 3 ECU_ADDRESS 0x0026DCB0 /end MEASUREMENT
/begin MEASUREMENT ModelWithControllersOnly_B.Reshape9to3x3columnmajor_l "" FLOAT64_IEEE ModelWithControllersOnly_CM_double_1 0 0 -1.7E+308 1.7E+308 LAYOUT COLUMN_DIR MATRIX_DIM 3 3 ECU_ADDRESS 0x0026E130 /end MEASUREMENT
/begin MEASUREMENT ModelWithControllersOnly_B.Reshape9to3x3columnmajor_n "" FLOAT64_IEEE ModelWithControllersOnly_CM_double_1 0 0 -1.7E+308 1.7E+308 LAYOUT COLUMN_DIR MATRIX_DIM 3 3 ECU_ADDRESS 0x0026DA70 /end MEASUREMENT
/begin MEASUREMENT ModelWithControllersOnly_B.SteeringSaturation "" FLOAT64_IEEE ModelWithControllersOnly_CM_double 0 0 -1.7E+308 1.7E+308 ECU_ADDRESS 0x0026E1E0 /end MEASUREMENT
/begin MEASUREMENT ModelWithControllersOnly_B.Sum1 "" FLOAT64_IEEE ModelWithControllersOnly_CM_double_W 0 0 -1.7E+308 1.7E+308 LAYOUT COLUMN_DIR MATRIX_DIM 2 ECU_ADDRESS 0x0026E048 /end MEASUREMENT
/begin MEASUREMENT ModelWithControllersOnly_B.Sum_b "" FLOAT64_IEEE ModelWithControllersOnly_CM_double 0 0 -1.7E+308 1.7E+308 LAYOUT COLUMN_DIR MATRIX_DIM 3 ECU_ADDRESS 0x0026D950 /end MEASUREMENT
/begin MEASUREMENT ModelWithControllersOnly_B.Sum_c "" FLOAT64_IEEE ModelWithControllersOnly_CM_double 0 0 -1.7E+308 1.7E+308 ECU_ADDRESS 0x0026E180 /end MEASUREMENT
/begin MEASUREMENT ModelWithControllersOnly_B.Sum_e "" FLOAT64_IEEE ModelWithControllersOnly_CM_double_W 0 0 -1.7E+308 1.7E+308 ECU_ADDRESS 0x0026E058 /end MEASUREMENT
/begin MEASUREMENT ModelWithControllersOnly_B.Sum_f "" FLOAT64_IEEE ModelWithControllersOnly_CM_double 0 0 -1.7E+308 1.7E+308 LAYOUT COLUMN_DIR MATRIX_DIM 3 ECU_ADDRESS 0x0026DBA8 /end MEASUREMENT
/begin MEASUREMENT ModelWithControllersOnly_B.Sum_g "" FLOAT64_IEEE ModelWithControllersOnly_CM_double 0 0 -1.7E+308 1.7E+308 ECU_ADDRESS 0x0026E198 /end MEASUREMENT
/begin MEASUREMENT ModelWithControllersOnly_B.Sum_i "" FLOAT64_IEEE ModelWithControllersOnly_CM_double 0 0 -1.7E+308 1.7E+308 LAYOUT COLUMN_DIR MATRIX_DIM 3 ECU_ADDRESS 0x0026DDE8 /end MEASUREMENT
/begin MEASUREMENT ModelWithControllersOnly_B.Sum_m "" FLOAT64_IEEE ModelWithControllersOnly_CM_double 0 0 -1.7E+308 1.7E+308 LAYOUT COLUMN_DIR MATRIX_DIM 3 ECU_ADDRESS 0x0026D710 /end MEASUREMENT
/begin MEASUREMENT ModelWithControllersOnly_B.SumofElements1 "" FLOAT64_IEEE ModelWithControllersOnly_CM_double_W 0 0 -1.7E+308 1.7E+308 ECU_ADDRESS 0x0026DFC8 /end MEASUREMENT
/begin MEASUREMENT ModelWithControllersOnly_B.SumofElements2 "" FLOAT64_IEEE ModelWithControllersOnly_CM_double_W 0 0 -1.7E+308 1.7E+308 ECU_ADDRESS 0x0026E000 /end MEASUREMENT
/begin MEASUREMENT ModelWithControllersOnly_B.SumofElements3 "" FLOAT64_IEEE ModelWithControllersOnly_CM_double_W 0 0 -1.7E+308 1.7E+308 ECU_ADDRESS 0x0026E038 /end MEASUREMENT
/begin MEASUREMENT ModelWithControllersOnly_B.Switch_d "" FLOAT64_IEEE ModelWithControllersOnly_CM_double 0 0 -1.7E+308 1.7E+308 ECU_ADDRESS 0x0026D9E0 /end MEASUREMENT
/begin MEASUREMENT ModelWithControllersOnly_B.Switch_p "" FLOAT64_IEEE ModelWithControllersOnly_CM_double 0 0 -1.7E+308 1.7E+308 ECU_ADDRESS 0x0026E080 /end MEASUREMENT
/begin MEASUREMENT ModelWithControllersOnly_B.TbrakeNm "" FLOAT64_IEEE ModelWithControllersOnly_CM_double 0 0 -1.7E+308 1.7E+308 ECU_ADDRESS 0x0026E1C8 /end MEASUREMENT
/begin MEASUREMENT ModelWithControllersOnly_B.TengineNm "" FLOAT64_IEEE ModelWithControllersOnly_CM_double 0 0 -1.7E+308 1.7E+308 ECU_ADDRESS 0x0026E1B0 /end MEASUREMENT
/begin MEASUREMENT ModelWithControllersOnly_B.ThrottleSaturation_p "" FLOAT64_IEEE ModelWithControllersOnly_CM_double 0 0 -1.7E+308 1.7E+308 ECU_ADDRESS 0x0026E1A8 /end MEASUREMENT
/begin MEASUREMENT ModelWithControllersOnly_B.TmpSignalConversionAtSFunctio_n "" FLOAT64_IEEE ModelWithControllersOnly_CM_double_N_into_m 0 0 -1.7E+308 1.7E+308 LAYOUT COLUMN_DIR MATRIX_DIM 3 ECU_ADDRESS 0x0026E398 /end MEASUREMENT
/begin MEASUREMENT ModelWithControllersOnly_B.TmpSignalConversionAtSFunctionI "" FLOAT64_IEEE ModelWithControllersOnly_CM_double_N 0 0 -1.7E+308 1.7E+308 LAYOUT COLUMN_DIR MATRIX_DIM 3 ECU_ADDRESS 0x0026E380 /end MEASUREMENT
/begin MEASUREMENT ModelWithControllersOnly_B.TmpSignalConversionAtsincosInpo "" FLOAT64_IEEE ModelWithControllersOnly_CM_double_rad 0 0 -1.7E+308 1.7E+308 LAYOUT COLUMN_DIR MATRIX_DIM 3 ECU_ADDRESS 0x0026D548 /end MEASUREMENT
/begin MEASUREMENT ModelWithControllersOnly_B.Tnet "" FLOAT64_IEEE ModelWithControllersOnly_CM_double 0 0 -1.7E+308 1.7E+308 ECU_ADDRESS 0x0026E378 /end MEASUREMENT
/begin MEASUREMENT ModelWithControllersOnly_B.TnetNm_e "" FLOAT64_IEEE ModelWithControllersOnly_CM_double 0 0 -1.7E+308 1.7E+308 ECU_ADDRESS 0x0026E230 /end MEASUREMENT
/begin MEASUREMENT ModelWithControllersOnly_B.Transpose1 "" FLOAT64_IEEE ModelWithControllersOnly_CM_double 0 0 -1.7E+308 1.7E+308 LAYOUT COLUMN_DIR MATRIX_DIM 3 3 ECU_ADDRESS 0x0026D620 /end MEASUREMENT
/begin MEASUREMENT ModelWithControllersOnly_B.Transpose1_a "" FLOAT64_IEEE ModelWithControllersOnly_CM_double 0 0 -1.7E+308 1.7E+308 LAYOUT COLUMN_DIR MATRIX_DIM 3 3 ECU_ADDRESS 0x0026D860 /end MEASUREMENT
/begin MEASUREMENT ModelWithControllersOnly_B.Transpose1_k "" FLOAT64_IEEE ModelWithControllersOnly_CM_double 0 0 -1.7E+308 1.7E+308 LAYOUT COLUMN_DIR MATRIX_DIM 3 3 ECU_ADDRESS 0x0026DAB8 /end MEASUREMENT
/begin MEASUREMENT ModelWithControllersOnly_B.Transpose1_m "" FLOAT64_IEEE ModelWithControllersOnly_CM_double 0 0 -1.7E+308 1.7E+308 LAYOUT COLUMN_DIR MATRIX_DIM 3 3 ECU_ADDRESS 0x0026DCF8 /end MEASUREMENT
/begin MEASUREMENT ModelWithControllersOnly_B.UnaryMinus5 "" FLOAT64_IEEE ModelWithControllersOnly_CM_double_W 0 0 -1.7E+308 1.7E+308 ECU_ADDRESS 0x0026E040 /end MEASUREMENT
/begin MEASUREMENT ModelWithControllersOnly_B.UnitConversion "" FLOAT64_IEEE ModelWithControllersOnly_CM_double_gn 0 0 -1.7E+308 1.7E+308 ECU_ADDRESS 0x0026DF78 /end MEASUREMENT
/begin MEASUREMENT ModelWithControllersOnly_B.UnitConversion1_f "" FLOAT64_IEEE ModelWithControllersOnly_CM_double_m_per_s_2 0 0 -1.7E+308 1.7E+308 ECU_ADDRESS 0x0026DF80 /end MEASUREMENT
/begin MEASUREMENT ModelWithControllersOnly_B.UnitConversion1_n "" FLOAT64_IEEE ModelWithControllersOnly_CM_double_gn 0 0 -1.7E+308 1.7E+308 ECU_ADDRESS 0x0026DF50 /end MEASUREMENT
/begin MEASUREMENT ModelWithControllersOnly_B.UnitConversion2 "" FLOAT64_IEEE ModelWithControllersOnly_CM_double_m_per_s_2 0 0 -1.7E+308 1.7E+308 ECU_ADDRESS 0x0026DF58 /end MEASUREMENT
/begin MEASUREMENT ModelWithControllersOnly_B.UnitDelay_p "" FLOAT64_IEEE ModelWithControllersOnly_CM_double 0 0 -1.7E+308 1.7E+308 ECU_ADDRESS 0x0026E1D0 /end MEASUREMENT
/begin MEASUREMENT ModelWithControllersOnly_B.V_wb "" FLOAT64_IEEE ModelWithControllersOnly_CM_double_m_per_s 0 0 -1.7E+308 1.7E+308 LAYOUT COLUMN_DIR MATRIX_DIM 3 ECU_ADDRESS 0x0026D788 /end MEASUREMENT
/begin MEASUREMENT ModelWithControllersOnly_B.V_wb_e "" FLOAT64_IEEE ModelWithControllersOnly_CM_double_m_per_s 0 0 -1.7E+308 1.7E+308 LAYOUT COLUMN_DIR MATRIX_DIM 3 ECU_ADDRESS 0x0026DE60 /end MEASUREMENT
/begin MEASUREMENT ModelWithControllersOnly_B.V_wb_g "" FLOAT64_IEEE ModelWithControllersOnly_CM_double_m_per_s 0 0 -1.7E+308 1.7E+308 LAYOUT COLUMN_DIR MATRIX_DIM 3 ECU_ADDRESS 0x0026DC20 /end MEASUREMENT
/begin MEASUREMENT ModelWithControllersOnly_B.V_wb_p "" FLOAT64_IEEE ModelWithControllersOnly_CM_double_m_per_s 0 0 -1.7E+308 1.7E+308 LAYOUT COLUMN_DIR MATRIX_DIM 3 ECU_ADDRESS 0x0026D9C8 /end MEASUREMENT
/begin MEASUREMENT ModelWithControllersOnly_B.VectorConcatenate1_i "" FLOAT64_IEEE ModelWithControllersOnly_CM_double_rad 0 0 -1.7E+308 1.7E+308 LAYOUT COLUMN_DIR MATRIX_DIM 2 ECU_ADDRESS 0x0026E070 /end MEASUREMENT
/begin MEASUREMENT ModelWithControllersOnly_B.VectorConcatenate1_n "" FLOAT64_IEEE ModelWithControllersOnly_CM_double 0 0 -1.7E+308 1.7E+308 LAYOUT COLUMN_DIR MATRIX_DIM 6 ECU_ADDRESS 0x0026DF98 /end MEASUREMENT
/begin MEASUREMENT ModelWithControllersOnly_B.VectorConcatenate2_o "" FLOAT64_IEEE ModelWithControllersOnly_CM_double 0 0 -1.7E+308 1.7E+308 LAYOUT COLUMN_DIR MATRIX_DIM 6 ECU_ADDRESS 0x0026DFD0 /end MEASUREMENT
/begin MEASUREMENT ModelWithControllersOnly_B.VectorConcatenate3_l "" FLOAT64_IEEE ModelWithControllersOnly_CM_double 0 0 -1.7E+308 1.7E+308 LAYOUT COLUMN_DIR MATRIX_DIM 6 ECU_ADDRESS 0x0026E008 /end MEASUREMENT
/begin MEASUREMENT ModelWithControllersOnly_B.VectorConcatenate_bj "" FLOAT64_IEEE ModelWithControllersOnly_CM_double 0 0 -1.7E+308 1.7E+308 LAYOUT COLUMN_DIR MATRIX_DIM 9 ECU_ADDRESS 0x0026D7D0 /end MEASUREMENT
/begin MEASUREMENT ModelWithControllersOnly_B.VectorConcatenate_bx "" FLOAT64_IEEE ModelWithControllersOnly_CM_double 0 0 -1.7E+308 1.7E+308 LAYOUT COLUMN_DIR MATRIX_DIM 9 ECU_ADDRESS 0x0026DC68 /end MEASUREMENT
/begin MEASUREMENT ModelWithControllersOnly_B.VectorConcatenate_c "" FLOAT64_IEEE ModelWithControllersOnly_CM_double_m 0 0 -1.7E+308 1.7E+308 LAYOUT COLUMN_DIR MATRIX_DIM 3 ECU_ADDRESS 0x0026D8A8 /end MEASUREMENT
/begin MEASUREMENT ModelWithControllersOnly_B.VectorConcatenate_d "" FLOAT64_IEEE ModelWithControllersOnly_CM_double_m 0 0 -1.7E+308 1.7E+308 LAYOUT COLUMN_DIR MATRIX_DIM 3 ECU_ADDRESS 0x0026D668 /end MEASUREMENT
/begin MEASUREMENT ModelWithControllersOnly_B.VectorConcatenate_f "" FLOAT64_IEEE ModelWithControllersOnly_CM_double 0 0 -1.7E+308 1.7E+308 LAYOUT COLUMN_DIR MATRIX_DIM 9 ECU_ADDRESS 0x0026D590 /end MEASUREMENT
/begin MEASUREMENT ModelWithControllersOnly_B.VectorConcatenate_f5 "" FLOAT64_IEEE ModelWithControllersOnly_CM_double 0 0 -1.7E+308 1.7E+308 LAYOUT COLUMN_DIR MATRIX_DIM 9 ECU_ADDRESS 0x0026DA28 /end MEASUREMENT
/begin MEASUREMENT ModelWithControllersOnly_B.VectorConcatenate_h "" FLOAT64_IEEE ModelWithControllersOnly_CM_double_m 0 0 -1.7E+308 1.7E+308 LAYOUT COLUMN_DIR MATRIX_DIM 3 ECU_ADDRESS 0x0026DD40 /end MEASUREMENT
/begin MEASUREMENT ModelWithControllersOnly_B.VectorConcatenate_j "" FLOAT64_IEEE ModelWithControllersOnly_CM_double_rad 0 0 -1.7E+308 1.7E+308 LAYOUT COLUMN_DIR MATRIX_DIM 2 ECU_ADDRESS 0x0026E060 /end MEASUREMENT
/begin MEASUREMENT ModelWithControllersOnly_B.VectorConcatenate_jc "" FLOAT64_IEEE ModelWithControllersOnly_CM_double 0 0 -1.7E+308 1.7E+308 LAYOUT COLUMN_DIR MATRIX_DIM 9 ECU_ADDRESS 0x0026E0E8 /end MEASUREMENT
/begin MEASUREMENT ModelWithControllersOnly_B.VectorConcatenate_o "" FLOAT64_IEEE ModelWithControllersOnly_CM_double_m 0 0 -1.7E+308 1.7E+308 LAYOUT COLUMN_DIR MATRIX_DIM 3 ECU_ADDRESS 0x0026DB00 /end MEASUREMENT
/begin MEASUREMENT ModelWithControllersOnly_B.ax "" FLOAT64_IEEE ModelWithControllersOnly_CM_double_m_per_s_2 0 0 -1.7E+308 1.7E+308 ECU_ADDRESS 0x0026DF48 /end MEASUREMENT
/begin MEASUREMENT ModelWithControllersOnly_B.ay "" FLOAT64_IEEE ModelWithControllersOnly_CM_double_m_per_s_2 0 0 -1.7E+308 1.7E+308 ECU_ADDRESS 0x0026DF70 /end MEASUREMENT
/begin MEASUREMENT ModelWithControllersOnly_B.az "" FLOAT64_IEEE ModelWithControllersOnly_CM_double_gn 0 0 -1.7E+308 1.7E+308 ECU_ADDRESS 0x0026E098 /end MEASUREMENT
/begin MEASUREMENT ModelWithControllersOnly_B.ixj "" FLOAT64_IEEE ModelWithControllersOnly_CM_double 0 0 -1.7E+308 1.7E+308 ECU_ADDRESS 0x0026D6F0 /end MEASUREMENT
/begin MEASUREMENT ModelWithControllersOnly_B.ixj_c "" FLOAT64_IEEE ModelWithControllersOnly_CM_double 0 0 -1.7E+308 1.7E+308 ECU_ADDRESS 0x0026DDC8 /end MEASUREMENT
/begin MEASUREMENT ModelWithControllersOnly_B.ixj_d "" FLOAT64_IEEE ModelWithControllersOnly_CM_double 0 0 -1.7E+308 1.7E+308 ECU_ADDRESS 0x0026D930 /end MEASUREMENT
/begin MEASUREMENT ModelWithControllersOnly_B.ixj_e "" FLOAT64_IEEE ModelWithControllersOnly_CM_double 0 0 -1.7E+308 1.7E+308 ECU_ADDRESS 0x0026DB88 /end MEASUREMENT
/begin MEASUREMENT ModelWithControllersOnly_B.ixk "" FLOAT64_IEEE ModelWithControllersOnly_CM_double 0 0 -1.7E+308 1.7E+308 ECU_ADDRESS 0x0026D700 /end MEASUREMENT
/begin MEASUREMENT ModelWithControllersOnly_B.ixk_j "" FLOAT64_IEEE ModelWithControllersOnly_CM_double 0 0 -1.7E+308 1.7E+308 ECU_ADDRESS 0x0026D940 /end MEASUREMENT
/begin MEASUREMENT ModelWithControllersOnly_B.ixk_m "" FLOAT64_IEEE ModelWithControllersOnly_CM_double 0 0 -1.7E+308 1.7E+308 ECU_ADDRESS 0x0026DB98 /end MEASUREMENT
/begin MEASUREMENT ModelWithControllersOnly_B.ixk_p "" FLOAT64_IEEE ModelWithControllersOnly_CM_double 0 0 -1.7E+308 1.7E+308 ECU_ADDRESS 0x0026DDD8 /end MEASUREMENT
/begin MEASUREMENT ModelWithControllersOnly_B.jxi "" FLOAT64_IEEE ModelWithControllersOnly_CM_double 0 0 -1.7E+308 1.7E+308 ECU_ADDRESS 0x0026D708 /end MEASUREMENT
/begin MEASUREMENT ModelWithControllersOnly_B.jxi_h "" FLOAT64_IEEE ModelWithControllersOnly_CM_double 0 0 -1.7E+308 1.7E+308 ECU_ADDRESS 0x0026DBA0 /end MEASUREMENT
/begin MEASUREMENT ModelWithControllersOnly_B.jxi_h1 "" FLOAT64_IEEE ModelWithControllersOnly_CM_double 0 0 -1.7E+308 1.7E+308 ECU_ADDRESS 0x0026DDE0 /end MEASUREMENT
/begin MEASUREMENT ModelWithControllersOnly_B.jxi_i "" FLOAT64_IEEE ModelWithControllersOnly_CM_double 0 0 -1.7E+308 1.7E+308 ECU_ADDRESS 0x0026D948 /end MEASUREMENT
/begin MEASUREMENT ModelWithControllersOnly_B.jxk "" FLOAT64_IEEE ModelWithControllersOnly_CM_double 0 0 -1.7E+308 1.7E+308 ECU_ADDRESS 0x0026D6E0 /end MEASUREMENT
/begin MEASUREMENT ModelWithControllersOnly_B.jxk_b "" FLOAT64_IEEE ModelWithControllersOnly_CM_double 0 0 -1.7E+308 1.7E+308 ECU_ADDRESS 0x0026DDB8 /end MEASUREMENT
/begin MEASUREMENT ModelWithControllersOnly_B.jxk_j "" FLOAT64_IEEE ModelWithControllersOnly_CM_double 0 0 -1.7E+308 1.7E+308 ECU_ADDRESS 0x0026D920 /end MEASUREMENT
/begin MEASUREMENT ModelWithControllersOnly_B.jxk_m "" FLOAT64_IEEE ModelWithControllersOnly_CM_double 0 0 -1.7E+308 1.7E+308 ECU_ADDRESS 0x0026DB78 /end MEASUREMENT
/begin MEASUREMENT ModelWithControllersOnly_B.kxi "" FLOAT64_IEEE ModelWithControllersOnly_CM_double 0 0 -1.7E+308 1.7E+308 ECU_ADDRESS 0x0026D6E8 /end MEASUREMENT
/begin MEASUREMENT ModelWithControllersOnly_B.kxi_e "" FLOAT64_IEEE ModelWithControllersOnly_CM_double 0 0 -1.7E+308 1.7E+308 ECU_ADDRESS 0x0026DDC0 /end MEASUREMENT
/begin MEASUREMENT ModelWithControllersOnly_B.kxi_g "" FLOAT64_IEEE ModelWithControllersOnly_CM_double 0 0 -1.7E+308 1.7E+308 ECU_ADDRESS 0x0026D928 /end MEASUREMENT
/begin MEASUREMENT ModelWithControllersOnly_B.kxi_k "" FLOAT64_IEEE ModelWithControllersOnly_CM_double 0 0 -1.7E+308 1.7E+308 ECU_ADDRESS 0x0026DB80 /end MEASUREMENT
/begin MEASUREMENT ModelWithControllersOnly_B.kxj "" FLOAT64_IEEE ModelWithControllersOnly_CM_double 0 0 -1.7E+308 1.7E+308 ECU_ADDRESS 0x0026D6F8 /end MEASUREMENT
/begin MEASUREMENT ModelWithControllersOnly_B.kxj_b "" FLOAT64_IEEE ModelWithControllersOnly_CM_double 0 0 -1.7E+308 1.7E+308 ECU_ADDRESS 0x0026DB90 /end MEASUREMENT
/begin MEASUREMENT ModelWithControllersOnly_B.kxj_f "" FLOAT64_IEEE ModelWithControllersOnly_CM_double 0 0 -1.7E+308 1.7E+308 ECU_ADDRESS 0x0026DDD0 /end MEASUREMENT
/begin MEASUREMENT ModelWithControllersOnly_B.kxj_j "" FLOAT64_IEEE ModelWithControllersOnly_CM_double 0 0 -1.7E+308 1.7E+308 ECU_ADDRESS 0x0026D938 /end MEASUREMENT
/begin MEASUREMENT ModelWithControllersOnly_B.lateral "" FLOAT64_IEEE ModelWithControllersOnly_CM_double 0 0 -1.7E+308 1.7E+308 ECU_ADDRESS 0x0026E178 /end MEASUREMENT
/begin MEASUREMENT ModelWithControllersOnly_B.lateral_g "" FLOAT64_IEEE ModelWithControllersOnly_CM_double 0 0 -1.7E+308 1.7E+308 ECU_ADDRESS 0x0026E190 /end MEASUREMENT
/begin MEASUREMENT ModelWithControllersOnly_B.rollingresistance "" FLOAT64_IEEE ModelWithControllersOnly_CM_double 0 0 -1.7E+308 1.7E+308 ECU_ADDRESS 0x0026E228 /end MEASUREMENT
/begin MEASUREMENT ModelWithControllersOnly_B.sincos_o1 "" FLOAT64_IEEE ModelWithControllersOnly_CM_double 0 0 -1.7E+308 1.7E+308 LAYOUT COLUMN_DIR MATRIX_DIM 3 ECU_ADDRESS 0x0026D560 /end MEASUREMENT
/begin MEASUREMENT ModelWithControllersOnly_B.sincos_o1_b "" FLOAT64_IEEE ModelWithControllersOnly_CM_double 0 0 -1.7E+308 1.7E+308 LAYOUT COLUMN_DIR MATRIX_DIM 3 ECU_ADDRESS 0x0026DC38 /end MEASUREMENT
/begin MEASUREMENT ModelWithControllersOnly_B.sincos_o1_bs "" FLOAT64_IEEE ModelWithControllersOnly_CM_double 0 0 -1.7E+308 1.7E+308 LAYOUT COLUMN_DIR MATRIX_DIM 3 ECU_ADDRESS 0x0026E0B8 /end MEASUREMENT
/begin MEASUREMENT ModelWithControllersOnly_B.sincos_o1_h "" FLOAT64_IEEE ModelWithControllersOnly_CM_double 0 0 -1.7E+308 1.7E+308 LAYOUT COLUMN_DIR MATRIX_DIM 3 ECU_ADDRESS 0x0026D7A0 /end MEASUREMENT
/begin MEASUREMENT ModelWithControllersOnly_B.sincos_o1_n "" FLOAT64_IEEE ModelWithControllersOnly_CM_double 0 0 -1.7E+308 1.7E+308 LAYOUT COLUMN_DIR MATRIX_DIM 3 ECU_ADDRESS 0x0026D9F8 /end MEASUREMENT
/begin MEASUREMENT ModelWithControllersOnly_B.sincos_o2 "" FLOAT64_IEEE ModelWithControllersOnly_CM_double 0 0 -1.7E+308 1.7E+308 LAYOUT COLUMN_DIR MATRIX_DIM 3 ECU_ADDRESS 0x0026D578 /end MEASUREMENT
/begin MEASUREMENT ModelWithControllersOnly_B.sincos_o2_f "" FLOAT64_IEEE ModelWithControllersOnly_CM_double 0 0 -1.7E+308 1.7E+308 LAYOUT COLUMN_DIR MATRIX_DIM 3 ECU_ADDRESS 0x0026E0D0 /end MEASUREMENT
/begin MEASUREMENT ModelWithControllersOnly_B.sincos_o2_g "" FLOAT64_IEEE ModelWithControllersOnly_CM_double 0 0 -1.7E+308 1.7E+308 LAYOUT COLUMN_DIR MATRIX_DIM 3 ECU_ADDRESS 0x0026D7B8 /end MEASUREMENT
/begin MEASUREMENT ModelWithControllersOnly_B.sincos_o2_gp "" FLOAT64_IEEE ModelWithControllersOnly_CM_double 0 0 -1.7E+308 1.7E+308 LAYOUT COLUMN_DIR MATRIX_DIM 3 ECU_ADDRESS 0x0026DC50 /end MEASUREMENT
/begin MEASUREMENT ModelWithControllersOnly_B.sincos_o2_k "" FLOAT64_IEEE ModelWithControllersOnly_CM_double 0 0 -1.7E+308 1.7E+308 LAYOUT COLUMN_DIR MATRIX_DIM 3 ECU_ADDRESS 0x0026DA10 /end MEASUREMENT
/begin MEASUREMENT ModelWithControllersOnly_B.steeringwheelangledeg "" FLOAT64_IEEE ModelWithControllersOnly_CM_double 0 0 -1.7E+308 1.7E+308 ECU_ADDRESS 0x0026E1E8 /end MEASUREMENT
/begin MEASUREMENT ModelWithControllersOnly_B.steeringwheelanglerad "" FLOAT64_IEEE ModelWithControllersOnly_CM_double_rad 0 0 -1.7E+308 1.7E+308 ECU_ADDRESS 0x0026E1F0 /end MEASUREMENT
/begin MEASUREMENT ModelWithControllersOnly_B.uDLookupTable "" FLOAT64_IEEE ModelWithControllersOnly_CM_double 0 0 -1.7E+308 1.7E+308 ECU_ADDRESS 0x0026E1F8 /end MEASUREMENT
/begin MEASUREMENT ModelWithControllersOnly_B.uDLookupTable1 "" FLOAT64_IEEE ModelWithControllersOnly_CM_double_rad 0 0 -1.7E+308 1.7E+308 ECU_ADDRESS 0x0026E208 /end MEASUREMENT
/begin MEASUREMENT ModelWithControllersOnly_B.uDLookupTable_c "" FLOAT64_IEEE ModelWithControllersOnly_CM_double_rad 0 0 -1.7E+308 1.7E+308 ECU_ADDRESS 0x0026E210 /end MEASUREMENT
/begin MEASUREMENT ModelWithControllersOnly_B.zddot "" FLOAT64_IEEE ModelWithControllersOnly_CM_double_m_per_s_2 0 0 -1.7E+308 1.7E+308 ECU_ADDRESS 0x0026E0A8 /end MEASUREMENT
/begin MEASUREMENT ModelWithControllersOnly_DW.Forward_SubsysRanBC "" SBYTE ModelWithControllersOnly_CM_int8 0 0 -128 127 ECU_ADDRESS 0x0026CFC7 /end MEASUREMENT
/begin MEASUREMENT ModelWithControllersOnly_DW.Reverse_SubsysRanBC "" SBYTE ModelWithControllersOnly_CM_int8 0 0 -128 127 ECU_ADDRESS 0x0026CFC5 /end MEASUREMENT
/begin MEASUREMENT ModelWithControllersOnly_DW.TmpRTBAtEqual1Inport1_Buf0 "" FLOAT64_IEEE ModelWithControllersOnly_CM_double 0 0 -1.7E+308 1.7E+308 ECU_ADDRESS 0x0026CA48 /end MEASUREMENT
/begin MEASUREMENT ModelWithControllersOnly_DW.TmpRTBAtEqual1Inport1_Buf1 "" FLOAT64_IEEE ModelWithControllersOnly_CM_double 0 0 -1.7E+308 1.7E+308 ECU_ADDRESS 0x0026CA50 /end MEASUREMENT
/begin MEASUREMENT ModelWithControllersOnly_DW.TmpRTBAtEqual1Inport1_Buf2 "" FLOAT64_IEEE ModelWithControllersOnly_CM_double 0 0 -1.7E+308 1.7E+308 ECU_ADDRESS 0x0026CA58 /end MEASUREMENT
/begin MEASUREMENT ModelWithControllersOnly_DW.TmpRTBAtEqual1Inport1_LstBufWR "" SBYTE ModelWithControllersOnly_CM_int8 0 0 -128 127 ECU_ADDRESS 0x0026CF88 /end MEASUREMENT
/begin MEASUREMENT ModelWithControllersOnly_DW.TmpRTBAtEqual1Inport1_RDBuf "" SBYTE ModelWithControllersOnly_CM_int8 0 0 -128 127 ECU_ADDRESS 0x0026CF89 /end MEASUREMENT
/begin MEASUREMENT ModelWithControllersOnly_DW.TmpRTBAtEqual2Inport1_Buf0 "" FLOAT64_IEEE ModelWithControllersOnly_CM_double 0 0 -1.7E+308 1.7E+308 ECU_ADDRESS 0x0026CA60 /end MEASUREMENT
/begin MEASUREMENT ModelWithControllersOnly_DW.TmpRTBAtEqual2Inport1_Buf1 "" FLOAT64_IEEE ModelWithControllersOnly_CM_double 0 0 -1.7E+308 1.7E+308 ECU_ADDRESS 0x0026CA68 /end MEASUREMENT
/begin MEASUREMENT ModelWithControllersOnly_DW.TmpRTBAtEqual2Inport1_Buf2 "" FLOAT64_IEEE ModelWithControllersOnly_CM_double 0 0 -1.7E+308 1.7E+308 ECU_ADDRESS 0x0026CA70 /end MEASUREMENT
/begin MEASUREMENT ModelWithControllersOnly_DW.TmpRTBAtEqual2Inport1_LstBufWR "" SBYTE ModelWithControllersOnly_CM_int8 0 0 -128 127 ECU_ADDRESS 0x0026CF8A /end MEASUREMENT
/begin MEASUREMENT ModelWithControllersOnly_DW.TmpRTBAtEqual2Inport1_RDBuf "" SBYTE ModelWithControllersOnly_CM_int8 0 0 -128 127 ECU_ADDRESS 0x0026CF8B /end MEASUREMENT
/begin MEASUREMENT ModelWithControllersOnly_DW.TmpRTBAtEqual4Inport2_Buf0 "" FLOAT64_IEEE ModelWithControllersOnly_CM_double 0 0 -1.7E+308 1.7E+308 ECU_ADDRESS 0x0026CA78 /end MEASUREMENT
/begin MEASUREMENT ModelWithControllersOnly_DW.TmpRTBAtEqual4Inport2_Buf1 "" FLOAT64_IEEE ModelWithControllersOnly_CM_double 0 0 -1.7E+308 1.7E+308 ECU_ADDRESS 0x0026CA80 /end MEASUREMENT
/begin MEASUREMENT ModelWithControllersOnly_DW.TmpRTBAtEqual4Inport2_Buf2 "" FLOAT64_IEEE ModelWithControllersOnly_CM_double 0 0 -1.7E+308 1.7E+308 ECU_ADDRESS 0x0026CA88 /end MEASUREMENT
/begin MEASUREMENT ModelWithControllersOnly_DW.TmpRTBAtEqual4Inport2_LstBufWR "" SBYTE ModelWithControllersOnly_CM_int8 0 0 -128 127 ECU_ADDRESS 0x0026CF8C /end MEASUREMENT
/begin MEASUREMENT ModelWithControllersOnly_DW.TmpRTBAtEqual4Inport2_RDBuf "" SBYTE ModelWithControllersOnly_CM_int8 0 0 -128 127 ECU_ADDRESS 0x0026CF8D /end MEASUREMENT
/begin MEASUREMENT ModelWithControllersOnly_DW.TmpRTBAtEqual5Inport2_Buf0 "" FLOAT64_IEEE ModelWithControllersOnly_CM_double 0 0 -1.7E+308 1.7E+308 ECU_ADDRESS 0x0026CA90 /end MEASUREMENT
/begin MEASUREMENT ModelWithControllersOnly_DW.TmpRTBAtEqual5Inport2_Buf1 "" FLOAT64_IEEE ModelWithControllersOnly_CM_double 0 0 -1.7E+308 1.7E+308 ECU_ADDRESS 0x0026CA98 /end MEASUREMENT
/begin MEASUREMENT ModelWithControllersOnly_DW.TmpRTBAtEqual5Inport2_Buf2 "" FLOAT64_IEEE ModelWithControllersOnly_CM_double 0 0 -1.7E+308 1.7E+308 ECU_ADDRESS 0x0026CAA0 /end MEASUREMENT
/begin MEASUREMENT ModelWithControllersOnly_DW.TmpRTBAtEqual5Inport2_LstBufWR "" SBYTE ModelWithControllersOnly_CM_int8 0 0 -128 127 ECU_ADDRESS 0x0026CF8E /end MEASUREMENT
/begin MEASUREMENT ModelWithControllersOnly_DW.TmpRTBAtEqual5Inport2_RDBuf "" SBYTE ModelWithControllersOnly_CM_int8 0 0 -128 127 ECU_ADDRESS 0x0026CF8F /end MEASUREMENT
/begin MEASUREMENT ModelWithControllersOnly_DW.TmpRTBAtIntegratorInport1_Buf "" FLOAT64_IEEE ModelWithControllersOnly_CM_double 0 0 -1.7E+308 1.7E+308 LAYOUT COLUMN_DIR MATRIX_DIM 2 ECU_ADDRESS 0x0026CB48 /end MEASUREMENT
/begin MEASUREMENT ModelWithControllersOnly_DW.TmpRTBAtIntegratorInport1_Buf_p "" FLOAT64_IEEE ModelWithControllersOnly_CM_double 0 0 -1.7E+308 1.7E+308 LAYOUT COLUMN_DIR MATRIX_DIM 2 ECU_ADDRESS 0x0026CB58 /end MEASUREMENT
/begin MEASUREMENT ModelWithControllersOnly_DW.TmpRTBAtIntegratorInport1_RdB_k "" SBYTE ModelWithControllersOnly_CM_int8 0 0 -128 127 ECU_ADDRESS 0x0026CFA4 /end MEASUREMENT
/begin MEASUREMENT ModelWithControllersOnly_DW.TmpRTBAtIntegratorInport1_RdBuf "" SBYTE ModelWithControllersOnly_CM_int8 0 0 -128 127 ECU_ADDRESS 0x0026CFA2 /end MEASUREMENT
/begin MEASUREMENT ModelWithControllersOnly_DW.TmpRTBAtIntegratorInport1_WrB_k "" SBYTE ModelWithControllersOnly_CM_int8 0 0 -128 127 ECU_ADDRESS 0x0026CFA5 /end MEASUREMENT
/begin MEASUREMENT ModelWithControllersOnly_DW.TmpRTBAtIntegratorInport1_WrBuf "" SBYTE ModelWithControllersOnly_CM_int8 0 0 -128 127 ECU_ADDRESS 0x0026CFA3 /end MEASUREMENT
/begin MEASUREMENT ModelWithControllersOnly_DW.TmpRTBAtIntegratorInport2_Buf "" FLOAT64_IEEE ModelWithControllersOnly_CM_double 0 0 -1.7E+308 1.7E+308 LAYOUT COLUMN_DIR MATRIX_DIM 2 ECU_ADDRESS 0x0026CB08 /end MEASUREMENT
/begin MEASUREMENT ModelWithControllersOnly_DW.TmpRTBAtIntegratorInport2_Buf_m "" FLOAT64_IEEE ModelWithControllersOnly_CM_double 0 0 -1.7E+308 1.7E+308 LAYOUT COLUMN_DIR MATRIX_DIM 2 ECU_ADDRESS 0x0026CB28 /end MEASUREMENT
/begin MEASUREMENT ModelWithControllersOnly_DW.TmpRTBAtIntegratorInport2_RdB_d "" SBYTE ModelWithControllersOnly_CM_int8 0 0 -128 127 ECU_ADDRESS 0x0026CF9E /end MEASUREMENT
/begin MEASUREMENT ModelWithControllersOnly_DW.TmpRTBAtIntegratorInport2_RdBuf "" SBYTE ModelWithControllersOnly_CM_int8 0 0 -128 127 ECU_ADDRESS 0x0026CF9A /end MEASUREMENT
/begin MEASUREMENT ModelWithControllersOnly_DW.TmpRTBAtIntegratorInport2_WrB_d "" SBYTE ModelWithControllersOnly_CM_int8 0 0 -128 127 ECU_ADDRESS 0x0026CF9F /end MEASUREMENT
/begin MEASUREMENT ModelWithControllersOnly_DW.TmpRTBAtIntegratorInport2_WrBuf "" SBYTE ModelWithControllersOnly_CM_int8 0 0 -128 127 ECU_ADDRESS 0x0026CF9B /end MEASUREMENT
/begin MEASUREMENT ModelWithControllersOnly_DW.TmpRTBAtMATLABFunction1Inpor_oh "" SBYTE ModelWithControllersOnly_CM_int8 0 0 -128 127 ECU_ADDRESS 0x0026CFB0 /end MEASUREMENT
/begin MEASUREMENT ModelWithControllersOnly_DW.TmpRTBAtMATLABFunction1Inport1_ "" FLOAT64_IEEE ModelWithControllersOnly_CM_double 0 0 -1.7E+308 1.7E+308 LAYOUT COLUMN_DIR MATRIX_DIM 2 ECU_ADDRESS 0x0026CC58 /end MEASUREMENT
/begin MEASUREMENT ModelWithControllersOnly_DW.TmpRTBAtMATLABFunction1Inport2_ "" FLOAT64_IEEE ModelWithControllersOnly_CM_double 0 0 -1.7E+308 1.7E+308 LAYOUT COLUMN_DIR MATRIX_DIM 2 ECU_ADDRESS 0x0026CC68 /end MEASUREMENT
/begin MEASUREMENT ModelWithControllersOnly_DW.TmpRTBAtMATLABFunction1Inport3_ "" FLOAT64_IEEE ModelWithControllersOnly_CM_double 0 0 -1.7E+308 1.7E+308 ECU_ADDRESS 0x0026CC78 /end MEASUREMENT
/begin MEASUREMENT ModelWithControllersOnly_DW.TmpRTBAtMATLABFunction1Inport_b "" SBYTE ModelWithControllersOnly_CM_int8 0 0 -128 127 ECU_ADDRESS 0x0026CFB1 /end MEASUREMENT
/begin MEASUREMENT ModelWithControllersOnly_DW.TmpRTBAtMATLABFunction1Inport_f "" FLOAT64_IEEE ModelWithControllersOnly_CM_double 0 0 -1.7E+308 1.7E+308 ECU_ADDRESS 0x0026CC80 /end MEASUREMENT
/begin MEASUREMENT ModelWithControllersOnly_DW.TmpRTBAtMATLABFunction1Inport_h "" SBYTE ModelWithControllersOnly_CM_int8 0 0 -128 127 ECU_ADDRESS 0x0026CFAC /end MEASUREMENT
/begin MEASUREMENT ModelWithControllersOnly_DW.TmpRTBAtMATLABFunction1Inport_j "" SBYTE ModelWithControllersOnly_CM_int8 0 0 -128 127 ECU_ADDRESS 0x0026CFAD /end MEASUREMENT
/begin MEASUREMENT ModelWithControllersOnly_DW.TmpRTBAtMATLABFunction1Inport_m "" SBYTE ModelWithControllersOnly_CM_int8 0 0 -128 127 ECU_ADDRESS 0x0026CFAF /end MEASUREMENT
/begin MEASUREMENT ModelWithControllersOnly_DW.TmpRTBAtMATLABFunction1Inport_o "" FLOAT64_IEEE ModelWithControllersOnly_CM_double 0 0 -1.7E+308 1.7E+308 ECU_ADDRESS 0x0026CC88 /end MEASUREMENT
/begin MEASUREMENT ModelWithControllersOnly_DW.TmpRTBAtMATLABFunction1Inport_p "" SBYTE ModelWithControllersOnly_CM_int8 0 0 -128 127 ECU_ADDRESS 0x0026CFAE /end MEASUREMENT
/begin MEASUREMENT ModelWithControllersOnly_DW.TmpRTBAtMATLABFunction2Inport1_ "" FLOAT64_IEEE ModelWithControllersOnly_CM_double 0 0 -1.7E+308 1.7E+308 LAYOUT COLUMN_DIR MATRIX_DIM 2 ECU_ADDRESS 0x0026CC90 /end MEASUREMENT
/begin MEASUREMENT ModelWithControllersOnly_DW.TmpRTBAtMATLABFunction2Inport2_ "" FLOAT64_IEEE ModelWithControllersOnly_CM_double 0 0 -1.7E+308 1.7E+308 LAYOUT COLUMN_DIR MATRIX_DIM 2 ECU_ADDRESS 0x0026CCA0 /end MEASUREMENT
/begin MEASUREMENT ModelWithControllersOnly_DW.TmpRTBAtMATLABFunction2Inport3_ "" FLOAT64_IEEE ModelWithControllersOnly_CM_double 0 0 -1.7E+308 1.7E+308 LAYOUT COLUMN_DIR MATRIX_DIM 2 ECU_ADDRESS 0x0026CCB0 /end MEASUREMENT
/begin MEASUREMENT ModelWithControllersOnly_DW.TmpRTBAtMATLABFunction2Inport_a "" SBYTE ModelWithControllersOnly_CM_int8 0 0 -128 127 ECU_ADDRESS 0x0026CFB6 /end MEASUREMENT
/begin MEASUREMENT ModelWithControllersOnly_DW.TmpRTBAtMATLABFunction2Inport_d "" SBYTE ModelWithControllersOnly_CM_int8 0 0 -128 127 ECU_ADDRESS 0x0026CFB3 /end MEASUREMENT
/begin MEASUREMENT ModelWithControllersOnly_DW.TmpRTBAtMATLABFunction2Inport_e "" SBYTE ModelWithControllersOnly_CM_int8 0 0 -128 127 ECU_ADDRESS 0x0026CFB2 /end MEASUREMENT
/begin MEASUREMENT ModelWithControllersOnly_DW.TmpRTBAtMATLABFunction2Inport_k "" SBYTE ModelWithControllersOnly_CM_int8 0 0 -128 127 ECU_ADDRESS 0x0026CFB5 /end MEASUREMENT
/begin MEASUREMENT ModelWithControllersOnly_DW.TmpRTBAtMATLABFunction2Inport_m "" SBYTE ModelWithControllersOnly_CM_int8 0 0 -128 127 ECU_ADDRESS 0x0026CFB4 /end MEASUREMENT
/begin MEASUREMENT ModelWithControllersOnly_DW.TmpRTBAtMATLABFunction2Inport_p "" SBYTE ModelWithControllersOnly_CM_int8 0 0 -128 127 ECU_ADDRESS 0x0026CFB7 /end MEASUREMENT
/begin MEASUREMENT ModelWithControllersOnly_DW.TmpRTBAtMATLABFunction3Inpor_bx "" SBYTE ModelWithControllersOnly_CM_int8 0 0 -128 127 ECU_ADDRESS 0x0026CFBD /end MEASUREMENT
/begin MEASUREMENT ModelWithControllersOnly_DW.TmpRTBAtMATLABFunction3Inpor_gh "" SBYTE ModelWithControllersOnly_CM_int8 0 0 -128 127 ECU_ADDRESS 0x0026CFBC /end MEASUREMENT
/begin MEASUREMENT ModelWithControllersOnly_DW.TmpRTBAtMATLABFunction3Inport1_ "" FLOAT64_IEEE ModelWithControllersOnly_CM_double 0 0 -1.7E+308 1.7E+308 LAYOUT COLUMN_DIR MATRIX_DIM 2 ECU_ADDRESS 0x0026CCC0 /end MEASUREMENT
/begin MEASUREMENT ModelWithControllersOnly_DW.TmpRTBAtMATLABFunction3Inport2_ "" FLOAT64_IEEE ModelWithControllersOnly_CM_double 0 0 -1.7E+308 1.7E+308 LAYOUT COLUMN_DIR MATRIX_DIM 2 ECU_ADDRESS 0x0026CCD0 /end MEASUREMENT
/begin MEASUREMENT ModelWithControllersOnly_DW.TmpRTBAtMATLABFunction3Inport3_ "" FLOAT64_IEEE ModelWithControllersOnly_CM_double 0 0 -1.7E+308 1.7E+308 LAYOUT COLUMN_DIR MATRIX_DIM 2 ECU_ADDRESS 0x0026CCE0 /end MEASUREMENT
/begin MEASUREMENT ModelWithControllersOnly_DW.TmpRTBAtMATLABFunction3Inport_a "" SBYTE ModelWithControllersOnly_CM_int8 0 0 -128 127 ECU_ADDRESS 0x0026CFB8 /end MEASUREMENT
/begin MEASUREMENT ModelWithControllersOnly_DW.TmpRTBAtMATLABFunction3Inport_b "" SBYTE ModelWithControllersOnly_CM_int8 0 0 -128 127 ECU_ADDRESS 0x0026CFBB /end MEASUREMENT
/begin MEASUREMENT ModelWithControllersOnly_DW.TmpRTBAtMATLABFunction3Inport_f "" SBYTE ModelWithControllersOnly_CM_int8 0 0 -128 127 ECU_ADDRESS 0x0026CFBA /end MEASUREMENT
/begin MEASUREMENT ModelWithControllersOnly_DW.TmpRTBAtMATLABFunction3Inport_g "" SBYTE ModelWithControllersOnly_CM_int8 0 0 -128 127 ECU_ADDRESS 0x0026CFB9 /end MEASUREMENT
/begin MEASUREMENT ModelWithControllersOnly_DW.TmpRTBAtMATLABFunctionInport1_B "" FLOAT64_IEEE ModelWithControllersOnly_CM_double 0 0 -1.7E+308 1.7E+308 LAYOUT COLUMN_DIR MATRIX_DIM 2 ECU_ADDRESS 0x0026CCF0 /end MEASUREMENT
/begin MEASUREMENT ModelWithControllersOnly_DW.TmpRTBAtMATLABFunctionInport1_R "" SBYTE ModelWithControllersOnly_CM_int8 0 0 -128 127 ECU_ADDRESS 0x0026CFBE /end MEASUREMENT
/begin MEASUREMENT ModelWithControllersOnly_DW.TmpRTBAtMATLABFunctionInport1_W "" SBYTE ModelWithControllersOnly_CM_int8 0 0 -128 127 ECU_ADDRESS 0x0026CFBF /end MEASUREMENT
/begin MEASUREMENT ModelWithControllersOnly_DW.TmpRTBAtMATLABFunctionInport2_B "" FLOAT64_IEEE ModelWithControllersOnly_CM_double 0 0 -1.7E+308 1.7E+308 LAYOUT COLUMN_DIR MATRIX_DIM 2 ECU_ADDRESS 0x0026CD00 /end MEASUREMENT
/begin MEASUREMENT ModelWithControllersOnly_DW.TmpRTBAtMATLABFunctionInport2_R "" SBYTE ModelWithControllersOnly_CM_int8 0 0 -128 127 ECU_ADDRESS 0x0026CFC0 /end MEASUREMENT
/begin MEASUREMENT ModelWithControllersOnly_DW.TmpRTBAtMATLABFunctionInport2_W "" SBYTE ModelWithControllersOnly_CM_int8 0 0 -128 127 ECU_ADDRESS 0x0026CFC1 /end MEASUREMENT
/begin MEASUREMENT ModelWithControllersOnly_DW.TmpRTBAtMATLABFunctionInport3_B "" FLOAT64_IEEE ModelWithControllersOnly_CM_double 0 0 -1.7E+308 1.7E+308 ECU_ADDRESS 0x0026CD10 /end MEASUREMENT
/begin MEASUREMENT ModelWithControllersOnly_DW.TmpRTBAtMATLABFunctionInport3_L "" SBYTE ModelWithControllersOnly_CM_int8 0 0 -128 127 ECU_ADDRESS 0x0026CFC2 /end MEASUREMENT
/begin MEASUREMENT ModelWithControllersOnly_DW.TmpRTBAtMATLABFunctionInport3_R "" SBYTE ModelWithControllersOnly_CM_int8 0 0 -128 127 ECU_ADDRESS 0x0026CFC3 /end MEASUREMENT
/begin MEASUREMENT ModelWithControllersOnly_DW.TmpRTBAtMATLABFunctionInport3_c "" FLOAT64_IEEE ModelWithControllersOnly_CM_double 0 0 -1.7E+308 1.7E+308 ECU_ADDRESS 0x0026CD18 /end MEASUREMENT
/begin MEASUREMENT ModelWithControllersOnly_DW.TmpRTBAtMATLABFunctionInport3_f "" FLOAT64_IEEE ModelWithControllersOnly_CM_double 0 0 -1.7E+308 1.7E+308 ECU_ADDRESS 0x0026CD20 /end MEASUREMENT
/begin MEASUREMENT ModelWithControllersOnly_DW.TmpRTBAtMultiplyInport1_Buf0 "" FLOAT64_IEEE ModelWithControllersOnly_CM_double 0 0 -1.7E+308 1.7E+308 ECU_ADDRESS 0x0026CAC8 /end MEASUREMENT
/begin MEASUREMENT ModelWithControllersOnly_DW.TmpRTBAtMultiplyInport1_Buf1 "" FLOAT64_IEEE ModelWithControllersOnly_CM_double 0 0 -1.7E+308 1.7E+308 ECU_ADDRESS 0x0026CAD0 /end MEASUREMENT
/begin MEASUREMENT ModelWithControllersOnly_DW.TmpRTBAtMultiplyInport1_Buf2 "" FLOAT64_IEEE ModelWithControllersOnly_CM_double 0 0 -1.7E+308 1.7E+308 ECU_ADDRESS 0x0026CAD8 /end MEASUREMENT
/begin MEASUREMENT ModelWithControllersOnly_DW.TmpRTBAtMultiplyInport1_LstBufW "" SBYTE ModelWithControllersOnly_CM_int8 0 0 -128 127 ECU_ADDRESS 0x0026CF94 /end MEASUREMENT
/begin MEASUREMENT ModelWithControllersOnly_DW.TmpRTBAtMultiplyInport1_RDBuf "" SBYTE ModelWithControllersOnly_CM_int8 0 0 -128 127 ECU_ADDRESS 0x0026CF95 /end MEASUREMENT
/begin MEASUREMENT ModelWithControllersOnly_DW.TmpRTBAtSumInport3_Buf "" FLOAT64_IEEE ModelWithControllersOnly_CM_double 0 0 -1.7E+308 1.7E+308 LAYOUT COLUMN_DIR MATRIX_DIM 2 ECU_ADDRESS 0x0026CB18 /end MEASUREMENT
/begin MEASUREMENT ModelWithControllersOnly_DW.TmpRTBAtSumInport3_Buf_f "" FLOAT64_IEEE ModelWithControllersOnly_CM_double 0 0 -1.7E+308 1.7E+308 LAYOUT COLUMN_DIR MATRIX_DIM 2 ECU_ADDRESS 0x0026CB38 /end MEASUREMENT
/begin MEASUREMENT ModelWithControllersOnly_DW.TmpRTBAtSumInport3_RdBufIdx "" SBYTE ModelWithControllersOnly_CM_int8 0 0 -128 127 ECU_ADDRESS 0x0026CF9C /end MEASUREMENT
/begin MEASUREMENT ModelWithControllersOnly_DW.TmpRTBAtSumInport3_RdBufIdx_l "" SBYTE ModelWithControllersOnly_CM_int8 0 0 -128 127 ECU_ADDRESS 0x0026CFA0 /end MEASUREMENT
/begin MEASUREMENT ModelWithControllersOnly_DW.TmpRTBAtSumInport3_WrBufIdx "" SBYTE ModelWithControllersOnly_CM_int8 0 0 -128 127 ECU_ADDRESS 0x0026CF9D /end MEASUREMENT
/begin MEASUREMENT ModelWithControllersOnly_DW.TmpRTBAtSumInport3_WrBufIdx_o "" SBYTE ModelWithControllersOnly_CM_int8 0 0 -128 127 ECU_ADDRESS 0x0026CFA1 /end MEASUREMENT
/begin MEASUREMENT ModelWithControllersOnly_DW.TmpRTBAtSwitchCaseInport1_Buf0 "" FLOAT64_IEEE ModelWithControllersOnly_CM_double 0 0 -1.7E+308 1.7E+308 ECU_ADDRESS 0x0026CAE0 /end MEASUREMENT
/begin MEASUREMENT ModelWithControllersOnly_DW.TmpRTBAtSwitchCaseInport1_Buf1 "" FLOAT64_IEEE ModelWithControllersOnly_CM_double 0 0 -1.7E+308 1.7E+308 ECU_ADDRESS 0x0026CAE8 /end MEASUREMENT
/begin MEASUREMENT ModelWithControllersOnly_DW.TmpRTBAtSwitchCaseInport1_Buf2 "" FLOAT64_IEEE ModelWithControllersOnly_CM_double 0 0 -1.7E+308 1.7E+308 ECU_ADDRESS 0x0026CAF0 /end MEASUREMENT
/begin MEASUREMENT ModelWithControllersOnly_DW.TmpRTBAtSwitchCaseInport1_LstBu "" SBYTE ModelWithControllersOnly_CM_int8 0 0 -128 127 ECU_ADDRESS 0x0026CF96 /end MEASUREMENT
/begin MEASUREMENT ModelWithControllersOnly_DW.TmpRTBAtSwitchCaseInport1_RDBuf "" SBYTE ModelWithControllersOnly_CM_int8 0 0 -128 127 ECU_ADDRESS 0x0026CF97 /end MEASUREMENT
/begin MEASUREMENT ModelWithControllersOnly_DW.UnitDelay_DSTATE_l "" FLOAT64_IEEE ModelWithControllersOnly_CM_double 0 0 -1.7E+308 1.7E+308 ECU_ADDRESS 0x0026CA20 /end MEASUREMENT
/begin MEASUREMENT ModelWithControllersOnly_DW.m_bpIndex "" ULONG ModelWithControllersOnly_CM_uint32 0 0 0 2147483646 ECU_ADDRESS 0x0026CF70 /end MEASUREMENT
/begin MEASUREMENT ModelWithControllersOnly_DW.m_bpLambda "" FLOAT64_IEEE ModelWithControllersOnly_CM_double 0 0 -1.7E+308 1.7E+308 ECU_ADDRESS 0x0026CDA0 /end MEASUREMENT
/begin MEASUREMENT ModelWithControllersOnly_DW.m_up "" FLOAT64_IEEE ModelWithControllersOnly_CM_double 0 0 -1.7E+308 1.7E+308 LAYOUT COLUMN_DIR MATRIX_DIM 2 ECU_ADDRESS 0x0026CDC0 /end MEASUREMENT
/begin MEASUREMENT ModelWithControllersOnly_DW.m_y2 "" FLOAT64_IEEE ModelWithControllersOnly_CM_double 0 0 -1.7E+308 1.7E+308 LAYOUT COLUMN_DIR MATRIX_DIM 2 ECU_ADDRESS 0x0026CDD0 /end MEASUREMENT
/begin MEASUREMENT ModelWithControllersOnly_DW.m_yy2 "" FLOAT64_IEEE ModelWithControllersOnly_CM_double 0 0 -1.7E+308 1.7E+308 ECU_ADDRESS 0x0026CDB8 /end MEASUREMENT
/begin MEASUREMENT ModelWithControllersOnly_DW.m_yyA "" FLOAT64_IEEE ModelWithControllersOnly_CM_double 0 0 -1.7E+308 1.7E+308 ECU_ADDRESS 0x0026CDA8 /end MEASUREMENT
/begin MEASUREMENT ModelWithControllersOnly_DW.m_yyB "" FLOAT64_IEEE ModelWithControllersOnly_CM_double 0 0 -1.7E+308 1.7E+308 ECU_ADDRESS 0x0026CDB0 /end MEASUREMENT
/begin MEASUREMENT ModelWithControllersOnly_DW.prevBp0AndTableData "" FLOAT64_IEEE ModelWithControllersOnly_CM_double 0 0 -1.7E+308 1.7E+308 LAYOUT COLUMN_DIR MATRIX_DIM 4 ECU_ADDRESS 0x0026CDE0 /end MEASUREMENT
/begin MEASUREMENT ModelWithControllersOnly_DW.reCalcSecDerivFirstDimCoeffs "" UBYTE ModelWithControllersOnly_CM_uint8 0 0 0 255 ECU_ADDRESS 0x0026CFC9 /end MEASUREMENT
/begin MEASUREMENT ModelWithControllersOnly_DW.secondorderlowpassbrakemodel_st "" FLOAT64_IEEE ModelWithControllersOnly_CM_double 0 0 -1.7E+308 1.7E+308 LAYOUT COLUMN_DIR MATRIX_DIM 2 ECU_ADDRESS 0x0026CA10 /end MEASUREMENT
/begin MEASUREMENT ModelWithControllersOnly_DW.secondorderlowpassbrakemodel_tm "" FLOAT64_IEEE ModelWithControllersOnly_CM_double 0 0 -1.7E+308 1.7E+308 ECU_ADDRESS 0x0026CD90 /end MEASUREMENT
/begin MEASUREMENT ModelWithControllersOnly_DW.secondorderlowpasssteeringmod_c "" FLOAT64_IEEE ModelWithControllersOnly_CM_double 0 0 -1.7E+308 1.7E+308 ECU_ADDRESS 0x0026CD98 /end MEASUREMENT
/begin MEASUREMENT ModelWithControllersOnly_DW.secondorderlowpasssteeringmodel "" FLOAT64_IEEE ModelWithControllersOnly_CM_double 0 0 -1.7E+308 1.7E+308 LAYOUT COLUMN_DIR MATRIX_DIM 2 ECU_ADDRESS 0x0026CA28 /end MEASUREMENT
/begin MEASUREMENT ModelWithControllersOnly_DW.secondorderlowpasstorquemodel_s "" FLOAT64_IEEE ModelWithControllersOnly_CM_double 0 0 -1.7E+308 1.7E+308 LAYOUT COLUMN_DIR MATRIX_DIM 2 ECU_ADDRESS 0x0026CA00 /end MEASUREMENT
/begin MEASUREMENT ModelWithControllersOnly_DW.secondorderlowpasstorquemodel_t "" FLOAT64_IEEE ModelWithControllersOnly_CM_double 0 0 -1.7E+308 1.7E+308 ECU_ADDRESS 0x0026CD88 /end MEASUREMENT
/begin MEASUREMENT ModelWithControllersOnly_DW.xdot1_Buf "" FLOAT64_IEEE ModelWithControllersOnly_CM_double 0 0 -1.7E+308 1.7E+308 LAYOUT COLUMN_DIR MATRIX_DIM 2 ECU_ADDRESS 0x0026CAB8 /end MEASUREMENT
/begin MEASUREMENT ModelWithControllersOnly_DW.xdot1_RdBufIdx "" SBYTE ModelWithControllersOnly_CM_int8 0 0 -128 127 ECU_ADDRESS 0x0026CF92 /end MEASUREMENT
/begin MEASUREMENT ModelWithControllersOnly_DW.xdot1_WrBufIdx "" SBYTE ModelWithControllersOnly_CM_int8 0 0 -128 127 ECU_ADDRESS 0x0026CF93 /end MEASUREMENT
/begin MEASUREMENT ModelWithControllersOnly_DW.xdot_Buf "" FLOAT64_IEEE ModelWithControllersOnly_CM_double 0 0 -1.7E+308 1.7E+308 LAYOUT COLUMN_DIR MATRIX_DIM 2 ECU_ADDRESS 0x0026CAA8 /end MEASUREMENT
/begin MEASUREMENT ModelWithControllersOnly_DW.xdot_Buf_d "" FLOAT64_IEEE ModelWithControllersOnly_CM_double 0 0 -1.7E+308 1.7E+308 LAYOUT COLUMN_DIR MATRIX_DIM 2 ECU_ADDRESS 0x0026CAF8 /end MEASUREMENT
/begin MEASUREMENT ModelWithControllersOnly_DW.xdot_RdBufIdx "" SBYTE ModelWithControllersOnly_CM_int8 0 0 -128 127 ECU_ADDRESS 0x0026CF90 /end MEASUREMENT
/begin MEASUREMENT ModelWithControllersOnly_DW.xdot_RdBufIdx_m "" SBYTE ModelWithControllersOnly_CM_int8 0 0 -128 127 ECU_ADDRESS 0x0026CF98 /end MEASUREMENT
/begin MEASUREMENT ModelWithControllersOnly_DW.xdot_WrBufIdx "" SBYTE ModelWithControllersOnly_CM_int8 0 0 -128 127 ECU_ADDRESS 0x0026CF91 /end MEASUREMENT
/begin MEASUREMENT ModelWithControllersOnly_DW.xdot_WrBufIdx_b "" SBYTE ModelWithControllersOnly_CM_int8 0 0 -128 127 ECU_ADDRESS 0x0026CF99 /end MEASUREMENT
/begin COMPU_METHOD ModelWithControllersOnly_CM_ZCSigState "" IDENTICAL "customformat" "" /end COMPU_METHOD
/begin COMPU_METHOD ModelWithControllersOnly_CM_double "" IDENTICAL "%15.10" "" /end COMPU_METHOD
/begin COMPU_METHOD ModelWithControllersOnly_CM_double_1 "" IDENTICAL "%15.10" "1" /end COMPU_METHOD
/begin COMPU_METHOD ModelWithControllersOnly_CM_double_N "" IDENTICAL "%15.10" "N" /end COMPU_METHOD
/begin COMPU_METHOD ModelWithControllersOnly_CM_double_N_into_m "" IDENTICAL "%15.10" "N*m" /end COMPU_METHOD
/begin COMPU_METHOD ModelWithControllersOnly_CM_double_W "" IDENTICAL "%15.10" "W" /end COMPU_METHOD
/begin COMPU_METHOD ModelWithControllersOnly_CM_double_gn "" IDENTICAL "%15.10" "gn" /end COMPU_METHOD
/begin COMPU_METHOD ModelWithControllersOnly_CM_double_m "" IDENTICAL "%15.10" "m" /end COMPU_METHOD
/begin COMPU_METHOD ModelWithControllersOnly_CM_double_m_per_s "" IDENTICAL "%15.10" "m/s" /end COMPU_METHOD
/begin COMPU_METHOD ModelWithControllersOnly_CM_double_m_per_s_2 "" IDENTICAL "%15.10" "m/s^2" /end COMPU_METHOD
/begin COMPU_METHOD ModelWithControllersOnly_CM_double_rad "" IDENTICAL "%15.10" "rad" /end COMPU_METHOD
/begin COMPU_METHOD ModelWithControllersOnly_CM_double_rad_per_s_2 "" IDENTICAL "%15.10" "rad/s^2" /end COMPU_METHOD
/begin COMPU_METHOD ModelWithControllersOnly_CM_int8 "" IDENTICAL "%3.0" "" /end COMPU_METHOD
/begin COMPU_METHOD ModelWithControllersOnly_CM_logical "" IDENTICAL "%1.0" "" /end COMPU_METHOD
/begin COMPU_METHOD ModelWithControllersOnly_CM_uint32 "" IDENTICAL "%10.0" "" /end COMPU_METHOD
/begin COMPU_METHOD ModelWithControllersOnly_CM_uint8 "" IDENTICAL "%3.0" "" /end COMPU_METHOD
/begin RECORD_LAYOUT FixLookup_FLOAT64_IEEE FNC_VALUES 1 FLOAT64_IEEE COLUMN_DIR DIRECT /end RECORD_LAYOUT
/begin RECORD_LAYOUT Scalar_BOOLEAN FNC_VALUES 1 UBYTE COLUMN_DIR DIRECT /end RECORD_LAYOUT
/begin RECORD_LAYOUT Scalar_FLOAT64_IEEE FNC_VALUES 1 FLOAT64_IEEE COLUMN_DIR DIRECT /end RECORD_LAYOUT
/begin RECORD_LAYOUT Scalar_SBYTE FNC_VALUES 1 SBYTE COLUMN_DIR DIRECT /end RECORD_LAYOUT
/begin RECORD_LAYOUT Scalar_SLONG FNC_VALUES 1 SLONG COLUMN_DIR DIRECT /end RECORD_LAYOUT
/begin RECORD_LAYOUT Scalar_UBYTE FNC_VALUES 1 UBYTE COLUMN_DIR DIRECT /end RECORD_LAYOUT
/begin RECORD_LAYOUT Scalar_ULONG FNC_VALUES 1 ULONG COLUMN_DIR DIRECT /end RECORD_LAYOUT
/begin GROUP ModelWithControllersOnly_Vehicle_Dynamics1_VehicleDynamics_Vehicle_Body_3DOF_Single_Track_Signal_Routing_Signal_Routing "ModelWithControllersOnly/Vehicle Dynamics1/VehicleDynamics/Vehicle Body 3DOF Single Track/Signal Routing/Signal Routing"
 /begin SUB_GROUP ModelWithControllersOnly_Vehicle_Dynamics1_VehicleDynamics_Vehicle_Body_3DOF_Single_Track_Signal_Routing_Signal_Routing_Forces_3DOF ModelWithControllersOnly_Vehicle_Dynamics1_VehicleDynamics_Vehicle_Body_3DOF_Single_Track_Signal_Routing_Signal_Routing_Lateral_3DOF ModelWithControllersOnly_Vehicle_Dynamics1_VehicleDynamics_Vehicle_Body_3DOF_Single_Track_Signal_Routing_Signal_Routing_Moments ModelWithControllersOnly_Vehicle_Dynamics1_VehicleDynamics_Vehicle_Body_3DOF_Single_Track_Signal_Routing_Signal_Routing_Power ModelWithControllersOnly_Vehicle_Dynamics1_VehicleDynamics_Vehicle_Body_3DOF_Single_Track_Signal_Routing_Signal_Routing_state2bus /end SUB_GROUP
 /begin REF_MEASUREMENT ModelWithControllersOnly_B.VectorConcatenate1_i ModelWithControllersOnly_B.VectorConcatenate_j /end REF_MEASUREMENT
/end GROUP
/begin GROUP ModelWithControllersOnly_Vehicle_Dynamics1_VehicleDynamics_Vehicle_Body_3DOF_Single_Track_Signal_Routing_Signal_Routing_Lateral_3DOF "ModelWithControllersOnly/Vehicle Dynamics1/VehicleDynamics/Vehicle Body 3DOF Single Track/Signal Routing/Signal Routing/Lateral 3DOF"
 /begin SUB_GROUP ModelWithControllersOnly_Vehicle_Dynamics1_VehicleDynamics_Vehicle_Body_3DOF_Single_Track_Signal_Routing_Signal_Routing_Lateral_3DOF_Hard_Point_Coordinate_Transform_Front ModelWithControllersOnly_Vehicle_Dynamics1_VehicleDynamics_Vehicle_Body_3DOF_Single_Track_Signal_Routing_Signal_Routing_Lateral_3DOF_Hard_Point_Coordinate_Transform_Geometric ModelWithControllersOnly_Vehicle_Dynamics1_VehicleDynamics_Vehicle_Body_3DOF_Single_Track_Signal_Routing_Signal_Routing_Lateral_3DOF_Hard_Point_Coordinate_Transform_Rear ModelWithControllersOnly_Vehicle_Dynamics1_VehicleDynamics_Vehicle_Body_3DOF_Single_Track_Signal_Routing_Signal_Routing_Lateral_3DOF_Hitch_Coordinate_Transform /end SUB_GROUP
/end GROUP
/begin GROUP ModelWithControllersOnly_Vehicle_Dynamics1_VehicleDynamics_Vehicle_Body_3DOF_Single_Track_Signal_Routing_Signal_Routing_Lateral_3DOF_Hard_Point_Coordinate_Transform_Front "ModelWithControllersOnly/Vehicle Dynamics1/VehicleDynamics/Vehicle Body 3DOF Single Track/Signal Routing/Signal Routing/Lateral 3DOF/Hard Point Coordinate Transform Front"
 /begin SUB_GROUP ModelWithControllersOnly_Vehicle_Dynamics1_VehicleDynamics_Vehicle_Body_3DOF_Single_Track_Signal_Routing_Signal_Routing_Lateral_3DOF_Hard_Point_Coordinate_Transform_Front_Rotation_Angles_to_Direction_Cosine_Matrix ModelWithControllersOnly_Vehicle_Dynamics1_VehicleDynamics_Vehicle_Body_3DOF_Single_Track_Signal_Routing_Signal_Routing_Lateral_3DOF_Hard_Point_Coordinate_Transform_Front_transform_to_Inertial_axes ModelWithControllersOnly_Vehicle_Dynamics1_VehicleDynamics_Vehicle_Body_3DOF_Single_Track_Signal_Routing_Signal_Routing_Lateral_3DOF_Hard_Point_Coordinate_Transform_Front_transform_to_Inertial_axes1 ModelWithControllersOnly_Vehicle_Dynamics1_VehicleDynamics_Vehicle_Body_3DOF_Single_Track_Signal_Routing_Signal_Routing_Lateral_3DOF_Hard_Point_Coordinate_Transform_Front_wxR /end SUB_GROUP
 /begin REF_CHARACTERISTIC ModelWithControllersOn_cal_impl.HardPointCoordinateTransformFro /end REF_CHARACTERISTIC
 /begin REF_MEASUREMENT ModelWithControllersOnly_B.Add1_f ModelWithControllersOnly_B.Add_e ModelWithControllersOnly_B.Reshape2 ModelWithControllersOnly_B.Reshape2_p ModelWithControllersOnly_B.Reshape9to3x3columnmajor ModelWithControllersOnly_B.Sum_m ModelWithControllersOnly_B.Transpose1 ModelWithControllersOnly_B.V_wb ModelWithControllersOnly_B.VectorConcatenate_d /end REF_MEASUREMENT
/end GROUP
/begin GROUP ModelWithControllersOnly_Vehicle_Dynamics1_VehicleDynamics_Vehicle_Body_3DOF_Single_Track_Signal_Routing_Signal_Routing_Lateral_3DOF_Hard_Point_Coordinate_Transform_Front_Rotation_Angles_to_Direction_Cosine_Matrix "ModelWithControllersOnly/Vehicle Dynamics1/VehicleDynamics/Vehicle Body 3DOF Single Track/Signal Routing/Signal Routing/Lateral 3DOF/Hard Point Coordinate Transform Front/Rotation Angles to
Direction Cosine Matrix"
 /begin SUB_GROUP ModelWithControllersOnly_Vehicle_Dynamics1_VehicleDynamics_Vehicle_Body_3DOF_Single_Track_Signal_Routing_Signal_Routing_Lateral_3DOF_Hard_Point_Coordinate_Transform_Front_Rotation_Angles_to_Direction_Cosine_Matrix_Create_3x3_Matrix /end SUB_GROUP
 /begin REF_MEASUREMENT ModelWithControllersOnly_B.TmpSignalConversionAtsincosInpo ModelWithControllersOnly_B.VectorConcatenate_f ModelWithControllersOnly_B.sincos_o1 ModelWithControllersOnly_B.sincos_o2 /end REF_MEASUREMENT
/end GROUP
/begin GROUP ModelWithControllersOnly_Vehicle_Dynamics1_VehicleDynamics_Vehicle_Body_3DOF_Single_Track_Signal_Routing_Signal_Routing_Lateral_3DOF_Hard_Point_Coordinate_Transform_Front_Rotation_Angles_to_Direction_Cosine_Matrix_Create_3x3_Matrix "ModelWithControllersOnly/Vehicle Dynamics1/VehicleDynamics/Vehicle Body 3DOF Single Track/Signal Routing/Signal Routing/Lateral 3DOF/Hard Point Coordinate Transform Front/Rotation Angles to
Direction Cosine Matrix/Create 3x3 Matrix"
 /begin REF_MEASUREMENT ModelWithControllersOnly_B.Reshape9to3x3columnmajor ModelWithControllersOnly_B.VectorConcatenate_f /end REF_MEASUREMENT
/end GROUP
/begin GROUP ModelWithControllersOnly_Vehicle_Dynamics1_VehicleDynamics_Vehicle_Body_3DOF_Single_Track_Signal_Routing_Signal_Routing_Lateral_3DOF_Hard_Point_Coordinate_Transform_Front_transform_to_Inertial_axes "ModelWithControllersOnly/Vehicle Dynamics1/VehicleDynamics/Vehicle Body 3DOF Single Track/Signal Routing/Signal Routing/Lateral 3DOF/Hard Point Coordinate Transform Front/transform to
Inertial axes"
 /begin REF_MEASUREMENT ModelWithControllersOnly_B.Product_m ModelWithControllersOnly_B.Reshape1_m ModelWithControllersOnly_B.Reshape2_p ModelWithControllersOnly_B.Sum_m ModelWithControllersOnly_B.Transpose1 /end REF_MEASUREMENT
/end GROUP
/begin GROUP ModelWithControllersOnly_Vehicle_Dynamics1_VehicleDynamics_Vehicle_Body_3DOF_Single_Track_Signal_Routing_Signal_Routing_Lateral_3DOF_Hard_Point_Coordinate_Transform_Front_transform_to_Inertial_axes1 "ModelWithControllersOnly/Vehicle Dynamics1/VehicleDynamics/Vehicle Body 3DOF Single Track/Signal Routing/Signal Routing/Lateral 3DOF/Hard Point Coordinate Transform Front/transform to
Inertial axes1"
 /begin REF_MEASUREMENT ModelWithControllersOnly_B.Product_f ModelWithControllersOnly_B.Reshape1 ModelWithControllersOnly_B.Reshape2 ModelWithControllersOnly_B.Transpose1 ModelWithControllersOnly_B.VectorConcatenate_d /end REF_MEASUREMENT
/end GROUP
/begin GROUP ModelWithControllersOnly_Vehicle_Dynamics1_VehicleDynamics_Vehicle_Body_3DOF_Single_Track_Signal_Routing_Signal_Routing_Lateral_3DOF_Hard_Point_Coordinate_Transform_Front_wxR "ModelWithControllersOnly/Vehicle Dynamics1/VehicleDynamics/Vehicle Body 3DOF Single Track/Signal Routing/Signal Routing/Lateral 3DOF/Hard Point Coordinate Transform Front/wxR"
 /begin SUB_GROUP ModelWithControllersOnly_Vehicle_Dynamics1_VehicleDynamics_Vehicle_Body_3DOF_Single_Track_Signal_Routing_Signal_Routing_Lateral_3DOF_Hard_Point_Coordinate_Transform_Front_wxR_Subsystem ModelWithControllersOnly_Vehicle_Dynamics1_VehicleDynamics_Vehicle_Body_3DOF_Single_Track_Signal_Routing_Signal_Routing_Lateral_3DOF_Hard_Point_Coordinate_Transform_Front_wxR_Subsystem1 /end SUB_GROUP
 /begin REF_MEASUREMENT ModelWithControllersOnly_B.Sum_m /end REF_MEASUREMENT
/end GROUP
/begin GROUP ModelWithControllersOnly_Vehicle_Dynamics1_VehicleDynamics_Vehicle_Body_3DOF_Single_Track_Signal_Routing_Signal_Routing_Lateral_3DOF_Hard_Point_Coordinate_Transform_Front_wxR_Subsystem "ModelWithControllersOnly/Vehicle Dynamics1/VehicleDynamics/Vehicle Body 3DOF Single Track/Signal Routing/Signal Routing/Lateral 3DOF/Hard Point Coordinate Transform Front/wxR/Subsystem"
 /begin REF_MEASUREMENT ModelWithControllersOnly_B.VectorConcatenate_d ModelWithControllersOnly_B.ixj ModelWithControllersOnly_B.jxk ModelWithControllersOnly_B.kxi /end REF_MEASUREMENT
/end GROUP
/begin GROUP ModelWithControllersOnly_Vehicle_Dynamics1_VehicleDynamics_Vehicle_Body_3DOF_Single_Track_Signal_Routing_Signal_Routing_Lateral_3DOF_Hard_Point_Coordinate_Transform_Front_wxR_Subsystem1 "ModelWithControllersOnly/Vehicle Dynamics1/VehicleDynamics/Vehicle Body 3DOF Single Track/Signal Routing/Signal Routing/Lateral 3DOF/Hard Point Coordinate Transform Front/wxR/Subsystem1"
 /begin REF_MEASUREMENT ModelWithControllersOnly_B.VectorConcatenate_d ModelWithControllersOnly_B.ixk ModelWithControllersOnly_B.jxi ModelWithControllersOnly_B.kxj /end REF_MEASUREMENT
/end GROUP
/begin GROUP ModelWithControllersOnly_Vehicle_Dynamics1_VehicleDynamics_Vehicle_Body_3DOF_Single_Track_Signal_Routing_Signal_Routing_Lateral_3DOF_Hard_Point_Coordinate_Transform_Geometric "ModelWithControllersOnly/Vehicle Dynamics1/VehicleDynamics/Vehicle Body 3DOF Single Track/Signal Routing/Signal Routing/Lateral 3DOF/Hard Point Coordinate Transform Geometric"
 /begin SUB_GROUP ModelWithControllersOnly_Vehicle_Dynamics1_VehicleDynamics_Vehicle_Body_3DOF_Single_Track_Signal_Routing_Signal_Routing_Lateral_3DOF_Hard_Point_Coordinate_Transform_Geometric_Hard_Point_Coordinate_Transform_External_Displacement_Beta /end SUB_GROUP
 /begin REF_CHARACTERISTIC ModelWithControllersOn_cal_impl.VehicleBody3DOFSingleTrack_latO ModelWithControllersOn_cal_impl.VehicleBody3DOFSingleTrack_long ModelWithControllersOn_cal_impl.VehicleBody3DOFSingleTrack_vert /end REF_CHARACTERISTIC
 /begin REF_MEASUREMENT ModelWithControllersOnly_B.VectorConcatenate_c /end REF_MEASUREMENT
/end GROUP
/begin GROUP ModelWithControllersOnly_Vehicle_Dynamics1_VehicleDynamics_Vehicle_Body_3DOF_Single_Track_Signal_Routing_Signal_Routing_Lateral_3DOF_Hard_Point_Coordinate_Transform_Geometric_Hard_Point_Coordinate_Transform_External_Displacement_Beta "ModelWithControllersOnly/Vehicle Dynamics1/VehicleDynamics/Vehicle Body 3DOF Single Track/Signal Routing/Signal Routing/Lateral 3DOF/Hard Point Coordinate Transform Geometric/Hard Point Coordinate Transform
External Displacement Beta"
 /begin SUB_GROUP ModelWithControllersOnly_Vehicle_Dynamics1_VehicleDynamics_Vehicle_Body_3DOF_Single_Track_Signal_Routing_Signal_Routing_Lateral_3DOF_Hard_Point_Coordinate_Transform_Geometric_Hard_Point_Coordinate_Transform_External_Displacement_Beta_Body_Slip ModelWithControllersOnly_Vehicle_Dynamics1_VehicleDynamics_Vehicle_Body_3DOF_Single_Track_Signal_Routing_Signal_Routing_Lateral_3DOF_Hard_Point_Coordinate_Transform_Geometric_Hard_Point_Coordinate_Transform_External_Displacement_Beta_Rotation_Angles_to_Direction_Cosine_Matrix ModelWithControllersOnly_Vehicle_Dynamics1_VehicleDynamics_Vehicle_Body_3DOF_Single_Track_Signal_Routing_Signal_Routing_Lateral_3DOF_Hard_Point_Coordinate_Transform_Geometric_Hard_Point_Coordinate_Transform_External_Displacement_Beta_transform_to_Inertial_axes ModelWithControllersOnly_Vehicle_Dynamics1_VehicleDynamics_Vehicle_Body_3DOF_Single_Track_Signal_Routing_Signal_Routing_Lateral_3DOF_Hard_Point_Coordinate_Transform_Geometric_Hard_Point_Coordinate_Transform_External_Displacement_Beta_transform_to_Inertial_axes1 ModelWithControllersOnly_Vehicle_Dynamics1_VehicleDynamics_Vehicle_Body_3DOF_Single_Track_Signal_Routing_Signal_Routing_Lateral_3DOF_Hard_Point_Coordinate_Transform_Geometric_Hard_Point_Coordinate_Transform_External_Displacement_Beta_wxR /end SUB_GROUP
 /begin REF_MEASUREMENT ModelWithControllersOnly_B.Add1_o ModelWithControllersOnly_B.Add_p ModelWithControllersOnly_B.Reshape2_c ModelWithControllersOnly_B.Reshape2_m ModelWithControllersOnly_B.Reshape9to3x3columnmajor_e ModelWithControllersOnly_B.Sum_b ModelWithControllersOnly_B.Transpose1_a ModelWithControllersOnly_B.V_wb_p /end REF_MEASUREMENT
/end GROUP
/begin GROUP ModelWithControllersOnly_Vehicle_Dynamics1_VehicleDynamics_Vehicle_Body_3DOF_Single_Track_Signal_Routing_Signal_Routing_Lateral_3DOF_Hard_Point_Coordinate_Transform_Geometric_Hard_Point_Coordinate_Transform_External_Displacement_Beta_Body_Slip "ModelWithControllersOnly/Vehicle Dynamics1/VehicleDynamics/Vehicle Body 3DOF Single Track/Signal Routing/Signal Routing/Lateral 3DOF/Hard Point Coordinate Transform Geometric/Hard Point Coordinate Transform
External Displacement Beta/Body Slip"
 /begin SUB_GROUP ModelWithControllersOnly_Vehicle_Dynamics1_VehicleDynamics_Vehicle_Body_3DOF_Single_Track_Signal_Routing_Signal_Routing_Lateral_3DOF_Hard_Point_Coordinate_Transform_Geometric_Hard_Point_Coordinate_Transform_External_Displacement_Beta_Body_Slip_div0protect___abs_poly /end SUB_GROUP
 /begin REF_MEASUREMENT ModelWithControllersOnly_B.Add1_o ModelWithControllersOnly_B.Beta ModelWithControllersOnly_B.Divide ModelWithControllersOnly_B.Switch_d /end REF_MEASUREMENT
/end GROUP
/begin GROUP ModelWithControllersOnly_Vehicle_Dynamics1_VehicleDynamics_Vehicle_Body_3DOF_Single_Track_Signal_Routing_Signal_Routing_Lateral_3DOF_Hard_Point_Coordinate_Transform_Geometric_Hard_Point_Coordinate_Transform_External_Displacement_Beta_Body_Slip_div0protect___abs_poly "ModelWithControllersOnly/Vehicle Dynamics1/VehicleDynamics/Vehicle Body 3DOF Single Track/Signal Routing/Signal Routing/Lateral 3DOF/Hard Point Coordinate Transform Geometric/Hard Point Coordinate Transform
External Displacement Beta/Body Slip/div0protect - abs poly"
 /begin SUB_GROUP ModelWithControllersOnly_Vehicle_Dynamics1_VehicleDynamics_Vehicle_Body_3DOF_Single_Track_Signal_Routing_Signal_Routing_Lateral_3DOF_Hard_Point_Coordinate_Transform_Geometric_Hard_Point_Coordinate_Transform_External_Displacement_Beta_Body_Slip_div0protect___abs_poly_Compare_To_Constant ModelWithControllersOnly_Vehicle_Dynamics1_VehicleDynamics_Vehicle_Body_3DOF_Single_Track_Signal_Routing_Signal_Routing_Lateral_3DOF_Hard_Point_Coordinate_Transform_Geometric_Hard_Point_Coordinate_Transform_External_Displacement_Beta_Body_Slip_div0protect___abs_poly_Compare_To_Constant1 /end SUB_GROUP
 /begin REF_MEASUREMENT ModelWithControllersOnly_B.Abs_d ModelWithControllersOnly_B.Add1_o ModelWithControllersOnly_B.Compare ModelWithControllersOnly_B.Compare_f ModelWithControllersOnly_B.Fcn_g ModelWithControllersOnly_B.LogicalOperator ModelWithControllersOnly_B.Switch_d /end REF_MEASUREMENT
/end GROUP
/begin GROUP ModelWithControllersOnly_Vehicle_Dynamics1_VehicleDynamics_Vehicle_Body_3DOF_Single_Track_Signal_Routing_Signal_Routing_Lateral_3DOF_Hard_Point_Coordinate_Transform_Geometric_Hard_Point_Coordinate_Transform_External_Displacement_Beta_Body_Slip_div0protect___abs_poly_Compare_To_Constant "ModelWithControllersOnly/Vehicle Dynamics1/VehicleDynamics/Vehicle Body 3DOF Single Track/Signal Routing/Signal Routing/Lateral 3DOF/Hard Point Coordinate Transform Geometric/Hard Point Coordinate Transform
External Displacement Beta/Body Slip/div0protect - abs poly/Compare
To Constant"
 /begin REF_MEASUREMENT ModelWithControllersOnly_B.Add1_o ModelWithControllersOnly_B.Compare /end REF_MEASUREMENT
/end GROUP
/begin GROUP ModelWithControllersOnly_Vehicle_Dynamics1_VehicleDynamics_Vehicle_Body_3DOF_Single_Track_Signal_Routing_Signal_Routing_Lateral_3DOF_Hard_Point_Coordinate_Transform_Geometric_Hard_Point_Coordinate_Transform_External_Displacement_Beta_Body_Slip_div0protect___abs_poly_Compare_To_Constant1 "ModelWithControllersOnly/Vehicle Dynamics1/VehicleDynamics/Vehicle Body 3DOF Single Track/Signal Routing/Signal Routing/Lateral 3DOF/Hard Point Coordinate Transform Geometric/Hard Point Coordinate Transform
External Displacement Beta/Body Slip/div0protect - abs poly/Compare
To Constant1"
 /begin REF_MEASUREMENT ModelWithControllersOnly_B.Add1_o ModelWithControllersOnly_B.Compare_f /end REF_MEASUREMENT
/end GROUP
/begin GROUP ModelWithControllersOnly_Vehicle_Dynamics1_VehicleDynamics_Vehicle_Body_3DOF_Single_Track_Signal_Routing_Signal_Routing_Lateral_3DOF_Hard_Point_Coordinate_Transform_Geometric_Hard_Point_Coordinate_Transform_External_Displacement_Beta_Rotation_Angles_to_Direction_Cosine_Matrix "ModelWithControllersOnly/Vehicle Dynamics1/VehicleDynamics/Vehicle Body 3DOF Single Track/Signal Routing/Signal Routing/Lateral 3DOF/Hard Point Coordinate Transform Geometric/Hard Point Coordinate Transform
External Displacement Beta/Rotation Angles to
Direction Cosine Matrix"
 /begin SUB_GROUP ModelWithControllersOnly_Vehicle_Dynamics1_VehicleDynamics_Vehicle_Body_3DOF_Single_Track_Signal_Routing_Signal_Routing_Lateral_3DOF_Hard_Point_Coordinate_Transform_Geometric_Hard_Point_Coordinate_Transform_External_Displacement_Beta_Rotation_Angles_to_Direction_Cosine_Matrix_Create_3x3_Matrix /end SUB_GROUP
 /begin REF_MEASUREMENT ModelWithControllersOnly_B.TmpSignalConversionAtsincosInpo ModelWithControllersOnly_B.VectorConcatenate_bj ModelWithControllersOnly_B.sincos_o1_h ModelWithControllersOnly_B.sincos_o2_g /end REF_MEASUREMENT
/end GROUP
/begin GROUP ModelWithControllersOnly_Vehicle_Dynamics1_VehicleDynamics_Vehicle_Body_3DOF_Single_Track_Signal_Routing_Signal_Routing_Lateral_3DOF_Hard_Point_Coordinate_Transform_Geometric_Hard_Point_Coordinate_Transform_External_Displacement_Beta_Rotation_Angles_to_Direction_Cosine_Matrix_Create_3x3_Matrix "ModelWithControllersOnly/Vehicle Dynamics1/VehicleDynamics/Vehicle Body 3DOF Single Track/Signal Routing/Signal Routing/Lateral 3DOF/Hard Point Coordinate Transform Geometric/Hard Point Coordinate Transform
External Displacement Beta/Rotation Angles to
Direction Cosine Matrix/Create 3x3 Matrix"
 /begin REF_MEASUREMENT ModelWithControllersOnly_B.Reshape9to3x3columnmajor_e ModelWithControllersOnly_B.VectorConcatenate_bj /end REF_MEASUREMENT
/end GROUP
/begin GROUP ModelWithControllersOnly_Vehicle_Dynamics1_VehicleDynamics_Vehicle_Body_3DOF_Single_Track_Signal_Routing_Signal_Routing_Lateral_3DOF_Hard_Point_Coordinate_Transform_Geometric_Hard_Point_Coordinate_Transform_External_Displacement_Beta_transform_to_Inertial_axes "ModelWithControllersOnly/Vehicle Dynamics1/VehicleDynamics/Vehicle Body 3DOF Single Track/Signal Routing/Signal Routing/Lateral 3DOF/Hard Point Coordinate Transform Geometric/Hard Point Coordinate Transform
External Displacement Beta/transform to
Inertial axes"
 /begin REF_MEASUREMENT ModelWithControllersOnly_B.Product_p ModelWithControllersOnly_B.Reshape1_j ModelWithControllersOnly_B.Reshape2_c ModelWithControllersOnly_B.Sum_b ModelWithControllersOnly_B.Transpose1_a /end REF_MEASUREMENT
/end GROUP
/begin GROUP ModelWithControllersOnly_Vehicle_Dynamics1_VehicleDynamics_Vehicle_Body_3DOF_Single_Track_Signal_Routing_Signal_Routing_Lateral_3DOF_Hard_Point_Coordinate_Transform_Geometric_Hard_Point_Coordinate_Transform_External_Displacement_Beta_transform_to_Inertial_axes1 "ModelWithControllersOnly/Vehicle Dynamics1/VehicleDynamics/Vehicle Body 3DOF Single Track/Signal Routing/Signal Routing/Lateral 3DOF/Hard Point Coordinate Transform Geometric/Hard Point Coordinate Transform
External Displacement Beta/transform to
Inertial axes1"
 /begin REF_MEASUREMENT ModelWithControllersOnly_B.Product_n ModelWithControllersOnly_B.Reshape1_e ModelWithControllersOnly_B.Reshape2_m ModelWithControllersOnly_B.Transpose1_a ModelWithControllersOnly_B.VectorConcatenate_c /end REF_MEASUREMENT
/end GROUP
/begin GROUP ModelWithControllersOnly_Vehicle_Dynamics1_VehicleDynamics_Vehicle_Body_3DOF_Single_Track_Signal_Routing_Signal_Routing_Lateral_3DOF_Hard_Point_Coordinate_Transform_Geometric_Hard_Point_Coordinate_Transform_External_Displacement_Beta_wxR "ModelWithControllersOnly/Vehicle Dynamics1/VehicleDynamics/Vehicle Body 3DOF Single Track/Signal Routing/Signal Routing/Lateral 3DOF/Hard Point Coordinate Transform Geometric/Hard Point Coordinate Transform
External Displacement Beta/wxR"
 /begin SUB_GROUP ModelWithControllersOnly_Vehicle_Dynamics1_VehicleDynamics_Vehicle_Body_3DOF_Single_Track_Signal_Routing_Signal_Routing_Lateral_3DOF_Hard_Point_Coordinate_Transform_Geometric_Hard_Point_Coordinate_Transform_External_Displacement_Beta_wxR_Subsystem ModelWithControllersOnly_Vehicle_Dynamics1_VehicleDynamics_Vehicle_Body_3DOF_Single_Track_Signal_Routing_Signal_Routing_Lateral_3DOF_Hard_Point_Coordinate_Transform_Geometric_Hard_Point_Coordinate_Transform_External_Displacement_Beta_wxR_Subsystem1 /end SUB_GROUP
 /begin REF_MEASUREMENT ModelWithControllersOnly_B.Sum_b /end REF_MEASUREMENT
/end GROUP
/begin GROUP ModelWithControllersOnly_Vehicle_Dynamics1_VehicleDynamics_Vehicle_Body_3DOF_Single_Track_Signal_Routing_Signal_Routing_Lateral_3DOF_Hard_Point_Coordinate_Transform_Geometric_Hard_Point_Coordinate_Transform_External_Displacement_Beta_wxR_Subsystem "ModelWithControllersOnly/Vehicle Dynamics1/VehicleDynamics/Vehicle Body 3DOF Single Track/Signal Routing/Signal Routing/Lateral 3DOF/Hard Point Coordinate Transform Geometric/Hard Point Coordinate Transform
External Displacement Beta/wxR/Subsystem"
 /begin REF_MEASUREMENT ModelWithControllersOnly_B.VectorConcatenate_c ModelWithControllersOnly_B.ixj_d ModelWithControllersOnly_B.jxk_j ModelWithControllersOnly_B.kxi_g /end REF_MEASUREMENT
/end GROUP
/begin GROUP ModelWithControllersOnly_Vehicle_Dynamics1_VehicleDynamics_Vehicle_Body_3DOF_Single_Track_Signal_Routing_Signal_Routing_Lateral_3DOF_Hard_Point_Coordinate_Transform_Geometric_Hard_Point_Coordinate_Transform_External_Displacement_Beta_wxR_Subsystem1 "ModelWithControllersOnly/Vehicle Dynamics1/VehicleDynamics/Vehicle Body 3DOF Single Track/Signal Routing/Signal Routing/Lateral 3DOF/Hard Point Coordinate Transform Geometric/Hard Point Coordinate Transform
External Displacement Beta/wxR/Subsystem1"
 /begin REF_MEASUREMENT ModelWithControllersOnly_B.VectorConcatenate_c ModelWithControllersOnly_B.ixk_j ModelWithControllersOnly_B.jxi_i ModelWithControllersOnly_B.kxj_j /end REF_MEASUREMENT
/end GROUP
/begin GROUP ModelWithControllersOnly_Vehicle_Dynamics1_VehicleDynamics_Vehicle_Body_3DOF_Single_Track_Signal_Routing_Signal_Routing_Lateral_3DOF_Hard_Point_Coordinate_Transform_Rear "ModelWithControllersOnly/Vehicle Dynamics1/VehicleDynamics/Vehicle Body 3DOF Single Track/Signal Routing/Signal Routing/Lateral 3DOF/Hard Point Coordinate Transform Rear"
 /begin SUB_GROUP ModelWithControllersOnly_Vehicle_Dynamics1_VehicleDynamics_Vehicle_Body_3DOF_Single_Track_Signal_Routing_Signal_Routing_Lateral_3DOF_Hard_Point_Coordinate_Transform_Rear_Rotation_Angles_to_Direction_Cosine_Matrix ModelWithControllersOnly_Vehicle_Dynamics1_VehicleDynamics_Vehicle_Body_3DOF_Single_Track_Signal_Routing_Signal_Routing_Lateral_3DOF_Hard_Point_Coordinate_Transform_Rear_transform_to_Inertial_axes ModelWithControllersOnly_Vehicle_Dynamics1_VehicleDynamics_Vehicle_Body_3DOF_Single_Track_Signal_Routing_Signal_Routing_Lateral_3DOF_Hard_Point_Coordinate_Transform_Rear_transform_to_Inertial_axes1 ModelWithControllersOnly_Vehicle_Dynamics1_VehicleDynamics_Vehicle_Body_3DOF_Single_Track_Signal_Routing_Signal_Routing_Lateral_3DOF_Hard_Point_Coordinate_Transform_Rear_wxR /end SUB_GROUP
 /begin REF_CHARACTERISTIC ModelWithControllersOn_cal_impl.HardPointCoordinateTransformRea /end REF_CHARACTERISTIC
 /begin REF_MEASUREMENT ModelWithControllersOnly_B.Add1_o0 ModelWithControllersOnly_B.Add_pa ModelWithControllersOnly_B.Reshape2_f ModelWithControllersOnly_B.Reshape2_g ModelWithControllersOnly_B.Reshape9to3x3columnmajor_n ModelWithControllersOnly_B.Sum_f ModelWithControllersOnly_B.Transpose1_k ModelWithControllersOnly_B.V_wb_g ModelWithControllersOnly_B.VectorConcatenate_o /end REF_MEASUREMENT
/end GROUP
/begin GROUP ModelWithControllersOnly_Vehicle_Dynamics1_VehicleDynamics_Vehicle_Body_3DOF_Single_Track_Signal_Routing_Signal_Routing_Lateral_3DOF_Hard_Point_Coordinate_Transform_Rear_Rotation_Angles_to_Direction_Cosine_Matrix "ModelWithControllersOnly/Vehicle Dynamics1/VehicleDynamics/Vehicle Body 3DOF Single Track/Signal Routing/Signal Routing/Lateral 3DOF/Hard Point Coordinate Transform Rear/Rotation Angles to
Direction Cosine Matrix"
 /begin SUB_GROUP ModelWithControllersOnly_Vehicle_Dynamics1_VehicleDynamics_Vehicle_Body_3DOF_Single_Track_Signal_Routing_Signal_Routing_Lateral_3DOF_Hard_Point_Coordinate_Transform_Rear_Rotation_Angles_to_Direction_Cosine_Matrix_Create_3x3_Matrix /end SUB_GROUP
 /begin REF_MEASUREMENT ModelWithControllersOnly_B.TmpSignalConversionAtsincosInpo ModelWithControllersOnly_B.VectorConcatenate_f5 ModelWithControllersOnly_B.sincos_o1_n ModelWithControllersOnly_B.sincos_o2_k /end REF_MEASUREMENT
/end GROUP
/begin GROUP ModelWithControllersOnly_Vehicle_Dynamics1_VehicleDynamics_Vehicle_Body_3DOF_Single_Track_Signal_Routing_Signal_Routing_Lateral_3DOF_Hard_Point_Coordinate_Transform_Rear_Rotation_Angles_to_Direction_Cosine_Matrix_Create_3x3_Matrix "ModelWithControllersOnly/Vehicle Dynamics1/VehicleDynamics/Vehicle Body 3DOF Single Track/Signal Routing/Signal Routing/Lateral 3DOF/Hard Point Coordinate Transform Rear/Rotation Angles to
Direction Cosine Matrix/Create 3x3 Matrix"
 /begin REF_MEASUREMENT ModelWithControllersOnly_B.Reshape9to3x3columnmajor_n ModelWithControllersOnly_B.VectorConcatenate_f5 /end REF_MEASUREMENT
/end GROUP
/begin GROUP ModelWithControllersOnly_Vehicle_Dynamics1_VehicleDynamics_Vehicle_Body_3DOF_Single_Track_Signal_Routing_Signal_Routing_Lateral_3DOF_Hard_Point_Coordinate_Transform_Rear_transform_to_Inertial_axes "ModelWithControllersOnly/Vehicle Dynamics1/VehicleDynamics/Vehicle Body 3DOF Single Track/Signal Routing/Signal Routing/Lateral 3DOF/Hard Point Coordinate Transform Rear/transform to
Inertial axes"
 /begin REF_MEASUREMENT ModelWithControllersOnly_B.Product_ky ModelWithControllersOnly_B.Reshape1_k ModelWithControllersOnly_B.Reshape2_f ModelWithControllersOnly_B.Sum_f ModelWithControllersOnly_B.Transpose1_k /end REF_MEASUREMENT
/end GROUP
/begin GROUP ModelWithControllersOnly_Vehicle_Dynamics1_VehicleDynamics_Vehicle_Body_3DOF_Single_Track_Signal_Routing_Signal_Routing_Lateral_3DOF_Hard_Point_Coordinate_Transform_Rear_transform_to_Inertial_axes1 "ModelWithControllersOnly/Vehicle Dynamics1/VehicleDynamics/Vehicle Body 3DOF Single Track/Signal Routing/Signal Routing/Lateral 3DOF/Hard Point Coordinate Transform Rear/transform to
Inertial axes1"
 /begin REF_MEASUREMENT ModelWithControllersOnly_B.Product_g ModelWithControllersOnly_B.Reshape1_n ModelWithControllersOnly_B.Reshape2_g ModelWithControllersOnly_B.Transpose1_k ModelWithControllersOnly_B.VectorConcatenate_o /end REF_MEASUREMENT
/end GROUP
/begin GROUP ModelWithControllersOnly_Vehicle_Dynamics1_VehicleDynamics_Vehicle_Body_3DOF_Single_Track_Signal_Routing_Signal_Routing_Lateral_3DOF_Hard_Point_Coordinate_Transform_Rear_wxR "ModelWithControllersOnly/Vehicle Dynamics1/VehicleDynamics/Vehicle Body 3DOF Single Track/Signal Routing/Signal Routing/Lateral 3DOF/Hard Point Coordinate Transform Rear/wxR"
 /begin SUB_GROUP ModelWithControllersOnly_Vehicle_Dynamics1_VehicleDynamics_Vehicle_Body_3DOF_Single_Track_Signal_Routing_Signal_Routing_Lateral_3DOF_Hard_Point_Coordinate_Transform_Rear_wxR_Subsystem ModelWithControllersOnly_Vehicle_Dynamics1_VehicleDynamics_Vehicle_Body_3DOF_Single_Track_Signal_Routing_Signal_Routing_Lateral_3DOF_Hard_Point_Coordinate_Transform_Rear_wxR_Subsystem1 /end SUB_GROUP
 /begin REF_MEASUREMENT ModelWithControllersOnly_B.Sum_f /end REF_MEASUREMENT
/end GROUP
/begin GROUP ModelWithControllersOnly_Vehicle_Dynamics1_VehicleDynamics_Vehicle_Body_3DOF_Single_Track_Signal_Routing_Signal_Routing_Lateral_3DOF_Hard_Point_Coordinate_Transform_Rear_wxR_Subsystem "ModelWithControllersOnly/Vehicle Dynamics1/VehicleDynamics/Vehicle Body 3DOF Single Track/Signal Routing/Signal Routing/Lateral 3DOF/Hard Point Coordinate Transform Rear/wxR/Subsystem"
 /begin REF_MEASUREMENT ModelWithControllersOnly_B.VectorConcatenate_o ModelWithControllersOnly_B.ixj_e ModelWithControllersOnly_B.jxk_m ModelWithControllersOnly_B.kxi_k /end REF_MEASUREMENT
/end GROUP
/begin GROUP ModelWithControllersOnly_Vehicle_Dynamics1_VehicleDynamics_Vehicle_Body_3DOF_Single_Track_Signal_Routing_Signal_Routing_Lateral_3DOF_Hard_Point_Coordinate_Transform_Rear_wxR_Subsystem1 "ModelWithControllersOnly/Vehicle Dynamics1/VehicleDynamics/Vehicle Body 3DOF Single Track/Signal Routing/Signal Routing/Lateral 3DOF/Hard Point Coordinate Transform Rear/wxR/Subsystem1"
 /begin REF_MEASUREMENT ModelWithControllersOnly_B.VectorConcatenate_o ModelWithControllersOnly_B.ixk_m ModelWithControllersOnly_B.jxi_h ModelWithControllersOnly_B.kxj_b /end REF_MEASUREMENT
/end GROUP
/begin GROUP ModelWithControllersOnly_Vehicle_Dynamics1_VehicleDynamics_Vehicle_Body_3DOF_Single_Track_Signal_Routing_Signal_Routing_Lateral_3DOF_Hitch_Coordinate_Transform "ModelWithControllersOnly/Vehicle Dynamics1/VehicleDynamics/Vehicle Body 3DOF Single Track/Signal Routing/Signal Routing/Lateral 3DOF/Hitch Coordinate Transform"
 /begin SUB_GROUP ModelWithControllersOnly_Vehicle_Dynamics1_VehicleDynamics_Vehicle_Body_3DOF_Single_Track_Signal_Routing_Signal_Routing_Lateral_3DOF_Hitch_Coordinate_Transform_Hard_Point_Coordinate_Transform_External_Displacement /end SUB_GROUP
 /begin REF_CHARACTERISTIC ModelWithControllersOn_cal_impl.Constant3_Value ModelWithControllersOn_cal_impl.Constant4_Value_b ModelWithControllersOn_cal_impl.Constant_Value_dz /end REF_CHARACTERISTIC
 /begin REF_MEASUREMENT ModelWithControllersOnly_B.VectorConcatenate_h /end REF_MEASUREMENT
/end GROUP
/begin GROUP ModelWithControllersOnly_Vehicle_Dynamics1_VehicleDynamics_Vehicle_Body_3DOF_Single_Track_Signal_Routing_Signal_Routing_Lateral_3DOF_Hitch_Coordinate_Transform_Hard_Point_Coordinate_Transform_External_Displacement "ModelWithControllersOnly/Vehicle Dynamics1/VehicleDynamics/Vehicle Body 3DOF Single Track/Signal Routing/Signal Routing/Lateral 3DOF/Hitch Coordinate Transform/Hard Point Coordinate Transform
External Displacement"
 /begin SUB_GROUP ModelWithControllersOnly_Vehicle_Dynamics1_VehicleDynamics_Vehicle_Body_3DOF_Single_Track_Signal_Routing_Signal_Routing_Lateral_3DOF_Hitch_Coordinate_Transform_Hard_Point_Coordinate_Transform_External_Displacement_Rotation_Angles_to_Direction_Cosine_Matrix ModelWithControllersOnly_Vehicle_Dynamics1_VehicleDynamics_Vehicle_Body_3DOF_Single_Track_Signal_Routing_Signal_Routing_Lateral_3DOF_Hitch_Coordinate_Transform_Hard_Point_Coordinate_Transform_External_Displacement_transform_to_Inertial_axes ModelWithControllersOnly_Vehicle_Dynamics1_VehicleDynamics_Vehicle_Body_3DOF_Single_Track_Signal_Routing_Signal_Routing_Lateral_3DOF_Hitch_Coordinate_Transform_Hard_Point_Coordinate_Transform_External_Displacement_transform_to_Inertial_axes1 ModelWithControllersOnly_Vehicle_Dynamics1_VehicleDynamics_Vehicle_Body_3DOF_Single_Track_Signal_Routing_Signal_Routing_Lateral_3DOF_Hitch_Coordinate_Transform_Hard_Point_Coordinate_Transform_External_Displacement_wxR /end SUB_GROUP
 /begin REF_MEASUREMENT ModelWithControllersOnly_B.Add1_h ModelWithControllersOnly_B.Add_c ModelWithControllersOnly_B.Reshape2_e ModelWithControllersOnly_B.Reshape2_mj ModelWithControllersOnly_B.Reshape9to3x3columnmajor_h ModelWithControllersOnly_B.Sum_i ModelWithControllersOnly_B.Transpose1_m ModelWithControllersOnly_B.V_wb_e /end REF_MEASUREMENT
/end GROUP
/begin GROUP ModelWithControllersOnly_Vehicle_Dynamics1_VehicleDynamics_Vehicle_Body_3DOF_Single_Track_Signal_Routing_Signal_Routing_Lateral_3DOF_Hitch_Coordinate_Transform_Hard_Point_Coordinate_Transform_External_Displacement_Rotation_Angles_to_Direction_Cosine_Matrix "ModelWithControllersOnly/Vehicle Dynamics1/VehicleDynamics/Vehicle Body 3DOF Single Track/Signal Routing/Signal Routing/Lateral 3DOF/Hitch Coordinate Transform/Hard Point Coordinate Transform
External Displacement/Rotation Angles to
Direction Cosine Matrix"
 /begin SUB_GROUP ModelWithControllersOnly_Vehicle_Dynamics1_VehicleDynamics_Vehicle_Body_3DOF_Single_Track_Signal_Routing_Signal_Routing_Lateral_3DOF_Hitch_Coordinate_Transform_Hard_Point_Coordinate_Transform_External_Displacement_Rotation_Angles_to_Direction_Cosine_Matrix_Create_3x3_Matrix /end SUB_GROUP
 /begin REF_MEASUREMENT ModelWithControllersOnly_B.TmpSignalConversionAtsincosInpo ModelWithControllersOnly_B.VectorConcatenate_bx ModelWithControllersOnly_B.sincos_o1_b ModelWithControllersOnly_B.sincos_o2_gp /end REF_MEASUREMENT
/end GROUP
/begin GROUP ModelWithControllersOnly_Vehicle_Dynamics1_VehicleDynamics_Vehicle_Body_3DOF_Single_Track_Signal_Routing_Signal_Routing_Lateral_3DOF_Hitch_Coordinate_Transform_Hard_Point_Coordinate_Transform_External_Displacement_Rotation_Angles_to_Direction_Cosine_Matrix_Create_3x3_Matrix "ModelWithControllersOnly/Vehicle Dynamics1/VehicleDynamics/Vehicle Body 3DOF Single Track/Signal Routing/Signal Routing/Lateral 3DOF/Hitch Coordinate Transform/Hard Point Coordinate Transform
External Displacement/Rotation Angles to
Direction Cosine Matrix/Create 3x3 Matrix"
 /begin REF_MEASUREMENT ModelWithControllersOnly_B.Reshape9to3x3columnmajor_h ModelWithControllersOnly_B.VectorConcatenate_bx /end REF_MEASUREMENT
/end GROUP
/begin GROUP ModelWithControllersOnly_Vehicle_Dynamics1_VehicleDynamics_Vehicle_Body_3DOF_Single_Track_Signal_Routing_Signal_Routing_Lateral_3DOF_Hitch_Coordinate_Transform_Hard_Point_Coordinate_Transform_External_Displacement_transform_to_Inertial_axes "ModelWithControllersOnly/Vehicle Dynamics1/VehicleDynamics/Vehicle Body 3DOF Single Track/Signal Routing/Signal Routing/Lateral 3DOF/Hitch Coordinate Transform/Hard Point Coordinate Transform
External Displacement/transform to
Inertial axes"
 /begin REF_MEASUREMENT ModelWithControllersOnly_B.Product_iz ModelWithControllersOnly_B.Reshape1_nq ModelWithControllersOnly_B.Reshape2_e ModelWithControllersOnly_B.Sum_i ModelWithControllersOnly_B.Transpose1_m /end REF_MEASUREMENT
/end GROUP
/begin GROUP ModelWithControllersOnly_Vehicle_Dynamics1_VehicleDynamics_Vehicle_Body_3DOF_Single_Track_Signal_Routing_Signal_Routing_Lateral_3DOF_Hitch_Coordinate_Transform_Hard_Point_Coordinate_Transform_External_Displacement_transform_to_Inertial_axes1 "ModelWithControllersOnly/Vehicle Dynamics1/VehicleDynamics/Vehicle Body 3DOF Single Track/Signal Routing/Signal Routing/Lateral 3DOF/Hitch Coordinate Transform/Hard Point Coordinate Transform
External Displacement/transform to
Inertial axes1"
 /begin REF_MEASUREMENT ModelWithControllersOnly_B.Product_a ModelWithControllersOnly_B.Reshape1_f ModelWithControllersOnly_B.Reshape2_mj ModelWithControllersOnly_B.Transpose1_m ModelWithControllersOnly_B.VectorConcatenate_h /end REF_MEASUREMENT
/end GROUP
/begin GROUP ModelWithControllersOnly_Vehicle_Dynamics1_VehicleDynamics_Vehicle_Body_3DOF_Single_Track_Signal_Routing_Signal_Routing_Lateral_3DOF_Hitch_Coordinate_Transform_Hard_Point_Coordinate_Transform_External_Displacement_wxR "ModelWithControllersOnly/Vehicle Dynamics1/VehicleDynamics/Vehicle Body 3DOF Single Track/Signal Routing/Signal Routing/Lateral 3DOF/Hitch Coordinate Transform/Hard Point Coordinate Transform
External Displacement/wxR"
 /begin SUB_GROUP ModelWithControllersOnly_Vehicle_Dynamics1_VehicleDynamics_Vehicle_Body_3DOF_Single_Track_Signal_Routing_Signal_Routing_Lateral_3DOF_Hitch_Coordinate_Transform_Hard_Point_Coordinate_Transform_External_Displacement_wxR_Subsystem ModelWithControllersOnly_Vehicle_Dynamics1_VehicleDynamics_Vehicle_Body_3DOF_Single_Track_Signal_Routing_Signal_Routing_Lateral_3DOF_Hitch_Coordinate_Transform_Hard_Point_Coordinate_Transform_External_Displacement_wxR_Subsystem1 /end SUB_GROUP
 /begin REF_MEASUREMENT ModelWithControllersOnly_B.Sum_i /end REF_MEASUREMENT
/end GROUP
/begin GROUP ModelWithControllersOnly_Vehicle_Dynamics1_VehicleDynamics_Vehicle_Body_3DOF_Single_Track_Signal_Routing_Signal_Routing_Lateral_3DOF_Hitch_Coordinate_Transform_Hard_Point_Coordinate_Transform_External_Displacement_wxR_Subsystem "ModelWithControllersOnly/Vehicle Dynamics1/VehicleDynamics/Vehicle Body 3DOF Single Track/Signal Routing/Signal Routing/Lateral 3DOF/Hitch Coordinate Transform/Hard Point Coordinate Transform
External Displacement/wxR/Subsystem"
 /begin REF_MEASUREMENT ModelWithControllersOnly_B.VectorConcatenate_h ModelWithControllersOnly_B.ixj_c ModelWithControllersOnly_B.jxk_b ModelWithControllersOnly_B.kxi_e /end REF_MEASUREMENT
/end GROUP
/begin GROUP ModelWithControllersOnly_Vehicle_Dynamics1_VehicleDynamics_Vehicle_Body_3DOF_Single_Track_Signal_Routing_Signal_Routing_Lateral_3DOF_Hitch_Coordinate_Transform_Hard_Point_Coordinate_Transform_External_Displacement_wxR_Subsystem1 "ModelWithControllersOnly/Vehicle Dynamics1/VehicleDynamics/Vehicle Body 3DOF Single Track/Signal Routing/Signal Routing/Lateral 3DOF/Hitch Coordinate Transform/Hard Point Coordinate Transform
External Displacement/wxR/Subsystem1"
 /begin REF_MEASUREMENT ModelWithControllersOnly_B.VectorConcatenate_h ModelWithControllersOnly_B.ixk_p ModelWithControllersOnly_B.jxi_h1 ModelWithControllersOnly_B.kxj_f /end REF_MEASUREMENT
/end GROUP
/begin GROUP ModelWithControllersOnly_Vehicle_Dynamics1_VehicleDynamics_Vehicle_Body_3DOF_Single_Track_Signal_Routing_Signal_Routing_Power "ModelWithControllersOnly/Vehicle Dynamics1/VehicleDynamics/Vehicle Body 3DOF Single Track/Signal Routing/Signal Routing/Power"
 /begin SUB_GROUP ModelWithControllersOnly_Vehicle_Dynamics1_VehicleDynamics_Vehicle_Body_3DOF_Single_Track_Signal_Routing_Signal_Routing_Power_Power_Accounting_Bus_Creator ModelWithControllersOnly_Vehicle_Dynamics1_VehicleDynamics_Vehicle_Body_3DOF_Single_Track_Signal_Routing_Signal_Routing_Power_xdot_mode /end SUB_GROUP
 /begin REF_MEASUREMENT ModelWithControllersOnly_B.Add1_f ModelWithControllersOnly_B.Add1_h ModelWithControllersOnly_B.Add1_o0 ModelWithControllersOnly_B.Product12 ModelWithControllersOnly_B.Product13 ModelWithControllersOnly_B.Product14 ModelWithControllersOnly_B.Product2_m ModelWithControllersOnly_B.Product3_b ModelWithControllersOnly_B.Product5 ModelWithControllersOnly_B.Product6 ModelWithControllersOnly_B.Product7 ModelWithControllersOnly_B.Product8 ModelWithControllersOnly_B.Product_po ModelWithControllersOnly_B.SumofElements1 ModelWithControllersOnly_B.SumofElements2 ModelWithControllersOnly_B.SumofElements3 ModelWithControllersOnly_B.UnaryMinus5 ModelWithControllersOnly_B.UnitConversion ModelWithControllersOnly_B.UnitConversion1_f ModelWithControllersOnly_B.UnitConversion1_n ModelWithControllersOnly_B.UnitConversion2 ModelWithControllersOnly_B.VectorConcatenate1_n ModelWithControllersOnly_B.VectorConcatenate2_o ModelWithControllersOnly_B.VectorConcatenate3_l /end REF_MEASUREMENT
/end GROUP
/begin GROUP ModelWithControllersOnly_Vehicle_Dynamics1_VehicleDynamics_Vehicle_Body_3DOF_Single_Track_Signal_Routing_Signal_Routing_Power_xdot_mode "ModelWithControllersOnly/Vehicle Dynamics1/VehicleDynamics/Vehicle Body 3DOF Single Track/Signal Routing/Signal Routing/Power/xdot mode"
 /begin SUB_GROUP ModelWithControllersOnly_Vehicle_Dynamics1_VehicleDynamics_Vehicle_Body_3DOF_Single_Track_Signal_Routing_Signal_Routing_Power_xdot_mode_FxIn /end SUB_GROUP
/end GROUP
/begin GROUP ModelWithControllersOnly_Vehicle_Dynamics1_VehicleDynamics_Vehicle_Body_3DOF_Single_Track_Signal_Routing_Signal_Routing_Power_xdot_mode_FxIn "ModelWithControllersOnly/Vehicle Dynamics1/VehicleDynamics/Vehicle Body 3DOF Single Track/Signal Routing/Signal Routing/Power/xdot mode/FxIn"
 /begin REF_MEASUREMENT ModelWithControllersOnly_B.Product14 ModelWithControllersOnly_B.Product2_m ModelWithControllersOnly_B.Product3_b ModelWithControllersOnly_B.Product8 ModelWithControllersOnly_B.Sum1 ModelWithControllersOnly_B.Sum_e /end REF_MEASUREMENT
/end GROUP
/begin GROUP ModelWithControllersOnly_Vehicle_Dynamics1_VehicleDynamics_Vehicle_Body_3DOF_Single_Track_Signal_Routing_Signal_Routing_state2bus "ModelWithControllersOnly/Vehicle Dynamics1/VehicleDynamics/Vehicle Body 3DOF Single Track/Signal Routing/Signal Routing/state2bus"
 /begin SUB_GROUP ModelWithControllersOnly_Vehicle_Dynamics1_VehicleDynamics_Vehicle_Body_3DOF_Single_Track_Signal_Routing_Signal_Routing_state2bus_Angle_Wrap ModelWithControllersOnly_Vehicle_Dynamics1_VehicleDynamics_Vehicle_Body_3DOF_Single_Track_Signal_Routing_Signal_Routing_state2bus_Body_Slip ModelWithControllersOnly_Vehicle_Dynamics1_VehicleDynamics_Vehicle_Body_3DOF_Single_Track_Signal_Routing_Signal_Routing_state2bus_Rotation_Angles_to_Direction_Cosine_Matrix ModelWithControllersOnly_Vehicle_Dynamics1_VehicleDynamics_Vehicle_Body_3DOF_Single_Track_Signal_Routing_Signal_Routing_state2bus_xddot2ax /end SUB_GROUP
 /begin REF_CHARACTERISTIC ModelWithControllersOn_cal_impl.Constant10_Value ModelWithControllersOn_cal_impl.Constant1_Value_o ModelWithControllersOn_cal_impl.Constant2_Value ModelWithControllersOn_cal_impl.Constant3_Value_j ModelWithControllersOn_cal_impl.Constant4_Value_g ModelWithControllersOn_cal_impl.Constant5_Value ModelWithControllersOn_cal_impl.Constant6_Value ModelWithControllersOn_cal_impl.Constant7_Value ModelWithControllersOn_cal_impl.Constant8_Value ModelWithControllersOn_cal_impl.Constant9_Value_n ModelWithControllersOn_cal_impl.Constant_Value_a /end REF_CHARACTERISTIC
 /begin REF_MEASUREMENT ModelWithControllersOnly_B.Constant10 ModelWithControllersOnly_B.Constant9 ModelWithControllersOnly_B.az ModelWithControllersOnly_B.zddot /end REF_MEASUREMENT
/end GROUP
/begin GROUP ModelWithControllersOnly_Vehicle_Dynamics1_VehicleDynamics_Vehicle_Body_3DOF_Single_Track_Signal_Routing_Signal_Routing_state2bus_Body_Slip "ModelWithControllersOnly/Vehicle Dynamics1/VehicleDynamics/Vehicle Body 3DOF Single Track/Signal Routing/Signal Routing/state2bus/Body Slip"
 /begin SUB_GROUP ModelWithControllersOnly_Vehicle_Dynamics1_VehicleDynamics_Vehicle_Body_3DOF_Single_Track_Signal_Routing_Signal_Routing_state2bus_Body_Slip_div0protect___abs_poly /end SUB_GROUP
 /begin REF_MEASUREMENT ModelWithControllersOnly_B.Beta_n ModelWithControllersOnly_B.Divide_p ModelWithControllersOnly_B.Switch_p /end REF_MEASUREMENT
/end GROUP
/begin GROUP ModelWithControllersOnly_Vehicle_Dynamics1_VehicleDynamics_Vehicle_Body_3DOF_Single_Track_Signal_Routing_Signal_Routing_state2bus_Body_Slip_div0protect___abs_poly "ModelWithControllersOnly/Vehicle Dynamics1/VehicleDynamics/Vehicle Body 3DOF Single Track/Signal Routing/Signal Routing/state2bus/Body Slip/div0protect - abs poly"
 /begin SUB_GROUP ModelWithControllersOnly_Vehicle_Dynamics1_VehicleDynamics_Vehicle_Body_3DOF_Single_Track_Signal_Routing_Signal_Routing_state2bus_Body_Slip_div0protect___abs_poly_Compare_To_Constant ModelWithControllersOnly_Vehicle_Dynamics1_VehicleDynamics_Vehicle_Body_3DOF_Single_Track_Signal_Routing_Signal_Routing_state2bus_Body_Slip_div0protect___abs_poly_Compare_To_Constant1 /end SUB_GROUP
 /begin REF_MEASUREMENT ModelWithControllersOnly_B.Abs ModelWithControllersOnly_B.Compare_i ModelWithControllersOnly_B.Compare_p ModelWithControllersOnly_B.Fcn ModelWithControllersOnly_B.LogicalOperator_e ModelWithControllersOnly_B.Switch_p /end REF_MEASUREMENT
/end GROUP
/begin GROUP ModelWithControllersOnly_Vehicle_Dynamics1_VehicleDynamics_Vehicle_Body_3DOF_Single_Track_Signal_Routing_Signal_Routing_state2bus_Body_Slip_div0protect___abs_poly_Compare_To_Constant "ModelWithControllersOnly/Vehicle Dynamics1/VehicleDynamics/Vehicle Body 3DOF Single Track/Signal Routing/Signal Routing/state2bus/Body Slip/div0protect - abs poly/Compare
To Constant" /begin REF_MEASUREMENT ModelWithControllersOnly_B.Compare_i /end REF_MEASUREMENT /end GROUP
/begin GROUP ModelWithControllersOnly_Vehicle_Dynamics1_VehicleDynamics_Vehicle_Body_3DOF_Single_Track_Signal_Routing_Signal_Routing_state2bus_Body_Slip_div0protect___abs_poly_Compare_To_Constant1 "ModelWithControllersOnly/Vehicle Dynamics1/VehicleDynamics/Vehicle Body 3DOF Single Track/Signal Routing/Signal Routing/state2bus/Body Slip/div0protect - abs poly/Compare
To Constant1" /begin REF_MEASUREMENT ModelWithControllersOnly_B.Compare_p /end REF_MEASUREMENT /end GROUP
/begin GROUP ModelWithControllersOnly_Vehicle_Dynamics1_VehicleDynamics_Vehicle_Body_3DOF_Single_Track_Signal_Routing_Signal_Routing_state2bus_Rotation_Angles_to_Direction_Cosine_Matrix "ModelWithControllersOnly/Vehicle Dynamics1/VehicleDynamics/Vehicle Body 3DOF Single Track/Signal Routing/Signal Routing/state2bus/Rotation Angles to
Direction Cosine Matrix"
 /begin SUB_GROUP ModelWithControllersOnly_Vehicle_Dynamics1_VehicleDynamics_Vehicle_Body_3DOF_Single_Track_Signal_Routing_Signal_Routing_state2bus_Rotation_Angles_to_Direction_Cosine_Matrix_Create_3x3_Matrix /end SUB_GROUP
 /begin REF_MEASUREMENT ModelWithControllersOnly_B.TmpSignalConversionAtsincosInpo ModelWithControllersOnly_B.VectorConcatenate_jc ModelWithControllersOnly_B.sincos_o1_bs ModelWithControllersOnly_B.sincos_o2_f /end REF_MEASUREMENT
/end GROUP
/begin GROUP ModelWithControllersOnly_Vehicle_Dynamics1_VehicleDynamics_Vehicle_Body_3DOF_Single_Track_Signal_Routing_Signal_Routing_state2bus_Rotation_Angles_to_Direction_Cosine_Matrix_Create_3x3_Matrix "ModelWithControllersOnly/Vehicle Dynamics1/VehicleDynamics/Vehicle Body 3DOF Single Track/Signal Routing/Signal Routing/state2bus/Rotation Angles to
Direction Cosine Matrix/Create 3x3 Matrix"
 /begin REF_MEASUREMENT ModelWithControllersOnly_B.Reshape9to3x3columnmajor_l ModelWithControllersOnly_B.VectorConcatenate_jc /end REF_MEASUREMENT
/end GROUP
/begin GROUP ModelWithControllersOnly_Vehicle_Dynamics1_VehicleDynamics_Vehicle_Body_3DOF_Single_Track_Signal_Routing_Signal_Routing_state2bus_xddot2ax "ModelWithControllersOnly/Vehicle Dynamics1/VehicleDynamics/Vehicle Body 3DOF Single Track/Signal Routing/Signal Routing/state2bus/xddot2ax"
 /begin SUB_GROUP ModelWithControllersOnly_Vehicle_Dynamics1_VehicleDynamics_Vehicle_Body_3DOF_Single_Track_Signal_Routing_Signal_Routing_state2bus_xddot2ax_m_22gn /end SUB_GROUP
 /begin REF_MEASUREMENT ModelWithControllersOnly_B.Divide1 ModelWithControllersOnly_B.Divide_c ModelWithControllersOnly_B.ax ModelWithControllersOnly_B.ay /end REF_MEASUREMENT
/end GROUP
/begin GROUP ModelWithControllersOnly_Vehicle_Dynamics1_VehicleDynamics_Vehicle_Body_3DOF_Single_Track_Signal_Routing_Signal_Routing_state2bus_xddot2ax_m_22gn "ModelWithControllersOnly/Vehicle Dynamics1/VehicleDynamics/Vehicle Body 3DOF Single Track/Signal Routing/Signal Routing/state2bus/xddot2ax/m^22gn"
 /begin REF_MEASUREMENT ModelWithControllersOnly_B.UnitConversion ModelWithControllersOnly_B.UnitConversion1_n ModelWithControllersOnly_B.ax ModelWithControllersOnly_B.ay /end REF_MEASUREMENT
/end GROUP
/begin GROUP ModelWithControllersOnly_Vehicle_Dynamics1_VehicleDynamics_Vehicle_Body_3DOF_Single_Track_friction "ModelWithControllersOnly/Vehicle Dynamics1/VehicleDynamics/Vehicle Body 3DOF Single Track/friction"
 /begin SUB_GROUP ModelWithControllersOnly_Vehicle_Dynamics1_VehicleDynamics_Vehicle_Body_3DOF_Single_Track_friction_mu_int /end SUB_GROUP
/end GROUP
/begin GROUP ModelWithControllersOnly_Vehicle_Dynamics1_VehicleDynamics_Vehicle_Body_3DOF_Single_Track_friction_mu_int "ModelWithControllersOnly/Vehicle Dynamics1/VehicleDynamics/Vehicle Body 3DOF Single Track/friction/mu int"
 /begin REF_CHARACTERISTIC ModelWithControllersOn_cal_impl.VehicleBody3DOFSingleTrack_mu /end REF_CHARACTERISTIC
/end GROUP
/begin GROUP ModelWithControllersOnly_Vehicle_Dynamics1_VehicleDynamics_Vehicle_Body_3DOF_Single_Track_front_forces "ModelWithControllersOnly/Vehicle Dynamics1/VehicleDynamics/Vehicle Body 3DOF Single Track/front forces"
 /begin SUB_GROUP ModelWithControllersOnly_Vehicle_Dynamics1_VehicleDynamics_Vehicle_Body_3DOF_Single_Track_front_forces_ext_long /end SUB_GROUP
/end GROUP
/begin GROUP ModelWithControllersOnly_Vehicle_Dynamics1_VehicleDynamics_Vehicle_Body_3DOF_Single_Track_front_steer "ModelWithControllersOnly/Vehicle Dynamics1/VehicleDynamics/Vehicle Body 3DOF Single Track/front steer"
 /begin SUB_GROUP ModelWithControllersOnly_Vehicle_Dynamics1_VehicleDynamics_Vehicle_Body_3DOF_Single_Track_front_steer_delta_ext /end SUB_GROUP
/end GROUP
/begin GROUP ModelWithControllersOnly_Vehicle_Dynamics1_VehicleDynamics_Vehicle_Body_3DOF_Single_Track_rear_forces "ModelWithControllersOnly/Vehicle Dynamics1/VehicleDynamics/Vehicle Body 3DOF Single Track/rear forces"
 /begin SUB_GROUP ModelWithControllersOnly_Vehicle_Dynamics1_VehicleDynamics_Vehicle_Body_3DOF_Single_Track_rear_forces_ext_long /end SUB_GROUP
/end GROUP
/begin GROUP ModelWithControllersOnly_Vehicle_Dynamics1_VehicleDynamics_Vehicle_Body_3DOF_Single_Track_sigma "ModelWithControllersOnly/Vehicle Dynamics1/VehicleDynamics/Vehicle Body 3DOF Single Track/sigma"
 /begin SUB_GROUP ModelWithControllersOnly_Vehicle_Dynamics1_VehicleDynamics_Vehicle_Body_3DOF_Single_Track_sigma_sigma /end SUB_GROUP
/end GROUP
/begin GROUP ModelWithControllersOnly_Vehicle_Dynamics1_VehicleDynamics_Vehicle_Body_3DOF_Single_Track_sigma_sigma "ModelWithControllersOnly/Vehicle Dynamics1/VehicleDynamics/Vehicle Body 3DOF Single Track/sigma/sigma"
 /begin SUB_GROUP ModelWithControllersOnly_Vehicle_Dynamics1_VehicleDynamics_Vehicle_Body_3DOF_Single_Track_sigma_sigma_relaxation_front ModelWithControllersOnly_Vehicle_Dynamics1_VehicleDynamics_Vehicle_Body_3DOF_Single_Track_sigma_sigma_relaxation_rear /end SUB_GROUP
 /begin REF_CHARACTERISTIC ModelWithControllersOn_cal_impl.VehicleBody3DOFSingleTrack_si_n ModelWithControllersOn_cal_impl.VehicleBody3DOFSingleTrack_sigm /end REF_CHARACTERISTIC
/end GROUP
/begin GROUP ModelWithControllersOnly_Vehicle_Dynamics1_VehicleDynamics_Vehicle_Body_3DOF_Single_Track_sigma_sigma_relaxation_front "ModelWithControllersOnly/Vehicle Dynamics1/VehicleDynamics/Vehicle Body 3DOF Single Track/sigma/sigma/relaxation front" /begin REF_CHARACTERISTIC ModelWithControllersOn_cal_impl.lateral_IC /end REF_CHARACTERISTIC
 /begin REF_MEASUREMENT ModelWithControllersOnly_B.Product1_h ModelWithControllersOnly_B.Sum_c ModelWithControllersOnly_B.lateral /end REF_MEASUREMENT
/end GROUP
/begin GROUP ModelWithControllersOnly_Vehicle_Dynamics1_VehicleDynamics_Vehicle_Body_3DOF_Single_Track_sigma_sigma_relaxation_rear "ModelWithControllersOnly/Vehicle Dynamics1/VehicleDynamics/Vehicle Body 3DOF Single Track/sigma/sigma/relaxation rear" /begin REF_CHARACTERISTIC ModelWithControllersOn_cal_impl.lateral_IC_a /end REF_CHARACTERISTIC
 /begin REF_MEASUREMENT ModelWithControllersOnly_B.Product1_af ModelWithControllersOnly_B.Sum_g ModelWithControllersOnly_B.lateral_g /end REF_MEASUREMENT
/end GROUP
/begin GROUP ModelWithControllersOnly_Vehicle_Dynamics1_VehicleDynamics_Vehicle_Body_3DOF_Single_Track_state "ModelWithControllersOnly/Vehicle Dynamics1/VehicleDynamics/Vehicle Body 3DOF Single Track/state"
 /begin SUB_GROUP ModelWithControllersOnly_Vehicle_Dynamics1_VehicleDynamics_Vehicle_Body_3DOF_Single_Track_state_xdot_int /end SUB_GROUP
/end GROUP
/begin GROUP ModelWithControllersOnly_Vehicle_Dynamics1_VehicleDynamics_Vehicle_Body_3DOF_Single_Track_wind "ModelWithControllersOnly/Vehicle Dynamics1/VehicleDynamics/Vehicle Body 3DOF Single Track/wind"
 /begin SUB_GROUP ModelWithControllersOnly_Vehicle_Dynamics1_VehicleDynamics_Vehicle_Body_3DOF_Single_Track_wind_wind_int /end SUB_GROUP
/end GROUP
/begin GROUP ModelWithControllersOnly_Vehicle_Dynamics1_VehicleDynamics_engine_steer_brake_dynamics "ModelWithControllersOnly/Vehicle Dynamics1/VehicleDynamics/engine-steer-brake dynamics"
 /begin SUB_GROUP ModelWithControllersOnly_Vehicle_Dynamics1_VehicleDynamics_engine_steer_brake_dynamics_Mapped_Steering /end SUB_GROUP
 /begin REF_CHARACTERISTIC ModelWithControllersOn_cal_impl.Gain2_Gain_h0 ModelWithControllersOn_cal_impl.UnitDelay_InitialCondition_f ModelWithControllersOn_cal_impl.degtorad1_Gain ModelWithControllersOn_cal_impl.secondorderlowpassbrakemodel_In ModelWithControllersOn_cal_impl.secondorderlowpasssteeringmodel ModelWithControllersOn_cal_impl.secondorderlowpasstorquemodel_I /end REF_CHARACTERISTIC
 /begin REF_MEASUREMENT ModelWithControllersOnly_B.Add_p3 ModelWithControllersOnly_B.BrakeSaturation_m ModelWithControllersOnly_B.DeadZone ModelWithControllersOnly_B.DeadZone1 ModelWithControllersOnly_B.SteeringSaturation ModelWithControllersOnly_B.TbrakeNm ModelWithControllersOnly_B.TengineNm ModelWithControllersOnly_B.ThrottleSaturation_p ModelWithControllersOnly_B.Tnet ModelWithControllersOnly_B.TnetNm_e ModelWithControllersOnly_B.UnitDelay_p ModelWithControllersOnly_B.rollingresistance ModelWithControllersOnly_B.steeringwheelangledeg ModelWithControllersOnly_B.steeringwheelanglerad ModelWithControllersOnly_B.uDLookupTable1 ModelWithControllersOnly_B.uDLookupTable_c ModelWithControllersOnly_DW.Scope1_PWORK_k ModelWithControllersOnly_DW.Scope2_PWORK ModelWithControllersOnly_DW.Scope3_PWORK ModelWithControllersOnly_DW.UnitDelay_DSTATE_l ModelWithControllersOnly_DW.secondorderlowpassbrakemodel_st ModelWithControllersOnly_DW.secondorderlowpassbrakemodel_tm ModelWithControllersOnly_DW.secondorderlowpasssteeringmod_c ModelWithControllersOnly_DW.secondorderlowpasssteeringmodel ModelWithControllersOnly_DW.secondorderlowpasstorquemodel_s ModelWithControllersOnly_DW.secondorderlowpasstorquemodel_t /end REF_MEASUREMENT
/end GROUP
/begin GROUP ModelWithControllersOnly_Vehicle_Dynamics1_VehicleDynamics_engine_steer_brake_dynamics_Mapped_Steering "ModelWithControllersOnly/Vehicle Dynamics1/VehicleDynamics/engine-steer-brake dynamics/Mapped Steering"
 /begin SUB_GROUP ModelWithControllersOnly_Vehicle_Dynamics1_VehicleDynamics_engine_steer_brake_dynamics_Mapped_Steering_LookupGain ModelWithControllersOnly_Vehicle_Dynamics1_VehicleDynamics_engine_steer_brake_dynamics_Mapped_Steering_Mapped /end SUB_GROUP
/end GROUP
/begin GROUP ModelWithControllersOnly_Vehicle_Dynamics1_VehicleDynamics_engine_steer_brake_dynamics_Mapped_Steering_LookupGain "ModelWithControllersOnly/Vehicle Dynamics1/VehicleDynamics/engine-steer-brake dynamics/Mapped Steering/LookupGain"
 /begin REF_CHARACTERISTIC ModelWithControllersOn_cal_impl.LookupGain_tbl ModelWithControllersOn_cal_impl.uDLookupTable_dimSizes ModelWithControllersOn_cal_impl.uDLookupTable_maxIndex ModelWithControllersOn_cal_impl.uDLookupTable_numYWorkElts /end REF_CHARACTERISTIC
 /begin REF_MEASUREMENT ModelWithControllersOnly_B.Product_kk ModelWithControllersOnly_B.steeringwheelanglerad ModelWithControllersOnly_B.uDLookupTable ModelWithControllersOnly_DW.SWork ModelWithControllersOnly_DW.TWork ModelWithControllersOnly_DW.m_bpDataSet ModelWithControllersOnly_DW.m_bpIndex ModelWithControllersOnly_DW.m_bpLambda ModelWithControllersOnly_DW.m_up ModelWithControllersOnly_DW.m_y2 ModelWithControllersOnly_DW.m_yy2 ModelWithControllersOnly_DW.m_yyA ModelWithControllersOnly_DW.m_yyB ModelWithControllersOnly_DW.prevBp0AndTableData ModelWithControllersOnly_DW.reCalcSecDerivFirstDimCoeffs /end REF_MEASUREMENT
/end GROUP
/begin GROUP ModelWithControllersOnly_Vehicle_Dynamics1_VehicleDynamics_engine_steer_brake_dynamics_Mapped_Steering_Mapped "ModelWithControllersOnly/Vehicle Dynamics1/VehicleDynamics/engine-steer-brake dynamics/Mapped Steering/Mapped"
 /begin REF_CHARACTERISTIC ModelWithControllersOn_cal_impl.uDLookupTable1_tableData ModelWithControllersOn_cal_impl.uDLookupTable_tableData /end REF_CHARACTERISTIC
 /begin REF_MEASUREMENT ModelWithControllersOnly_B.Product_kk ModelWithControllersOnly_B.uDLookupTable1 ModelWithControllersOnly_B.uDLookupTable_c /end REF_MEASUREMENT
/end GROUP
/end MODULE
/end PROJECT
