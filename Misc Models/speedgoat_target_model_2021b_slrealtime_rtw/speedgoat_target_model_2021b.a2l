/******************************************************************************
* ASAP2 file: speedgoat_target_model_2021b.a2l
* Academic License - for use in teaching, academic research, and meeting
* course requirements at degree granting institutions only. Not for
* government, commercial, or other organizational use.
* Code generation for model "speedgoat_target_model_2021b".
* Model version : 1.14
* Simulink Coder version : 10.4 R2021b
* C source code generated on : Tue Oct 25 18:52:00 2022
* Target selection: slrealtime.tlc
* Embedded hardware selection: Intel->x86-64 (Linux 64)
* Code generation objectives: Unspecified
* Validation result: Not run
* (add additional file header information here)
******************************************************************************/ ASAP2_VERSION 1 71
/begin PROJECT ProjectName "Project Comment Goes Here"
/begin HEADER "Header Comments go here" /end HEADER
/begin MODULE ModuleName "Module Comment Goes Here"
/begin IF_DATA XCP
 /begin PROTOCOL_LAYER 0x0100 0x03E8 0x00C8 0x0000 0x0000 0x0000 0x0000 0x0000 0xFC 0x0578 BYTE_ORDER_MSB_LAST ADDRESS_GRANULARITY_BYTE OPTIONAL_CMD ALLOC_ODT_ENTRY OPTIONAL_CMD ALLOC_ODT OPTIONAL_CMD ALLOC_DAQ OPTIONAL_CMD FREE_DAQ OPTIONAL_CMD GET_DAQ_CLOCK OPTIONAL_CMD GET_DAQ_RESOLUTION_INFO OPTIONAL_CMD GET_DAQ_PROCESSOR_INFO OPTIONAL_CMD START_STOP_SYNCH OPTIONAL_CMD START_STOP_DAQ_LIST OPTIONAL_CMD SET_DAQ_LIST_MODE OPTIONAL_CMD WRITE_DAQ OPTIONAL_CMD SET_DAQ_PTR OPTIONAL_CMD GET_CAL_PAGE OPTIONAL_CMD SET_CAL_PAGE OPTIONAL_CMD COPY_CAL_PAGE OPTIONAL_CMD SHORT_DOWNLOAD OPTIONAL_CMD DOWNLOAD_MAX OPTIONAL_CMD DOWNLOAD OPTIONAL_CMD SHORT_UPLOAD OPTIONAL_CMD UPLOAD OPTIONAL_CMD SET_MTA OPTIONAL_CMD GET_SEGMENT_INFO OPTIONAL_CMD GET_PAGE_INFO OPTIONAL_CMD SET_SEGMENT_MODE OPTIONAL_CMD GET_SEGMENT_MODE OPTIONAL_CMD GET_PAG_PROCESSOR_INFO OPTIONAL_CMD MODIFY_BITS /end PROTOCOL_LAYER
 /begin DAQ DYNAMIC 0x0000 0x0080 0x00 OPTIMISATION_TYPE_DEFAULT ADDRESS_EXTENSION_FREE IDENTIFICATION_FIELD_TYPE_RELATIVE_WORD_ALIGNED GRANULARITY_ODT_ENTRY_SIZE_DAQ_BYTE 0xFF OVERLOAD_INDICATION_PID PRESCALER_SUPPORTED /begin STIM GRANULARITY_ODT_ENTRY_SIZE_STIM_BYTE 0xFF /end STIM /begin TIMESTAMP_SUPPORTED 0x0001 SIZE_DWORD UNIT_1US TIMESTAMP_FIXED /end TIMESTAMP_SUPPORTED /begin EVENT "100 ms" "100 ms" 0x0000 DAQ 0xFF 0x01 0x08 0x00 /end EVENT /begin EVENT "1 s" "1 s" 0x0001 DAQ 0xFF 0x01 0x09 0x00 /end EVENT /end DAQ
 /begin XCP_ON_UDP_IP 0x0100 0x15B3 ADDRESS "192.168.7.2" /end XCP_ON_UDP_IP
/end IF_DATA
/begin MOD_PAR "MOD PAR Comment Goes Here"
 /begin MEMORY_SEGMENT speedgoat_target_model_cal_impl "speedgoat_target_model_cal_impl" DATA FLASH INTERN 0x00235020 0x11C8 -1 -1 -1 -1 -1
  /begin IF_DATA XCP
   /begin SEGMENT 0x00 0x02 0x00 0x00 0x00
    /begin PAGE 0x00 ECU_ACCESS_DONT_CARE XCP_READ_ACCESS_DONT_CARE XCP_WRITE_ACCESS_NOT_ALLOWED /end PAGE
    /begin PAGE 0x01 ECU_ACCESS_DONT_CARE XCP_READ_ACCESS_DONT_CARE XCP_WRITE_ACCESS_DONT_CARE /end PAGE
   /end SEGMENT
  /end IF_DATA
 /end MEMORY_SEGMENT
/end MOD_PAR
/begin MOD_COMMON "Mod Common Comment Here" BYTE_ORDER MSB_LAST ALIGNMENT_BYTE 1 ALIGNMENT_WORD 2 ALIGNMENT_LONG 4 ALIGNMENT_FLOAT32_IEEE 4 ALIGNMENT_FLOAT64_IEEE 8 ALIGNMENT_INT64 8 /end MOD_COMMON
/begin CHARACTERISTIC speedgoat_target_model_cal_impl.ACCsystem_DefaultSpacing "" VALUE 0x00235198 Scalar_FLOAT64_IEEE 0 speedgoat_target_model_2021b_CM_double -1.7E+308 1.7E+308 /end CHARACTERISTIC
/begin CHARACTERISTIC speedgoat_target_model_cal_impl.ACCsystem_MaxAcceleration "" VALUE 0x002351D8 Scalar_FLOAT64_IEEE 0 speedgoat_target_model_2021b_CM_double -1.7E+308 1.7E+308 /end CHARACTERISTIC
/begin CHARACTERISTIC speedgoat_target_model_cal_impl.ACCsystem_MaxVelocity "" VALUE 0x002351E0 Scalar_FLOAT64_IEEE 0 speedgoat_target_model_2021b_CM_double -1.7E+308 1.7E+308 /end CHARACTERISTIC
/begin CHARACTERISTIC speedgoat_target_model_cal_impl.ACCsystem_MinAcceleration "" VALUE 0x002351E8 Scalar_FLOAT64_IEEE 0 speedgoat_target_model_2021b_CM_double -1.7E+308 1.7E+308 /end CHARACTERISTIC
/begin CHARACTERISTIC speedgoat_target_model_cal_impl.ApproachingSpeed_Value "" VALUE 0x002354C0 Scalar_FLOAT64_IEEE 0 speedgoat_target_model_2021b_CM_double -1.7E+308 1.7E+308 /end CHARACTERISTIC
/begin CHARACTERISTIC speedgoat_target_model_cal_impl.BrakeSaturation_LowerSat "" VALUE 0x002352C0 Scalar_FLOAT64_IEEE 0 speedgoat_target_model_2021b_CM_double -1.7E+308 1.7E+308 /end CHARACTERISTIC
/begin CHARACTERISTIC speedgoat_target_model_cal_impl.BrakeSaturation_LowerSat_m "" VALUE 0x00235368 Scalar_FLOAT64_IEEE 0 speedgoat_target_model_2021b_CM_double -1.7E+308 1.7E+308 /end CHARACTERISTIC
/begin CHARACTERISTIC speedgoat_target_model_cal_impl.BrakeSaturation_UpperSat "" VALUE 0x002352B8 Scalar_FLOAT64_IEEE 0 speedgoat_target_model_2021b_CM_double -1.7E+308 1.7E+308 /end CHARACTERISTIC
/begin CHARACTERISTIC speedgoat_target_model_cal_impl.BrakeSaturation_UpperSat_a "" VALUE 0x00235360 Scalar_FLOAT64_IEEE 0 speedgoat_target_model_2021b_CM_double -1.7E+308 1.7E+308 /end CHARACTERISTIC
/begin CHARACTERISTIC speedgoat_target_model_cal_impl.Clear2Go_Value "" VALUE 0x002354E8 Scalar_FLOAT64_IEEE 0 speedgoat_target_model_2021b_CM_double -1.7E+308 1.7E+308 /end CHARACTERISTIC
/begin CHARACTERISTIC speedgoat_target_model_cal_impl.CompareToConstant_const "" VALUE 0x00235218 Scalar_FLOAT64_IEEE 0 speedgoat_target_model_2021b_CM_double -1.7E+308 1.7E+308 /end CHARACTERISTIC
/begin CHARACTERISTIC speedgoat_target_model_cal_impl.CompareToConstant_const_e "" VALUE 0x00235220 Scalar_FLOAT64_IEEE 0 speedgoat_target_model_2021b_CM_double -1.7E+308 1.7E+308 /end CHARACTERISTIC
/begin CHARACTERISTIC speedgoat_target_model_cal_impl.CompareToConstant_const_g "" VALUE 0x00235238 Scalar_FLOAT64_IEEE 0 speedgoat_target_model_2021b_CM_double -1.7E+308 1.7E+308 /end CHARACTERISTIC
/begin CHARACTERISTIC speedgoat_target_model_cal_impl.CompareToConstant_const_k "" VALUE 0x00235230 Scalar_FLOAT64_IEEE 0 speedgoat_target_model_2021b_CM_double -1.7E+308 1.7E+308 /end CHARACTERISTIC
/begin CHARACTERISTIC speedgoat_target_model_cal_impl.CompareToConstant_const_l "" VALUE 0x00235228 Scalar_FLOAT64_IEEE 0 speedgoat_target_model_2021b_CM_double -1.7E+308 1.7E+308 /end CHARACTERISTIC
/begin CHARACTERISTIC speedgoat_target_model_cal_impl.Constant1_Value "" VALUE 0x00235250 Scalar_FLOAT64_IEEE 0 speedgoat_target_model_2021b_CM_double -1.7E+308 1.7E+308 /end CHARACTERISTIC
/begin CHARACTERISTIC speedgoat_target_model_cal_impl.Constant1_Value_d "" VALUE 0x002352D0 Scalar_FLOAT64_IEEE 0 speedgoat_target_model_2021b_CM_double -1.7E+308 1.7E+308 /end CHARACTERISTIC
/begin CHARACTERISTIC speedgoat_target_model_cal_impl.Constant1_Value_f "" VALUE 0x00235268 Scalar_FLOAT64_IEEE 0 speedgoat_target_model_2021b_CM_double -1.7E+308 1.7E+308 /end CHARACTERISTIC
/begin CHARACTERISTIC speedgoat_target_model_cal_impl.Constant1_Value_fy "" VALUE 0x00235378 Scalar_FLOAT64_IEEE 0 speedgoat_target_model_2021b_CM_double -1.7E+308 1.7E+308 /end CHARACTERISTIC
/begin CHARACTERISTIC speedgoat_target_model_cal_impl.Constant1_Value_i "" VALUE 0x00235298 Scalar_FLOAT64_IEEE 0 speedgoat_target_model_2021b_CM_double -1.7E+308 1.7E+308 /end CHARACTERISTIC
/begin CHARACTERISTIC speedgoat_target_model_cal_impl.Constant1_Value_i4 "" VALUE 0x002354D0 Scalar_FLOAT64_IEEE 0 speedgoat_target_model_2021b_CM_double -1.7E+308 1.7E+308 /end CHARACTERISTIC
/begin CHARACTERISTIC speedgoat_target_model_cal_impl.Constant1_Value_id "" VALUE 0x00235680 Scalar_FLOAT64_IEEE 0 speedgoat_target_model_2021b_CM_double -1.7E+308 1.7E+308 /end CHARACTERISTIC
/begin CHARACTERISTIC speedgoat_target_model_cal_impl.Constant1_Value_o "" VALUE 0x00235340 Scalar_FLOAT64_IEEE 0 speedgoat_target_model_2021b_CM_double -1.7E+308 1.7E+308 /end CHARACTERISTIC
/begin CHARACTERISTIC speedgoat_target_model_cal_impl.Constant2_Value "" VALUE 0x00235690 Scalar_FLOAT64_IEEE 0 speedgoat_target_model_2021b_CM_double -1.7E+308 1.7E+308 /end CHARACTERISTIC
/begin CHARACTERISTIC speedgoat_target_model_cal_impl.Constant3_Value "" VALUE 0x00235688 Scalar_FLOAT64_IEEE 0 speedgoat_target_model_2021b_CM_double -1.7E+308 1.7E+308 /end CHARACTERISTIC
/begin CHARACTERISTIC speedgoat_target_model_cal_impl.Constant4_Value "" VALUE 0x00235678 Scalar_FLOAT64_IEEE 0 speedgoat_target_model_2021b_CM_double -1.7E+308 1.7E+308 /end CHARACTERISTIC
/begin CHARACTERISTIC speedgoat_target_model_cal_impl.Constant_Value "" VALUE 0x002352C8 Scalar_FLOAT64_IEEE 0 speedgoat_target_model_2021b_CM_double -1.7E+308 1.7E+308 /end CHARACTERISTIC
/begin CHARACTERISTIC speedgoat_target_model_cal_impl.Constant_Value_d "" VALUE 0x00235370 Scalar_FLOAT64_IEEE 0 speedgoat_target_model_2021b_CM_double -1.7E+308 1.7E+308 /end CHARACTERISTIC
/begin CHARACTERISTIC speedgoat_target_model_cal_impl.Constant_Value_dy "" VALUE 0x00235450 Scalar_FLOAT64_IEEE 0 speedgoat_target_model_2021b_CM_double -1.7E+308 1.7E+308 /end CHARACTERISTIC
/begin CHARACTERISTIC speedgoat_target_model_cal_impl.Constant_Value_g "" VALUE 0x00235470 Scalar_FLOAT64_IEEE 0 speedgoat_target_model_2021b_CM_double -1.7E+308 1.7E+308 /end CHARACTERISTIC
/begin CHARACTERISTIC speedgoat_target_model_cal_impl.Constant_Value_j "" VALUE 0x00235480 Scalar_FLOAT64_IEEE 0 speedgoat_target_model_2021b_CM_double -1.7E+308 1.7E+308 /end CHARACTERISTIC
/begin CHARACTERISTIC speedgoat_target_model_cal_impl.Constant_Value_k "" VALUE 0x00235440 Scalar_FLOAT64_IEEE 0 speedgoat_target_model_2021b_CM_double -1.7E+308 1.7E+308 /end CHARACTERISTIC
/begin CHARACTERISTIC speedgoat_target_model_cal_impl.Constant_Value_kp "" VAL_BLK 0x00235020 Scalar_FLOAT64_IEEE 0 speedgoat_target_model_2021b_CM_double -1.7E+308 1.7E+308 MATRIX_DIM 2 1 /end CHARACTERISTIC
/begin CHARACTERISTIC speedgoat_target_model_cal_impl.Constant_Value_m "" VALUE 0x002356A8 Scalar_FLOAT64_IEEE 0 speedgoat_target_model_2021b_CM_double -1.7E+308 1.7E+308 /end CHARACTERISTIC
/begin CHARACTERISTIC speedgoat_target_model_cal_impl.Constant_Value_p "" VALUE 0x00235460 Scalar_FLOAT64_IEEE 0 speedgoat_target_model_2021b_CM_double -1.7E+308 1.7E+308 /end CHARACTERISTIC
/begin CHARACTERISTIC speedgoat_target_model_cal_impl.CurrPoses_Y0 "" VALUE 0x002353D0 Scalar_FLOAT64_IEEE 0 speedgoat_target_model_2021b_CM_double -1.7E+308 1.7E+308 /end CHARACTERISTIC
/begin CHARACTERISTIC speedgoat_target_model_cal_impl.Curvature_Y0 "" VALUE 0x00235428 Scalar_FLOAT64_IEEE 0 speedgoat_target_model_2021b_CM_double -1.7E+308 1.7E+308 /end CHARACTERISTIC
/begin CHARACTERISTIC speedgoat_target_model_cal_impl.D2S_Y0 "" VALUE 0x00235408 Scalar_FLOAT64_IEEE 0 speedgoat_target_model_2021b_CM_double -1.7E+308 1.7E+308 /end CHARACTERISTIC
/begin CHARACTERISTIC speedgoat_target_model_cal_impl.Data_Y0 "" VALUE 0x002361BC Scalar_UBYTE 0 speedgoat_target_model_2021b_CM_uint8 0 255 /end CHARACTERISTIC
/begin CHARACTERISTIC speedgoat_target_model_cal_impl.Data_Y0_j "" VALUE 0x002361BD Scalar_UBYTE 0 speedgoat_target_model_2021b_CM_uint8 0 255 /end CHARACTERISTIC
/begin CHARACTERISTIC speedgoat_target_model_cal_impl.Data_Y0_ja "" VALUE 0x002361BF Scalar_UBYTE 0 speedgoat_target_model_2021b_CM_uint8 0 255 /end CHARACTERISTIC
/begin CHARACTERISTIC speedgoat_target_model_cal_impl.Data_Y0_k "" VALUE 0x002361BE Scalar_UBYTE 0 speedgoat_target_model_2021b_CM_uint8 0 255 /end CHARACTERISTIC
/begin CHARACTERISTIC speedgoat_target_model_cal_impl.Data_Y0_l "" VALUE 0x002361C0 Scalar_UBYTE 0 speedgoat_target_model_2021b_CM_uint8 0 255 /end CHARACTERISTIC
/begin CHARACTERISTIC speedgoat_target_model_cal_impl.Direction_Y0 "" VALUE 0x00235420 Scalar_FLOAT64_IEEE 0 speedgoat_target_model_2021b_CM_double -1.7E+308 1.7E+308 /end CHARACTERISTIC
/begin CHARACTERISTIC speedgoat_target_model_cal_impl.DiscreteTimeIntegrator_IC "" VALUE 0x00235288 Scalar_FLOAT64_IEEE 0 speedgoat_target_model_2021b_CM_double -1.7E+308 1.7E+308 /end CHARACTERISTIC
/begin CHARACTERISTIC speedgoat_target_model_cal_impl.DiscreteTimeIntegrator_IC_a "" VALUE 0x002352E0 Scalar_FLOAT64_IEEE 0 speedgoat_target_model_2021b_CM_double -1.7E+308 1.7E+308 /end CHARACTERISTIC
/begin CHARACTERISTIC speedgoat_target_model_cal_impl.DiscreteTimeIntegrator_IC_d "" VALUE 0x00235388 Scalar_FLOAT64_IEEE 0 speedgoat_target_model_2021b_CM_double -1.7E+308 1.7E+308 /end CHARACTERISTIC
/begin CHARACTERISTIC speedgoat_target_model_cal_impl.DiscreteTimeIntegrator_IC_i "" VALUE 0x00235330 Scalar_FLOAT64_IEEE 0 speedgoat_target_model_2021b_CM_double -1.7E+308 1.7E+308 /end CHARACTERISTIC
/begin CHARACTERISTIC speedgoat_target_model_cal_impl.DiscreteTimeIntegrator_gainva_a "" VALUE 0x00235380 Scalar_FLOAT64_IEEE 0 speedgoat_target_model_2021b_CM_double -1.7E+308 1.7E+308 /end CHARACTERISTIC
/begin CHARACTERISTIC speedgoat_target_model_cal_impl.DiscreteTimeIntegrator_gainva_c "" VALUE 0x00235328 Scalar_FLOAT64_IEEE 0 speedgoat_target_model_2021b_CM_double -1.7E+308 1.7E+308 /end CHARACTERISTIC
/begin CHARACTERISTIC speedgoat_target_model_cal_impl.DiscreteTimeIntegrator_gainva_j "" VALUE 0x002352D8 Scalar_FLOAT64_IEEE 0 speedgoat_target_model_2021b_CM_double -1.7E+308 1.7E+308 /end CHARACTERISTIC
/begin CHARACTERISTIC speedgoat_target_model_cal_impl.DiscreteTimeIntegrator_gainval "" VALUE 0x00235280 Scalar_FLOAT64_IEEE 0 speedgoat_target_model_2021b_CM_double -1.7E+308 1.7E+308 /end CHARACTERISTIC
/begin CHARACTERISTIC speedgoat_target_model_cal_impl.E_zero_Value "" VALUE 0x002355F0 Scalar_FLOAT64_IEEE 0 speedgoat_target_model_2021b_CM_double -1.7E+308 1.7E+308 /end CHARACTERISTIC
/begin CHARACTERISTIC speedgoat_target_model_cal_impl.Enableoptimizationconstant_Valu "" VALUE 0x002355E8 Scalar_FLOAT64_IEEE 0 speedgoat_target_model_2021b_CM_double -1.7E+308 1.7E+308 /end CHARACTERISTIC
/begin CHARACTERISTIC speedgoat_target_model_cal_impl.Externalcontrolsignalconstant_V "" VALUE 0x00235580 Scalar_FLOAT64_IEEE 0 speedgoat_target_model_2021b_CM_double -1.7E+308 1.7E+308 /end CHARACTERISTIC
/begin CHARACTERISTIC speedgoat_target_model_cal_impl.F_zero_Value "" VAL_BLK 0x00235040 Scalar_FLOAT64_IEEE 0 speedgoat_target_model_2021b_CM_double -1.7E+308 1.7E+308 MATRIX_DIM 2 1 /end CHARACTERISTIC
/begin CHARACTERISTIC speedgoat_target_model_cal_impl.G_zero_Value "" VALUE 0x002355F8 Scalar_FLOAT64_IEEE 0 speedgoat_target_model_2021b_CM_double -1.7E+308 1.7E+308 /end CHARACTERISTIC
/begin CHARACTERISTIC speedgoat_target_model_cal_impl.Gain1_Gain "" VALUE 0x00235290 Scalar_FLOAT64_IEEE 0 speedgoat_target_model_2021b_CM_double -1.7E+308 1.7E+308 /end CHARACTERISTIC
/begin CHARACTERISTIC speedgoat_target_model_cal_impl.Gain1_Gain_d "" VALUE 0x002352F0 Scalar_FLOAT64_IEEE 0 speedgoat_target_model_2021b_CM_double -1.7E+308 1.7E+308 /end CHARACTERISTIC
/begin CHARACTERISTIC speedgoat_target_model_cal_impl.Gain1_Gain_j "" VALUE 0x00235398 Scalar_FLOAT64_IEEE 0 speedgoat_target_model_2021b_CM_double -1.7E+308 1.7E+308 /end CHARACTERISTIC
/begin CHARACTERISTIC speedgoat_target_model_cal_impl.Gain1_Gain_j3 "" VALUE 0x00235490 Scalar_FLOAT64_IEEE 0 speedgoat_target_model_2021b_CM_double -1.7E+308 1.7E+308 /end CHARACTERISTIC
/begin CHARACTERISTIC speedgoat_target_model_cal_impl.Gain1_Gain_m "" VALUE 0x00235338 Scalar_FLOAT64_IEEE 0 speedgoat_target_model_2021b_CM_double -1.7E+308 1.7E+308 /end CHARACTERISTIC
/begin CHARACTERISTIC speedgoat_target_model_cal_impl.Gain2_Gain "" VALUE 0x002352A0 Scalar_FLOAT64_IEEE 0 speedgoat_target_model_2021b_CM_double -1.7E+308 1.7E+308 /end CHARACTERISTIC
/begin CHARACTERISTIC speedgoat_target_model_cal_impl.Gain2_Gain_h "" VALUE 0x002353A0 Scalar_FLOAT64_IEEE 0 speedgoat_target_model_2021b_CM_double -1.7E+308 1.7E+308 /end CHARACTERISTIC
/begin CHARACTERISTIC speedgoat_target_model_cal_impl.Gain2_Gain_l "" VALUE 0x00235348 Scalar_FLOAT64_IEEE 0 speedgoat_target_model_2021b_CM_double -1.7E+308 1.7E+308 /end CHARACTERISTIC
/begin CHARACTERISTIC speedgoat_target_model_cal_impl.Gain2_Gain_n "" VALUE 0x002352F8 Scalar_FLOAT64_IEEE 0 speedgoat_target_model_2021b_CM_double -1.7E+308 1.7E+308 /end CHARACTERISTIC
/begin CHARACTERISTIC speedgoat_target_model_cal_impl.Gain4_Gain "" VALUE 0x002352B0 Scalar_FLOAT64_IEEE 0 speedgoat_target_model_2021b_CM_double -1.7E+308 1.7E+308 /end CHARACTERISTIC
/begin CHARACTERISTIC speedgoat_target_model_cal_impl.Gain4_Gain_b "" VALUE 0x00235300 Scalar_FLOAT64_IEEE 0 speedgoat_target_model_2021b_CM_double -1.7E+308 1.7E+308 /end CHARACTERISTIC
/begin CHARACTERISTIC speedgoat_target_model_cal_impl.Gain4_Gain_m "" VALUE 0x00235358 Scalar_FLOAT64_IEEE 0 speedgoat_target_model_2021b_CM_double -1.7E+308 1.7E+308 /end CHARACTERISTIC
/begin CHARACTERISTIC speedgoat_target_model_cal_impl.Gain4_Gain_n "" VALUE 0x002353A8 Scalar_FLOAT64_IEEE 0 speedgoat_target_model_2021b_CM_double -1.7E+308 1.7E+308 /end CHARACTERISTIC
/begin CHARACTERISTIC speedgoat_target_model_cal_impl.Gain_Gain "" VALUE 0x002352A8 Scalar_FLOAT64_IEEE 0 speedgoat_target_model_2021b_CM_double -1.7E+308 1.7E+308 /end CHARACTERISTIC
/begin CHARACTERISTIC speedgoat_target_model_cal_impl.Gain_Gain_c "" VALUE 0x00235390 Scalar_FLOAT64_IEEE 0 speedgoat_target_model_2021b_CM_double -1.7E+308 1.7E+308 /end CHARACTERISTIC
/begin CHARACTERISTIC speedgoat_target_model_cal_impl.Gain_Gain_g "" VALUE 0x00235488 Scalar_FLOAT64_IEEE 0 speedgoat_target_model_2021b_CM_double -1.7E+308 1.7E+308 /end CHARACTERISTIC
/begin CHARACTERISTIC speedgoat_target_model_cal_impl.Gain_Gain_k "" VALUE 0x00235498 Scalar_FLOAT64_IEEE 0 speedgoat_target_model_2021b_CM_double -1.7E+308 1.7E+308 /end CHARACTERISTIC
/begin CHARACTERISTIC speedgoat_target_model_cal_impl.Gain_Gain_m "" VALUE 0x00235350 Scalar_FLOAT64_IEEE 0 speedgoat_target_model_2021b_CM_double -1.7E+308 1.7E+308 /end CHARACTERISTIC
/begin CHARACTERISTIC speedgoat_target_model_cal_impl.Gain_Gain_n "" VALUE 0x002352E8 Scalar_FLOAT64_IEEE 0 speedgoat_target_model_2021b_CM_double -1.7E+308 1.7E+308 /end CHARACTERISTIC
/begin CHARACTERISTIC speedgoat_target_model_cal_impl.Integrator_gainval "" VALUE 0x00235258 Scalar_FLOAT64_IEEE 0 speedgoat_target_model_2021b_CM_double -1.7E+308 1.7E+308 /end CHARACTERISTIC
/begin CHARACTERISTIC speedgoat_target_model_cal_impl.Integrator_gainval_b "" VALUE 0x00235270 Scalar_FLOAT64_IEEE 0 speedgoat_target_model_2021b_CM_double -1.7E+308 1.7E+308 /end CHARACTERISTIC
/begin CHARACTERISTIC speedgoat_target_model_cal_impl.Kinematic_MaxSteeringAngle "" VALUE 0x00235240 Scalar_FLOAT64_IEEE 0 speedgoat_target_model_2021b_CM_double -1.7E+308 1.7E+308 /end CHARACTERISTIC
/begin CHARACTERISTIC speedgoat_target_model_cal_impl.Kinematic_Wheelbase "" VALUE 0x00235248 Scalar_FLOAT64_IEEE 0 speedgoat_target_model_2021b_CM_double -1.7E+308 1.7E+308 /end CHARACTERISTIC
/begin CHARACTERISTIC speedgoat_target_model_cal_impl.LaneAvailable_Value "" VALUE 0x00235508 Scalar_FLOAT64_IEEE 0 speedgoat_target_model_2021b_CM_double -1.7E+308 1.7E+308 /end CHARACTERISTIC
/begin CHARACTERISTIC speedgoat_target_model_cal_impl.LaneChanged_Value "" VALUE 0x00235510 Scalar_FLOAT64_IEEE 0 speedgoat_target_model_2021b_CM_double -1.7E+308 1.7E+308 /end CHARACTERISTIC
/begin CHARACTERISTIC speedgoat_target_model_cal_impl.LateralControllerStanley_DelayG "" VALUE 0x002351A0 Scalar_FLOAT64_IEEE 0 speedgoat_target_model_2021b_CM_double -1.7E+308 1.7E+308 /end CHARACTERISTIC
/begin CHARACTERISTIC speedgoat_target_model_cal_impl.LateralControllerStanley_Posi_i "" VALUE 0x002351F8 Scalar_FLOAT64_IEEE 0 speedgoat_target_model_2021b_CM_double -1.7E+308 1.7E+308 /end CHARACTERISTIC
/begin CHARACTERISTIC speedgoat_target_model_cal_impl.LateralControllerStanley_Positi "" VALUE 0x002351F0 Scalar_FLOAT64_IEEE 0 speedgoat_target_model_2021b_CM_double -1.7E+308 1.7E+308 /end CHARACTERISTIC
/begin CHARACTERISTIC speedgoat_target_model_cal_impl.LateralControllerStanley_YawRat "" VALUE 0x00235210 Scalar_FLOAT64_IEEE 0 speedgoat_target_model_2021b_CM_double -1.7E+308 1.7E+308 /end CHARACTERISTIC
/begin CHARACTERISTIC speedgoat_target_model_cal_impl.LongitudinalControllerStanley_K "" VALUE 0x002351B8 Scalar_FLOAT64_IEEE 0 speedgoat_target_model_2021b_CM_double -1.7E+308 1.7E+308 /end CHARACTERISTIC
/begin CHARACTERISTIC speedgoat_target_model_cal_impl.LongitudinalControllerStanley_n "" VALUE 0x002351C0 Scalar_FLOAT64_IEEE 0 speedgoat_target_model_2021b_CM_double -1.7E+308 1.7E+308 /end CHARACTERISTIC
/begin CHARACTERISTIC speedgoat_target_model_cal_impl.Longitudinalvelocity_Y0 "" VALUE 0x002353E0 Scalar_FLOAT64_IEEE 0 speedgoat_target_model_2021b_CM_double -1.7E+308 1.7E+308 /end CHARACTERISTIC
/begin CHARACTERISTIC speedgoat_target_model_cal_impl.MatrixDimensionCheck_P1 "" VAL_BLK 0x002356C0 Scalar_UWORD 0 speedgoat_target_model_2021b_CM_uint16 0 65535 MATRIX_DIM 64 1 /end CHARACTERISTIC
/begin CHARACTERISTIC speedgoat_target_model_cal_impl.MatrixDimensionCheck_P1_c "" VAL_BLK 0x00235974 Scalar_UWORD 0 speedgoat_target_model_2021b_CM_uint16 0 65535 MATRIX_DIM 64 1 /end CHARACTERISTIC
/begin CHARACTERISTIC speedgoat_target_model_cal_impl.MatrixDimensionCheck_P1_cd "" VAL_BLK 0x00235ABC Scalar_UWORD 0 speedgoat_target_model_2021b_CM_uint16 0 65535 MATRIX_DIM 64 1 /end CHARACTERISTIC
/begin CHARACTERISTIC speedgoat_target_model_cal_impl.MatrixDimensionCheck_P1_d "" VAL_BLK 0x00235B42 Scalar_UWORD 0 speedgoat_target_model_2021b_CM_uint16 0 65535 MATRIX_DIM 64 1 /end CHARACTERISTIC
/begin CHARACTERISTIC speedgoat_target_model_cal_impl.MatrixDimensionCheck_P1_dw "" VAL_BLK 0x00235BCA Scalar_UWORD 0 speedgoat_target_model_2021b_CM_uint16 0 65535 MATRIX_DIM 64 1 /end CHARACTERISTIC
/begin CHARACTERISTIC speedgoat_target_model_cal_impl.MatrixDimensionCheck_P1_i "" VAL_BLK 0x00235A18 Scalar_UWORD 0 speedgoat_target_model_2021b_CM_uint16 0 65535 MATRIX_DIM 64 1 /end CHARACTERISTIC
/begin CHARACTERISTIC speedgoat_target_model_cal_impl.MatrixDimensionCheck_P1_j "" VAL_BLK 0x00235744 Scalar_UWORD 0 speedgoat_target_model_2021b_CM_uint16 0 65535 MATRIX_DIM 64 1 /end CHARACTERISTIC
/begin CHARACTERISTIC speedgoat_target_model_cal_impl.MatrixDimensionCheck_P1_jj "" VAL_BLK 0x00235C52 Scalar_UWORD 0 speedgoat_target_model_2021b_CM_uint16 0 65535 MATRIX_DIM 64 1 /end CHARACTERISTIC
/begin CHARACTERISTIC speedgoat_target_model_cal_impl.MatrixDimensionCheck_P1_jjz "" VAL_BLK 0x00235DEC Scalar_UWORD 0 speedgoat_target_model_2021b_CM_uint16 0 65535 MATRIX_DIM 64 1 /end CHARACTERISTIC
/begin CHARACTERISTIC speedgoat_target_model_cal_impl.MatrixDimensionCheck_P1_l "" VAL_BLK 0x00235D64 Scalar_UWORD 0 speedgoat_target_model_2021b_CM_uint16 0 65535 MATRIX_DIM 64 1 /end CHARACTERISTIC
/begin CHARACTERISTIC speedgoat_target_model_cal_impl.MatrixDimensionCheck_P1_o "" VAL_BLK 0x00235CDC Scalar_UWORD 0 speedgoat_target_model_2021b_CM_uint16 0 65535 MATRIX_DIM 64 1 /end CHARACTERISTIC
/begin CHARACTERISTIC speedgoat_target_model_cal_impl.MatrixDimensionCheck_P1_p "" VAL_BLK 0x002358D0 Scalar_UWORD 0 speedgoat_target_model_2021b_CM_uint16 0 65535 MATRIX_DIM 64 1 /end CHARACTERISTIC
/begin CHARACTERISTIC speedgoat_target_model_cal_impl.MatrixDimensionCheck_P2 "" VAL_BLK 0x00235740 Scalar_UWORD 0 speedgoat_target_model_2021b_CM_uint16 0 65535 MATRIX_DIM 2 1 /end CHARACTERISTIC
/begin CHARACTERISTIC speedgoat_target_model_cal_impl.MatrixDimensionCheck_P2_c "" VAL_BLK 0x00235950 Scalar_UWORD 0 speedgoat_target_model_2021b_CM_uint16 0 65535 MATRIX_DIM 18 1 /end CHARACTERISTIC
/begin CHARACTERISTIC speedgoat_target_model_cal_impl.MatrixDimensionCheck_P2_d "" VAL_BLK 0x00235C4A Scalar_UWORD 0 speedgoat_target_model_2021b_CM_uint16 0 65535 MATRIX_DIM 4 1 /end CHARACTERISTIC
/begin CHARACTERISTIC speedgoat_target_model_cal_impl.MatrixDimensionCheck_P2_d3 "" VAL_BLK 0x00235DE4 Scalar_UWORD 0 speedgoat_target_model_2021b_CM_uint16 0 65535 MATRIX_DIM 4 1 /end CHARACTERISTIC
/begin CHARACTERISTIC speedgoat_target_model_cal_impl.MatrixDimensionCheck_P2_e "" VAL_BLK 0x00235A98 Scalar_UWORD 0 speedgoat_target_model_2021b_CM_uint16 0 65535 MATRIX_DIM 18 1 /end CHARACTERISTIC
/begin CHARACTERISTIC speedgoat_target_model_cal_impl.MatrixDimensionCheck_P2_g "" VAL_BLK 0x00235E6C Scalar_UWORD 0 speedgoat_target_model_2021b_CM_uint16 0 65535 MATRIX_DIM 4 1 /end CHARACTERISTIC
/begin CHARACTERISTIC speedgoat_target_model_cal_impl.MatrixDimensionCheck_P2_i "" VAL_BLK 0x002359F4 Scalar_UWORD 0 speedgoat_target_model_2021b_CM_uint16 0 65535 MATRIX_DIM 18 1 /end CHARACTERISTIC
/begin CHARACTERISTIC speedgoat_target_model_cal_impl.MatrixDimensionCheck_P2_ie "" VAL_BLK 0x00235CD2 Scalar_UWORD 0 speedgoat_target_model_2021b_CM_uint16 0 65535 MATRIX_DIM 5 1 /end CHARACTERISTIC
/begin CHARACTERISTIC speedgoat_target_model_cal_impl.MatrixDimensionCheck_P2_j "" VAL_BLK 0x002357C4 Scalar_UWORD 0 speedgoat_target_model_2021b_CM_uint16 0 65535 MATRIX_DIM 4 1 /end CHARACTERISTIC
/begin CHARACTERISTIC speedgoat_target_model_cal_impl.MatrixDimensionCheck_P2_j0 "" VAL_BLK 0x00235BC2 Scalar_UWORD 0 speedgoat_target_model_2021b_CM_uint16 0 65535 MATRIX_DIM 4 1 /end CHARACTERISTIC
/begin CHARACTERISTIC speedgoat_target_model_cal_impl.MatrixDimensionCheck_P2_k "" VAL_BLK 0x00235B3C Scalar_UWORD 0 speedgoat_target_model_2021b_CM_uint16 0 65535 MATRIX_DIM 3 1 /end CHARACTERISTIC
/begin CHARACTERISTIC speedgoat_target_model_cal_impl.MatrixDimensionCheck_P2_n "" VAL_BLK 0x00235D5C Scalar_UWORD 0 speedgoat_target_model_2021b_CM_uint16 0 65535 MATRIX_DIM 4 1 /end CHARACTERISTIC
/begin CHARACTERISTIC speedgoat_target_model_cal_impl.MatrixDimensionCheck_P3 "" VALUE 0x00236152 Scalar_UWORD 0 speedgoat_target_model_2021b_CM_uint16 0 65535 /end CHARACTERISTIC
/begin CHARACTERISTIC speedgoat_target_model_cal_impl.MatrixDimensionCheck_P3_a "" VALUE 0x00236156 Scalar_UWORD 0 speedgoat_target_model_2021b_CM_uint16 0 65535 /end CHARACTERISTIC
/begin CHARACTERISTIC speedgoat_target_model_cal_impl.MatrixDimensionCheck_P3_d "" VALUE 0x00236160 Scalar_UWORD 0 speedgoat_target_model_2021b_CM_uint16 0 65535 /end CHARACTERISTIC
/begin CHARACTERISTIC speedgoat_target_model_cal_impl.MatrixDimensionCheck_P3_e "" VALUE 0x0023618C Scalar_UWORD 0 speedgoat_target_model_2021b_CM_uint16 0 65535 /end CHARACTERISTIC
/begin CHARACTERISTIC speedgoat_target_model_cal_impl.MatrixDimensionCheck_P3_e2 "" VALUE 0x00236190 Scalar_UWORD 0 speedgoat_target_model_2021b_CM_uint16 0 65535 /end CHARACTERISTIC
/begin CHARACTERISTIC speedgoat_target_model_cal_impl.MatrixDimensionCheck_P3_i "" VALUE 0x0023617C Scalar_UWORD 0 speedgoat_target_model_2021b_CM_uint16 0 65535 /end CHARACTERISTIC
/begin CHARACTERISTIC speedgoat_target_model_cal_impl.MatrixDimensionCheck_P3_k "" VALUE 0x00236180 Scalar_UWORD 0 speedgoat_target_model_2021b_CM_uint16 0 65535 /end CHARACTERISTIC
/begin CHARACTERISTIC speedgoat_target_model_cal_impl.MatrixDimensionCheck_P3_l "" VALUE 0x00236178 Scalar_UWORD 0 speedgoat_target_model_2021b_CM_uint16 0 65535 /end CHARACTERISTIC
/begin CHARACTERISTIC speedgoat_target_model_cal_impl.MatrixDimensionCheck_P3_m "" VALUE 0x00236170 Scalar_UWORD 0 speedgoat_target_model_2021b_CM_uint16 0 65535 /end CHARACTERISTIC
/begin CHARACTERISTIC speedgoat_target_model_cal_impl.MatrixDimensionCheck_P3_n "" VALUE 0x00236168 Scalar_UWORD 0 speedgoat_target_model_2021b_CM_uint16 0 65535 /end CHARACTERISTIC
/begin CHARACTERISTIC speedgoat_target_model_cal_impl.MatrixDimensionCheck_P3_p "" VALUE 0x00236184 Scalar_UWORD 0 speedgoat_target_model_2021b_CM_uint16 0 65535 /end CHARACTERISTIC
/begin CHARACTERISTIC speedgoat_target_model_cal_impl.MatrixDimensionCheck_P3_p0 "" VALUE 0x00236188 Scalar_UWORD 0 speedgoat_target_model_2021b_CM_uint16 0 65535 /end CHARACTERISTIC
/begin CHARACTERISTIC speedgoat_target_model_cal_impl.MatrixDimensionCheck_P4 "" VALUE 0x00236154 Scalar_UWORD 0 speedgoat_target_model_2021b_CM_uint16 0 65535 /end CHARACTERISTIC
/begin CHARACTERISTIC speedgoat_target_model_cal_impl.MatrixDimensionCheck_P4_c "" VALUE 0x00236182 Scalar_UWORD 0 speedgoat_target_model_2021b_CM_uint16 0 65535 /end CHARACTERISTIC
/begin CHARACTERISTIC speedgoat_target_model_cal_impl.MatrixDimensionCheck_P4_e "" VALUE 0x00236162 Scalar_UWORD 0 speedgoat_target_model_2021b_CM_uint16 0 65535 /end CHARACTERISTIC
/begin CHARACTERISTIC speedgoat_target_model_cal_impl.MatrixDimensionCheck_P4_i "" VALUE 0x0023618A Scalar_UWORD 0 speedgoat_target_model_2021b_CM_uint16 0 65535 /end CHARACTERISTIC
/begin CHARACTERISTIC speedgoat_target_model_cal_impl.MatrixDimensionCheck_P4_j "" VALUE 0x0023617E Scalar_UWORD 0 speedgoat_target_model_2021b_CM_uint16 0 65535 /end CHARACTERISTIC
/begin CHARACTERISTIC speedgoat_target_model_cal_impl.MatrixDimensionCheck_P4_j2 "" VALUE 0x00236186 Scalar_UWORD 0 speedgoat_target_model_2021b_CM_uint16 0 65535 /end CHARACTERISTIC
/begin CHARACTERISTIC speedgoat_target_model_cal_impl.MatrixDimensionCheck_P4_jd "" VALUE 0x00236192 Scalar_UWORD 0 speedgoat_target_model_2021b_CM_uint16 0 65535 /end CHARACTERISTIC
/begin CHARACTERISTIC speedgoat_target_model_cal_impl.MatrixDimensionCheck_P4_jh "" VALUE 0x0023618E Scalar_UWORD 0 speedgoat_target_model_2021b_CM_uint16 0 65535 /end CHARACTERISTIC
/begin CHARACTERISTIC speedgoat_target_model_cal_impl.MatrixDimensionCheck_P4_k "" VALUE 0x0023617A Scalar_UWORD 0 speedgoat_target_model_2021b_CM_uint16 0 65535 /end CHARACTERISTIC
/begin CHARACTERISTIC speedgoat_target_model_cal_impl.MatrixDimensionCheck_P4_m "" VALUE 0x00236158 Scalar_UWORD 0 speedgoat_target_model_2021b_CM_uint16 0 65535 /end CHARACTERISTIC
/begin CHARACTERISTIC speedgoat_target_model_cal_impl.MatrixDimensionCheck_P4_ms "" VALUE 0x00236172 Scalar_UWORD 0 speedgoat_target_model_2021b_CM_uint16 0 65535 /end CHARACTERISTIC
/begin CHARACTERISTIC speedgoat_target_model_cal_impl.MatrixDimensionCheck_P4_p "" VALUE 0x0023616A Scalar_UWORD 0 speedgoat_target_model_2021b_CM_uint16 0 65535 /end CHARACTERISTIC
/begin CHARACTERISTIC speedgoat_target_model_cal_impl.MatrixDimensionCheck_P5 "" VALUE 0x00236164 Scalar_UWORD 0 speedgoat_target_model_2021b_CM_uint16 0 65535 /end CHARACTERISTIC
/begin CHARACTERISTIC speedgoat_target_model_cal_impl.MatrixDimensionCheck_P5_h "" VALUE 0x00236174 Scalar_UWORD 0 speedgoat_target_model_2021b_CM_uint16 0 65535 /end CHARACTERISTIC
/begin CHARACTERISTIC speedgoat_target_model_cal_impl.MatrixDimensionCheck_P5_m "" VALUE 0x0023616C Scalar_UWORD 0 speedgoat_target_model_2021b_CM_uint16 0 65535 /end CHARACTERISTIC
/begin CHARACTERISTIC speedgoat_target_model_cal_impl.MatrixDimensionCheck_P6 "" VALUE 0x00236166 Scalar_UWORD 0 speedgoat_target_model_2021b_CM_uint16 0 65535 /end CHARACTERISTIC
/begin CHARACTERISTIC speedgoat_target_model_cal_impl.MatrixDimensionCheck_P6_d "" VALUE 0x0023616E Scalar_UWORD 0 speedgoat_target_model_2021b_CM_uint16 0 65535 /end CHARACTERISTIC
/begin CHARACTERISTIC speedgoat_target_model_cal_impl.MatrixDimensionCheck_P6_l "" VALUE 0x00236176 Scalar_UWORD 0 speedgoat_target_model_2021b_CM_uint16 0 65535 /end CHARACTERISTIC
/begin CHARACTERISTIC speedgoat_target_model_cal_impl.Memory_InitialCondition "" VAL_BLK 0x002361C1 Scalar_BOOLEAN 0 speedgoat_target_model_2021b_CM_logical 0 1 MATRIX_DIM 1 34 /end CHARACTERISTIC
/begin CHARACTERISTIC speedgoat_target_model_cal_impl.Merge1_InitialOutput "" VALUE 0x00235530 Scalar_FLOAT64_IEEE 0 speedgoat_target_model_2021b_CM_double -1.7E+308 1.7E+308 /end CHARACTERISTIC
/begin CHARACTERISTIC speedgoat_target_model_cal_impl.Merge2_InitialOutput "" VALUE 0x00235538 Scalar_FLOAT64_IEEE 0 speedgoat_target_model_2021b_CM_double -1.7E+308 1.7E+308 /end CHARACTERISTIC
/begin CHARACTERISTIC speedgoat_target_model_cal_impl.Merge_InitialOutput "" VALUE 0x002356A0 Scalar_FLOAT64_IEEE 0 speedgoat_target_model_2021b_CM_double -1.7E+308 1.7E+308 /end CHARACTERISTIC
/begin CHARACTERISTIC speedgoat_target_model_cal_impl.MinSpeed_Value "" VALUE 0x00235500 Scalar_FLOAT64_IEEE 0 speedgoat_target_model_2021b_CM_double -1.7E+308 1.7E+308 /end CHARACTERISTIC
/begin CHARACTERISTIC speedgoat_target_model_cal_impl.Minimumvelocityconstant_Value "" VALUE 0x00235560 Scalar_FLOAT64_IEEE 0 speedgoat_target_model_2021b_CM_double -1.7E+308 1.7E+308 /end CHARACTERISTIC
/begin CHARACTERISTIC speedgoat_target_model_cal_impl.NavigatingFlag_Value "" VALUE 0x002354E0 Scalar_FLOAT64_IEEE 0 speedgoat_target_model_2021b_CM_double -1.7E+308 1.7E+308 /end CHARACTERISTIC
/begin CHARACTERISTIC speedgoat_target_model_cal_impl.NumMsg_Y0 "" VALUE 0x00235438 Scalar_FLOAT64_IEEE 0 speedgoat_target_model_2021b_CM_double -1.7E+308 1.7E+308 /end CHARACTERISTIC
/begin CHARACTERISTIC speedgoat_target_model_cal_impl.NumMsg_Y0_b "" VALUE 0x00235448 Scalar_FLOAT64_IEEE 0 speedgoat_target_model_2021b_CM_double -1.7E+308 1.7E+308 /end CHARACTERISTIC
/begin CHARACTERISTIC speedgoat_target_model_cal_impl.NumMsg_Y0_bf "" VALUE 0x00235458 Scalar_FLOAT64_IEEE 0 speedgoat_target_model_2021b_CM_double -1.7E+308 1.7E+308 /end CHARACTERISTIC
/begin CHARACTERISTIC speedgoat_target_model_cal_impl.NumMsg_Y0_c "" VALUE 0x00235478 Scalar_FLOAT64_IEEE 0 speedgoat_target_model_2021b_CM_double -1.7E+308 1.7E+308 /end CHARACTERISTIC
/begin CHARACTERISTIC speedgoat_target_model_cal_impl.NumMsg_Y0_f "" VALUE 0x00235468 Scalar_FLOAT64_IEEE 0 speedgoat_target_model_2021b_CM_double -1.7E+308 1.7E+308 /end CHARACTERISTIC
/begin CHARACTERISTIC speedgoat_target_model_cal_impl.ObjAhead_Y0 "" VALUE 0x002353D8 Scalar_FLOAT64_IEEE 0 speedgoat_target_model_2021b_CM_double -1.7E+308 1.7E+308 /end CHARACTERISTIC
/begin CHARACTERISTIC speedgoat_target_model_cal_impl.ObjectDist_Y0 "" VALUE 0x00235400 Scalar_FLOAT64_IEEE 0 speedgoat_target_model_2021b_CM_double -1.7E+308 1.7E+308 /end CHARACTERISTIC
/begin CHARACTERISTIC speedgoat_target_model_cal_impl.PIForward_InitialConditionForIn "" VALUE 0x002351A8 Scalar_FLOAT64_IEEE 0 speedgoat_target_model_2021b_CM_double -1.7E+308 1.7E+308 /end CHARACTERISTIC
/begin CHARACTERISTIC speedgoat_target_model_cal_impl.PIForward_LowerSaturationLimit "" VALUE 0x002351C8 Scalar_FLOAT64_IEEE 0 speedgoat_target_model_2021b_CM_double -1.7E+308 1.7E+308 /end CHARACTERISTIC
/begin CHARACTERISTIC speedgoat_target_model_cal_impl.PIForward_UpperSaturationLimit "" VALUE 0x00235200 Scalar_FLOAT64_IEEE 0 speedgoat_target_model_2021b_CM_double -1.7E+308 1.7E+308 /end CHARACTERISTIC
/begin CHARACTERISTIC speedgoat_target_model_cal_impl.PIReverse_InitialConditionForIn "" VALUE 0x002351B0 Scalar_FLOAT64_IEEE 0 speedgoat_target_model_2021b_CM_double -1.7E+308 1.7E+308 /end CHARACTERISTIC
/begin CHARACTERISTIC speedgoat_target_model_cal_impl.PIReverse_LowerSaturationLimit "" VALUE 0x002351D0 Scalar_FLOAT64_IEEE 0 speedgoat_target_model_2021b_CM_double -1.7E+308 1.7E+308 /end CHARACTERISTIC
/begin CHARACTERISTIC speedgoat_target_model_cal_impl.PIReverse_UpperSaturationLimit "" VALUE 0x00235208 Scalar_FLOAT64_IEEE 0 speedgoat_target_model_2021b_CM_double -1.7E+308 1.7E+308 /end CHARACTERISTIC
/begin CHARACTERISTIC speedgoat_target_model_cal_impl.RRCrossing_Value "" VALUE 0x002354D8 Scalar_FLOAT64_IEEE 0 speedgoat_target_model_2021b_CM_double -1.7E+308 1.7E+308 /end CHARACTERISTIC
/begin CHARACTERISTIC speedgoat_target_model_cal_impl.RefPoses_Y0 "" VALUE 0x002353F8 Scalar_FLOAT64_IEEE 0 speedgoat_target_model_2021b_CM_double -1.7E+308 1.7E+308 /end CHARACTERISTIC
/begin CHARACTERISTIC speedgoat_target_model_cal_impl.Relativedistance_Y0 "" VALUE 0x00235410 Scalar_FLOAT64_IEEE 0 speedgoat_target_model_2021b_CM_double -1.7E+308 1.7E+308 /end CHARACTERISTIC
/begin CHARACTERISTIC speedgoat_target_model_cal_impl.Relativevelocity_Y0 "" VALUE 0x002353F0 Scalar_FLOAT64_IEEE 0 speedgoat_target_model_2021b_CM_double -1.7E+308 1.7E+308 /end CHARACTERISTIC
/begin CHARACTERISTIC speedgoat_target_model_cal_impl.RoadSpeed_Value "" VALUE 0x002354F0 Scalar_FLOAT64_IEEE 0 speedgoat_target_model_2021b_CM_double -1.7E+308 1.7E+308 /end CHARACTERISTIC
/begin CHARACTERISTIC speedgoat_target_model_cal_impl.S_zero_Value "" VALUE 0x00235618 Scalar_FLOAT64_IEEE 0 speedgoat_target_model_2021b_CM_double -1.7E+308 1.7E+308 /end CHARACTERISTIC
/begin CHARACTERISTIC speedgoat_target_model_cal_impl.Saturation_LowerSat "" VALUE 0x002354B8 Scalar_FLOAT64_IEEE 0 speedgoat_target_model_2021b_CM_double -1.7E+308 1.7E+308 /end CHARACTERISTIC
/begin CHARACTERISTIC speedgoat_target_model_cal_impl.Saturation_UpperSat "" VALUE 0x002354B0 Scalar_FLOAT64_IEEE 0 speedgoat_target_model_2021b_CM_double -1.7E+308 1.7E+308 /end CHARACTERISTIC
/begin CHARACTERISTIC speedgoat_target_model_cal_impl.SceneID_Y0 "" VALUE 0x002353E8 Scalar_FLOAT64_IEEE 0 speedgoat_target_model_2021b_CM_double -1.7E+308 1.7E+308 /end CHARACTERISTIC
/begin CHARACTERISTIC speedgoat_target_model_cal_impl.SceneSpeed_Value "" VALUE 0x002354C8 Scalar_FLOAT64_IEEE 0 speedgoat_target_model_2021b_CM_double -1.7E+308 1.7E+308 /end CHARACTERISTIC
/begin CHARACTERISTIC speedgoat_target_model_cal_impl.Switch1_Threshold "" VALUE 0x00235320 Scalar_FLOAT64_IEEE 0 speedgoat_target_model_2021b_CM_double -1.7E+308 1.7E+308 /end CHARACTERISTIC
/begin CHARACTERISTIC speedgoat_target_model_cal_impl.Switch1_Threshold_g "" VALUE 0x002356B8 Scalar_FLOAT64_IEEE 0 speedgoat_target_model_2021b_CM_double -1.7E+308 1.7E+308 /end CHARACTERISTIC
/begin CHARACTERISTIC speedgoat_target_model_cal_impl.Switch1_Threshold_m "" VALUE 0x002353C8 Scalar_FLOAT64_IEEE 0 speedgoat_target_model_2021b_CM_double -1.7E+308 1.7E+308 /end CHARACTERISTIC
/begin CHARACTERISTIC speedgoat_target_model_cal_impl.Switch_Threshold "" VALUE 0x00235318 Scalar_FLOAT64_IEEE 0 speedgoat_target_model_2021b_CM_double -1.7E+308 1.7E+308 /end CHARACTERISTIC
/begin CHARACTERISTIC speedgoat_target_model_cal_impl.Switch_Threshold_f "" VALUE 0x002353C0 Scalar_FLOAT64_IEEE 0 speedgoat_target_model_2021b_CM_double -1.7E+308 1.7E+308 /end CHARACTERISTIC
/begin CHARACTERISTIC speedgoat_target_model_cal_impl.Switch_Threshold_k "" VALUE 0x002356B0 Scalar_FLOAT64_IEEE 0 speedgoat_target_model_2021b_CM_double -1.7E+308 1.7E+308 /end CHARACTERISTIC
/begin CHARACTERISTIC speedgoat_target_model_cal_impl.TLstate_Y0 "" VALUE 0x00235418 Scalar_FLOAT64_IEEE 0 speedgoat_target_model_2021b_CM_double -1.7E+308 1.7E+308 /end CHARACTERISTIC
/begin CHARACTERISTIC speedgoat_target_model_cal_impl.ThrottleSaturation_LowerSat "" VALUE 0x00235310 Scalar_FLOAT64_IEEE 0 speedgoat_target_model_2021b_CM_double -1.7E+308 1.7E+308 /end CHARACTERISTIC
/begin CHARACTERISTIC speedgoat_target_model_cal_impl.ThrottleSaturation_LowerSat_g "" VALUE 0x002353B8 Scalar_FLOAT64_IEEE 0 speedgoat_target_model_2021b_CM_double -1.7E+308 1.7E+308 /end CHARACTERISTIC
/begin CHARACTERISTIC speedgoat_target_model_cal_impl.ThrottleSaturation_UpperSat "" VALUE 0x00235308 Scalar_FLOAT64_IEEE 0 speedgoat_target_model_2021b_CM_double -1.7E+308 1.7E+308 /end CHARACTERISTIC
/begin CHARACTERISTIC speedgoat_target_model_cal_impl.ThrottleSaturation_UpperSat_e "" VALUE 0x002353B0 Scalar_FLOAT64_IEEE 0 speedgoat_target_model_2021b_CM_double -1.7E+308 1.7E+308 /end CHARACTERISTIC
/begin CHARACTERISTIC speedgoat_target_model_cal_impl.TmpRTBAtDataTypeConversion_vset "" VALUE 0x00235570 Scalar_FLOAT64_IEEE 0 speedgoat_target_model_2021b_CM_double -1.7E+308 1.7E+308 /end CHARACTERISTIC
/begin CHARACTERISTIC speedgoat_target_model_cal_impl.TmpRTBAtEqual1Inport1_InitialCo "" VALUE 0x00235588 Scalar_FLOAT64_IEEE 0 speedgoat_target_model_2021b_CM_double -1.7E+308 1.7E+308 /end CHARACTERISTIC
/begin CHARACTERISTIC speedgoat_target_model_cal_impl.TmpRTBAtEqual2Inport1_InitialCo "" VALUE 0x00235590 Scalar_FLOAT64_IEEE 0 speedgoat_target_model_2021b_CM_double -1.7E+308 1.7E+308 /end CHARACTERISTIC
/begin CHARACTERISTIC speedgoat_target_model_cal_impl.TmpRTBAtEqual3Inport1_InitialCo "" VALUE 0x00235598 Scalar_FLOAT64_IEEE 0 speedgoat_target_model_2021b_CM_double -1.7E+308 1.7E+308 /end CHARACTERISTIC
/begin CHARACTERISTIC speedgoat_target_model_cal_impl.TmpRTBAtEqual4Inport2_InitialCo "" VALUE 0x002355A0 Scalar_FLOAT64_IEEE 0 speedgoat_target_model_2021b_CM_double -1.7E+308 1.7E+308 /end CHARACTERISTIC
/begin CHARACTERISTIC speedgoat_target_model_cal_impl.TmpRTBAtEqual5Inport2_InitialCo "" VALUE 0x002355A8 Scalar_FLOAT64_IEEE 0 speedgoat_target_model_2021b_CM_double -1.7E+308 1.7E+308 /end CHARACTERISTIC
/begin CHARACTERISTIC speedgoat_target_model_cal_impl.TmpRTBAtMinusInport2_InitialCon "" VALUE 0x002355D8 Scalar_FLOAT64_IEEE 0 speedgoat_target_model_2021b_CM_double -1.7E+308 1.7E+308 /end CHARACTERISTIC
/begin CHARACTERISTIC speedgoat_target_model_cal_impl.TmpRTBAtMultiplyInport1_Initial "" VALUE 0x002355C8 Scalar_FLOAT64_IEEE 0 speedgoat_target_model_2021b_CM_double -1.7E+308 1.7E+308 /end CHARACTERISTIC
/begin CHARACTERISTIC speedgoat_target_model_cal_impl.TmpRTBAtSign1Inport1_InitialCon "" VALUE 0x002355B0 Scalar_FLOAT64_IEEE 0 speedgoat_target_model_2021b_CM_double -1.7E+308 1.7E+308 /end CHARACTERISTIC
/begin CHARACTERISTIC speedgoat_target_model_cal_impl.TmpRTBAtSwitch1Outport1_Initial "" VALUE 0x00235528 Scalar_FLOAT64_IEEE 0 speedgoat_target_model_2021b_CM_double -1.7E+308 1.7E+308 /end CHARACTERISTIC
/begin CHARACTERISTIC speedgoat_target_model_cal_impl.TmpRTBAtSwitchCaseInport1_Initi "" VALUE 0x002355D0 Scalar_FLOAT64_IEEE 0 speedgoat_target_model_2021b_CM_double -1.7E+308 1.7E+308 /end CHARACTERISTIC
/begin CHARACTERISTIC speedgoat_target_model_cal_impl.TmpRTBAtSwitchOutport1_InitialC "" VALUE 0x00235520 Scalar_FLOAT64_IEEE 0 speedgoat_target_model_2021b_CM_double -1.7E+308 1.7E+308 /end CHARACTERISTIC
/begin CHARACTERISTIC speedgoat_target_model_cal_impl.TmpRTBAtoptimizerInport3_Initia "" VALUE 0x00235550 Scalar_FLOAT64_IEEE 0 speedgoat_target_model_2021b_CM_double -1.7E+308 1.7E+308 /end CHARACTERISTIC
/begin CHARACTERISTIC speedgoat_target_model_cal_impl.TmpRTBAtoptimizerInport5_Initia "" VALUE 0x00235558 Scalar_FLOAT64_IEEE 0 speedgoat_target_model_2021b_CM_double -1.7E+308 1.7E+308 /end CHARACTERISTIC
/begin CHARACTERISTIC speedgoat_target_model_cal_impl.UDPReceive2_fmAddress "" VAL_BLK 0x002361A0 Scalar_UBYTE 0 speedgoat_target_model_2021b_CM_uint8 0 255 MATRIX_DIM 4 1 /end CHARACTERISTIC
/begin CHARACTERISTIC speedgoat_target_model_cal_impl.UDPReceive2_fmAddress_c "" VAL_BLK 0x002361A8 Scalar_UBYTE 0 speedgoat_target_model_2021b_CM_uint8 0 255 MATRIX_DIM 4 1 /end CHARACTERISTIC
/begin CHARACTERISTIC speedgoat_target_model_cal_impl.UDPReceive2_fmAddress_e "" VAL_BLK 0x002361A4 Scalar_UBYTE 0 speedgoat_target_model_2021b_CM_uint8 0 255 MATRIX_DIM 4 1 /end CHARACTERISTIC
/begin CHARACTERISTIC speedgoat_target_model_cal_impl.UDPReceive2_fmAddress_h "" VAL_BLK 0x002361AC Scalar_UBYTE 0 speedgoat_target_model_2021b_CM_uint8 0 255 MATRIX_DIM 4 1 /end CHARACTERISTIC
/begin CHARACTERISTIC speedgoat_target_model_cal_impl.UDPReceive2_fmAddress_i "" VAL_BLK 0x002361B0 Scalar_UBYTE 0 speedgoat_target_model_2021b_CM_uint8 0 255 MATRIX_DIM 4 1 /end CHARACTERISTIC
/begin CHARACTERISTIC speedgoat_target_model_cal_impl.UDPSendControllerIntermediateSi "" VALUE 0x00236150 Scalar_UWORD 0 speedgoat_target_model_2021b_CM_uint16 0 65535 /end CHARACTERISTIC
/begin CHARACTERISTIC speedgoat_target_model_cal_impl.UDPSendControllerIntermediate_k "" VAL_BLK 0x002361B8 Scalar_UBYTE 0 speedgoat_target_model_2021b_CM_uint8 0 255 MATRIX_DIM 4 1 /end CHARACTERISTIC
/begin CHARACTERISTIC speedgoat_target_model_cal_impl.UDPSendControllerOutput_toAddre "" VAL_BLK 0x002361B4 Scalar_UBYTE 0 speedgoat_target_model_2021b_CM_uint8 0 255 MATRIX_DIM 4 1 /end CHARACTERISTIC
/begin CHARACTERISTIC speedgoat_target_model_cal_impl.UDPSendControllerOutput_toPort "" VALUE 0x0023614E Scalar_UWORD 0 speedgoat_target_model_2021b_CM_uint16 0 65535 /end CHARACTERISTIC
/begin CHARACTERISTIC speedgoat_target_model_cal_impl.Unconstrained_Value "" VALUE 0x00235650 Scalar_FLOAT64_IEEE 0 speedgoat_target_model_2021b_CM_double -1.7E+308 1.7E+308 /end CHARACTERISTIC
/begin CHARACTERISTIC speedgoat_target_model_cal_impl.UnitDelay_InitialCondition "" VALUE 0x002354A0 Scalar_FLOAT64_IEEE 0 speedgoat_target_model_2021b_CM_double -1.7E+308 1.7E+308 /end CHARACTERISTIC
/begin CHARACTERISTIC speedgoat_target_model_cal_impl.UnitDelay_InitialCondition_j "" VALUE 0x002354A8 Scalar_FLOAT64_IEEE 0 speedgoat_target_model_2021b_CM_double -1.7E+308 1.7E+308 /end CHARACTERISTIC
/begin CHARACTERISTIC speedgoat_target_model_cal_impl.VectorDimensionCheck_P1 "" VAL_BLK 0x002357CC Scalar_UWORD 0 speedgoat_target_model_2021b_CM_uint16 0 65535 MATRIX_DIM 64 1 /end CHARACTERISTIC
/begin CHARACTERISTIC speedgoat_target_model_cal_impl.VectorDimensionCheck_P1_b "" VAL_BLK 0x0023584C Scalar_UWORD 0 speedgoat_target_model_2021b_CM_uint16 0 65535 MATRIX_DIM 64 1 /end CHARACTERISTIC
/begin CHARACTERISTIC speedgoat_target_model_cal_impl.VectorDimensionCheck_P1_f "" VAL_BLK 0x00235E74 Scalar_UWORD 0 speedgoat_target_model_2021b_CM_uint16 0 65535 MATRIX_DIM 64 1 /end CHARACTERISTIC
/begin CHARACTERISTIC speedgoat_target_model_cal_impl.VectorDimensionCheck_P1_fq "" VAL_BLK 0x00235F00 Scalar_UWORD 0 speedgoat_target_model_2021b_CM_uint16 0 65535 MATRIX_DIM 64 1 /end CHARACTERISTIC
/begin CHARACTERISTIC speedgoat_target_model_cal_impl.VectorDimensionCheck_P1_h "" VAL_BLK 0x00235F8C Scalar_UWORD 0 speedgoat_target_model_2021b_CM_uint16 0 65535 MATRIX_DIM 64 1 /end CHARACTERISTIC
/begin CHARACTERISTIC speedgoat_target_model_cal_impl.VectorDimensionCheck_P1_o "" VAL_BLK 0x00236018 Scalar_UWORD 0 speedgoat_target_model_2021b_CM_uint16 0 65535 MATRIX_DIM 64 1 /end CHARACTERISTIC
/begin CHARACTERISTIC speedgoat_target_model_cal_impl.VectorDimensionCheck_P1_oo "" VAL_BLK 0x002360BC Scalar_UWORD 0 speedgoat_target_model_2021b_CM_uint16 0 65535 MATRIX_DIM 64 1 /end CHARACTERISTIC
/begin CHARACTERISTIC speedgoat_target_model_cal_impl.VectorDimensionCheck_P2 "" VALUE 0x0023615A Scalar_UWORD 0 speedgoat_target_model_2021b_CM_uint16 0 65535 /end CHARACTERISTIC
/begin CHARACTERISTIC speedgoat_target_model_cal_impl.VectorDimensionCheck_P2_b "" VAL_BLK 0x00235EF4 Scalar_UWORD 0 speedgoat_target_model_2021b_CM_uint16 0 65535 MATRIX_DIM 6 1 /end CHARACTERISTIC
/begin CHARACTERISTIC speedgoat_target_model_cal_impl.VectorDimensionCheck_P2_f "" VAL_BLK 0x0023613C Scalar_UWORD 0 speedgoat_target_model_2021b_CM_uint16 0 65535 MATRIX_DIM 9 1 /end CHARACTERISTIC
/begin CHARACTERISTIC speedgoat_target_model_cal_impl.VectorDimensionCheck_P2_h "" VAL_BLK 0x0023600C Scalar_UWORD 0 speedgoat_target_model_2021b_CM_uint16 0 65535 MATRIX_DIM 6 1 /end CHARACTERISTIC
/begin CHARACTERISTIC speedgoat_target_model_cal_impl.VectorDimensionCheck_P2_l "" VAL_BLK 0x002358CC Scalar_UWORD 0 speedgoat_target_model_2021b_CM_uint16 0 65535 MATRIX_DIM 2 1 /end CHARACTERISTIC
/begin CHARACTERISTIC speedgoat_target_model_cal_impl.VectorDimensionCheck_P2_n "" VAL_BLK 0x00235F80 Scalar_UWORD 0 speedgoat_target_model_2021b_CM_uint16 0 65535 MATRIX_DIM 6 1 /end CHARACTERISTIC
/begin CHARACTERISTIC speedgoat_target_model_cal_impl.VectorDimensionCheck_P2_p "" VAL_BLK 0x00236098 Scalar_UWORD 0 speedgoat_target_model_2021b_CM_uint16 0 65535 MATRIX_DIM 18 1 /end CHARACTERISTIC
/begin CHARACTERISTIC speedgoat_target_model_cal_impl.VectorDimensionCheck_P3 "" VALUE 0x0023615C Scalar_UWORD 0 speedgoat_target_model_2021b_CM_uint16 0 65535 /end CHARACTERISTIC
/begin CHARACTERISTIC speedgoat_target_model_cal_impl.VectorDimensionCheck_P3_d "" VALUE 0x00236198 Scalar_UWORD 0 speedgoat_target_model_2021b_CM_uint16 0 65535 /end CHARACTERISTIC
/begin CHARACTERISTIC speedgoat_target_model_cal_impl.VectorDimensionCheck_P3_dg "" VALUE 0x0023619C Scalar_UWORD 0 speedgoat_target_model_2021b_CM_uint16 0 65535 /end CHARACTERISTIC
/begin CHARACTERISTIC speedgoat_target_model_cal_impl.VectorDimensionCheck_P3_i "" VALUE 0x00236194 Scalar_UWORD 0 speedgoat_target_model_2021b_CM_uint16 0 65535 /end CHARACTERISTIC
/begin CHARACTERISTIC speedgoat_target_model_cal_impl.VectorDimensionCheck_P4 "" VALUE 0x0023615E Scalar_UWORD 0 speedgoat_target_model_2021b_CM_uint16 0 65535 /end CHARACTERISTIC
/begin CHARACTERISTIC speedgoat_target_model_cal_impl.VectorDimensionCheck_P4_b "" VALUE 0x0023619E Scalar_UWORD 0 speedgoat_target_model_2021b_CM_uint16 0 65535 /end CHARACTERISTIC
/begin CHARACTERISTIC speedgoat_target_model_cal_impl.VectorDimensionCheck_P4_c "" VALUE 0x00236196 Scalar_UWORD 0 speedgoat_target_model_2021b_CM_uint16 0 65535 /end CHARACTERISTIC
/begin CHARACTERISTIC speedgoat_target_model_cal_impl.VectorDimensionCheck_P4_f "" VALUE 0x0023619A Scalar_UWORD 0 speedgoat_target_model_2021b_CM_uint16 0 65535 /end CHARACTERISTIC
/begin CHARACTERISTIC speedgoat_target_model_cal_impl.WaitTime_Value "" VALUE 0x002354F8 Scalar_FLOAT64_IEEE 0 speedgoat_target_model_2021b_CM_double -1.7E+308 1.7E+308 /end CHARACTERISTIC
/begin CHARACTERISTIC speedgoat_target_model_cal_impl.ZeroGain_Gain "" VALUE 0x00235260 Scalar_FLOAT64_IEEE 0 speedgoat_target_model_2021b_CM_double -1.7E+308 1.7E+308 /end CHARACTERISTIC
/begin CHARACTERISTIC speedgoat_target_model_cal_impl.ZeroGain_Gain_k "" VALUE 0x00235278 Scalar_FLOAT64_IEEE 0 speedgoat_target_model_2021b_CM_double -1.7E+308 1.7E+308 /end CHARACTERISTIC
/begin CHARACTERISTIC speedgoat_target_model_cal_impl.acceleration_InitialCondition "" VALUE 0x00235518 Scalar_FLOAT64_IEEE 0 speedgoat_target_model_2021b_CM_double -1.7E+308 1.7E+308 /end CHARACTERISTIC
/begin CHARACTERISTIC speedgoat_target_model_cal_impl.constant_Value "" VALUE 0x00235668 Scalar_FLOAT64_IEEE 0 speedgoat_target_model_2021b_CM_double -1.7E+308 1.7E+308 /end CHARACTERISTIC
/begin CHARACTERISTIC speedgoat_target_model_cal_impl.default_spacing_InitialConditio "" VALUE 0x00235578 Scalar_FLOAT64_IEEE 0 speedgoat_target_model_2021b_CM_double -1.7E+308 1.7E+308 /end CHARACTERISTIC
/begin CHARACTERISTIC speedgoat_target_model_cal_impl.duwt_zero_Value "" VALUE 0x00235608 Scalar_FLOAT64_IEEE 0 speedgoat_target_model_2021b_CM_double -1.7E+308 1.7E+308 /end CHARACTERISTIC
/begin CHARACTERISTIC speedgoat_target_model_cal_impl.ecrwt_zero_Value "" VALUE 0x00235658 Scalar_FLOAT64_IEEE 0 speedgoat_target_model_2021b_CM_double -1.7E+308 1.7E+308 /end CHARACTERISTIC
/begin CHARACTERISTIC speedgoat_target_model_cal_impl.extmv_scale1_Gain "" VALUE 0x00235640 Scalar_FLOAT64_IEEE 0 speedgoat_target_model_2021b_CM_double -1.7E+308 1.7E+308 /end CHARACTERISTIC
/begin CHARACTERISTIC speedgoat_target_model_cal_impl.extmv_scale_Gain "" VALUE 0x00235630 Scalar_FLOAT64_IEEE 0 speedgoat_target_model_2021b_CM_double -1.7E+308 1.7E+308 /end CHARACTERISTIC
/begin CHARACTERISTIC speedgoat_target_model_cal_impl.extmv_zero_Value "" VALUE 0x00235628 Scalar_FLOAT64_IEEE 0 speedgoat_target_model_2021b_CM_double -1.7E+308 1.7E+308 /end CHARACTERISTIC
/begin CHARACTERISTIC speedgoat_target_model_cal_impl.last_mv_InitialCondition "" VALUE 0x00235648 Scalar_FLOAT64_IEEE 0 speedgoat_target_model_2021b_CM_double -1.7E+308 1.7E+308 /end CHARACTERISTIC
/begin CHARACTERISTIC speedgoat_target_model_cal_impl.last_x_InitialCondition "" VAL_BLK 0x00235070 Scalar_FLOAT64_IEEE 0 speedgoat_target_model_2021b_CM_double -1.7E+308 1.7E+308 MATRIX_DIM 1 4 /end CHARACTERISTIC
/begin CHARACTERISTIC speedgoat_target_model_cal_impl.m_zero_Value "" VALUE 0x00235548 Scalar_FLOAT64_IEEE 0 speedgoat_target_model_2021b_CM_double -1.7E+308 1.7E+308 /end CHARACTERISTIC
/begin CHARACTERISTIC speedgoat_target_model_cal_impl.min_velocity_InitialCondition "" VALUE 0x00235568 Scalar_FLOAT64_IEEE 0 speedgoat_target_model_2021b_CM_double -1.7E+308 1.7E+308 /end CHARACTERISTIC
/begin CHARACTERISTIC speedgoat_target_model_cal_impl.mvtarget_zero_Value "" VALUE 0x00235638 Scalar_FLOAT64_IEEE 0 speedgoat_target_model_2021b_CM_double -1.7E+308 1.7E+308 /end CHARACTERISTIC
/begin CHARACTERISTIC speedgoat_target_model_cal_impl.p_zero_Value "" VALUE 0x00235540 Scalar_FLOAT64_IEEE 0 speedgoat_target_model_2021b_CM_double -1.7E+308 1.7E+308 /end CHARACTERISTIC
/begin CHARACTERISTIC speedgoat_target_model_cal_impl.reset_Value "" VALUE 0x00235698 Scalar_FLOAT64_IEEE 0 speedgoat_target_model_2021b_CM_double -1.7E+308 1.7E+308 /end CHARACTERISTIC
/begin CHARACTERISTIC speedgoat_target_model_cal_impl.set_velocity1_InitialCondition "" VALUE 0x002355C0 Scalar_FLOAT64_IEEE 0 speedgoat_target_model_2021b_CM_double -1.7E+308 1.7E+308 /end CHARACTERISTIC
/begin CHARACTERISTIC speedgoat_target_model_cal_impl.set_velocity_InitialCondition "" VALUE 0x002355B8 Scalar_FLOAT64_IEEE 0 speedgoat_target_model_2021b_CM_double -1.7E+308 1.7E+308 /end CHARACTERISTIC
/begin CHARACTERISTIC speedgoat_target_model_cal_impl.set_velocity_InitialCondition_h "" VALUE 0x002355E0 Scalar_FLOAT64_IEEE 0 speedgoat_target_model_2021b_CM_double -1.7E+308 1.7E+308 /end CHARACTERISTIC
/begin CHARACTERISTIC speedgoat_target_model_cal_impl.umin_scale1_Gain "" VALUE 0x00235660 Scalar_FLOAT64_IEEE 0 speedgoat_target_model_2021b_CM_double -1.7E+308 1.7E+308 /end CHARACTERISTIC
/begin CHARACTERISTIC speedgoat_target_model_cal_impl.umin_scale2_Gain "" VALUE 0x00235670 Scalar_FLOAT64_IEEE 0 speedgoat_target_model_2021b_CM_double -1.7E+308 1.7E+308 /end CHARACTERISTIC
/begin CHARACTERISTIC speedgoat_target_model_cal_impl.umin_scale3_Gain "" VAL_BLK 0x00235090 Scalar_FLOAT64_IEEE 0 speedgoat_target_model_2021b_CM_double -1.7E+308 1.7E+308 MATRIX_DIM 1 11 /end CHARACTERISTIC
/begin CHARACTERISTIC speedgoat_target_model_cal_impl.umin_scale4_Gain "" VALUE 0x00235610 Scalar_FLOAT64_IEEE 0 speedgoat_target_model_2021b_CM_double -1.7E+308 1.7E+308 /end CHARACTERISTIC
/begin CHARACTERISTIC speedgoat_target_model_cal_impl.umin_scale5_Gain "" VAL_BLK 0x002350E8 Scalar_FLOAT64_IEEE 0 speedgoat_target_model_2021b_CM_double -1.7E+308 1.7E+308 MATRIX_DIM 2 11 /end CHARACTERISTIC
/begin CHARACTERISTIC speedgoat_target_model_cal_impl.uwt_zero_Value "" VALUE 0x00235600 Scalar_FLOAT64_IEEE 0 speedgoat_target_model_2021b_CM_double -1.7E+308 1.7E+308 /end CHARACTERISTIC
/begin CHARACTERISTIC speedgoat_target_model_cal_impl.yawrate_Y0 "" VALUE 0x00235430 Scalar_FLOAT64_IEEE 0 speedgoat_target_model_2021b_CM_double -1.7E+308 1.7E+308 /end CHARACTERISTIC
/begin CHARACTERISTIC speedgoat_target_model_cal_impl.ym_zero_Value "" VAL_BLK 0x00235030 Scalar_FLOAT64_IEEE 0 speedgoat_target_model_2021b_CM_double -1.7E+308 1.7E+308 MATRIX_DIM 1 2 /end CHARACTERISTIC
/begin CHARACTERISTIC speedgoat_target_model_cal_impl.ymin_scale1_Gain "" VAL_BLK 0x00235060 Scalar_FLOAT64_IEEE 0 speedgoat_target_model_2021b_CM_double -1.7E+308 1.7E+308 MATRIX_DIM 2 1 /end CHARACTERISTIC
/begin CHARACTERISTIC speedgoat_target_model_cal_impl.ymin_scale2_Gain "" VALUE 0x00235620 Scalar_FLOAT64_IEEE 0 speedgoat_target_model_2021b_CM_double -1.7E+308 1.7E+308 /end CHARACTERISTIC
/begin CHARACTERISTIC speedgoat_target_model_cal_impl.ywt_zero_Value "" VAL_BLK 0x00235050 Scalar_FLOAT64_IEEE 0 speedgoat_target_model_2021b_CM_double -1.7E+308 1.7E+308 MATRIX_DIM 1 2 /end CHARACTERISTIC
/begin MEASUREMENT speedgoat_target_model_2021b_B.ACC "" FLOAT64_IEEE speedgoat_target_model_2021b_CM_double 0 0 -1.7E+308 1.7E+308 ECU_ADDRESS 0x00237020 /end MEASUREMENT
/begin MEASUREMENT speedgoat_target_model_2021b_B.ACC_i "" FLOAT64_IEEE speedgoat_target_model_2021b_CM_double 0 0 -1.7E+308 1.7E+308 ECU_ADDRESS 0x00237038 /end MEASUREMENT
/begin MEASUREMENT speedgoat_target_model_2021b_B.AND1 "" UBYTE speedgoat_target_model_2021b_CM_logical 0 0 0 1 ECU_ADDRESS 0x002376FE /end MEASUREMENT
/begin MEASUREMENT speedgoat_target_model_2021b_B.AND2 "" UBYTE speedgoat_target_model_2021b_CM_logical 0 0 0 1 ECU_ADDRESS 0x00237703 /end MEASUREMENT
/begin MEASUREMENT speedgoat_target_model_2021b_B.AND3 "" UBYTE speedgoat_target_model_2021b_CM_logical 0 0 0 1 ECU_ADDRESS 0x002376FB /end MEASUREMENT
/begin MEASUREMENT speedgoat_target_model_2021b_B.AND3_b "" UBYTE speedgoat_target_model_2021b_CM_logical 0 0 0 1 ECU_ADDRESS 0x0023770D /end MEASUREMENT
/begin MEASUREMENT speedgoat_target_model_2021b_B.AND3_j "" UBYTE speedgoat_target_model_2021b_CM_logical 0 0 0 1 ECU_ADDRESS 0x00237710 /end MEASUREMENT
/begin MEASUREMENT speedgoat_target_model_2021b_B.Abs "" FLOAT64_IEEE speedgoat_target_model_2021b_CM_double 0 0 -1.7E+308 1.7E+308 ECU_ADDRESS 0x00237010 /end MEASUREMENT
/begin MEASUREMENT speedgoat_target_model_2021b_B.Add "" FLOAT64_IEEE speedgoat_target_model_2021b_CM_double 0 0 -1.7E+308 1.7E+308 ECU_ADDRESS 0x00236758 /end MEASUREMENT
/begin MEASUREMENT speedgoat_target_model_2021b_B.ApproachingSpeed "" FLOAT64_IEEE speedgoat_target_model_2021b_CM_double 0 0 -1.7E+308 1.7E+308 ECU_ADDRESS 0x00236768 /end MEASUREMENT
/begin MEASUREMENT speedgoat_target_model_2021b_B.BrakeSaturation "" FLOAT64_IEEE speedgoat_target_model_2021b_CM_double 0 0 -1.7E+308 1.7E+308 MATRIX_DIM 1 1 ECU_ADDRESS 0x00236E98 /end MEASUREMENT
/begin MEASUREMENT speedgoat_target_model_2021b_B.BrakeSaturation_n "" FLOAT64_IEEE speedgoat_target_model_2021b_CM_double 0 0 -1.7E+308 1.7E+308 ECU_ADDRESS 0x00236F18 /end MEASUREMENT
/begin MEASUREMENT speedgoat_target_model_2021b_B.BytePacking "" UBYTE speedgoat_target_model_2021b_CM_uint8 0 0 0 255 LAYOUT COLUMN_DIR MATRIX_DIM 24 ECU_ADDRESS 0x00237356 /end MEASUREMENT
/begin MEASUREMENT speedgoat_target_model_2021b_B.BytePacking1 "" UBYTE speedgoat_target_model_2021b_CM_uint8 0 0 0 255 LAYOUT COLUMN_DIR MATRIX_DIM 16 ECU_ADDRESS 0x0023736E /end MEASUREMENT
/begin MEASUREMENT speedgoat_target_model_2021b_B.Clear2Go "" FLOAT64_IEEE speedgoat_target_model_2021b_CM_double 0 0 -1.7E+308 1.7E+308 ECU_ADDRESS 0x00236790 /end MEASUREMENT
/begin MEASUREMENT speedgoat_target_model_2021b_B.Compare "" UBYTE speedgoat_target_model_2021b_CM_logical 0 0 0 1 ECU_ADDRESS 0x00237706 /end MEASUREMENT
/begin MEASUREMENT speedgoat_target_model_2021b_B.Compare_b "" UBYTE speedgoat_target_model_2021b_CM_logical 0 0 0 1 ECU_ADDRESS 0x0023770A /end MEASUREMENT
/begin MEASUREMENT speedgoat_target_model_2021b_B.Compare_j "" UBYTE speedgoat_target_model_2021b_CM_logical 0 0 0 1 ECU_ADDRESS 0x00237707 /end MEASUREMENT
/begin MEASUREMENT speedgoat_target_model_2021b_B.Compare_n "" UBYTE speedgoat_target_model_2021b_CM_logical 0 0 0 1 ECU_ADDRESS 0x00237708 /end MEASUREMENT
/begin MEASUREMENT speedgoat_target_model_2021b_B.Compare_p "" UBYTE speedgoat_target_model_2021b_CM_logical 0 0 0 1 ECU_ADDRESS 0x00237709 /end MEASUREMENT
/begin MEASUREMENT speedgoat_target_model_2021b_B.Constant1 "" FLOAT64_IEEE speedgoat_target_model_2021b_CM_double 0 0 -1.7E+308 1.7E+308 ECU_ADDRESS 0x00236778 /end MEASUREMENT
/begin MEASUREMENT speedgoat_target_model_2021b_B.CurrPoses "" FLOAT64_IEEE speedgoat_target_model_2021b_CM_double 0 0 -1.7E+308 1.7E+308 LAYOUT COLUMN_DIR MATRIX_DIM 3 ECU_ADDRESS 0x00236E48 /end MEASUREMENT
/begin MEASUREMENT speedgoat_target_model_2021b_B.Curvature "" FLOAT64_IEEE speedgoat_target_model_2021b_CM_double 0 0 -1.7E+308 1.7E+308 ECU_ADDRESS 0x00236B18 /end MEASUREMENT
/begin MEASUREMENT speedgoat_target_model_2021b_B.CurvedSteadyYaw "" FLOAT64_IEEE speedgoat_target_model_2021b_CM_double 0 0 -1.7E+308 1.7E+308 ECU_ADDRESS 0x00236718 /end MEASUREMENT
/begin MEASUREMENT speedgoat_target_model_2021b_B.D2D "" FLOAT64_IEEE speedgoat_target_model_2021b_CM_double 0 0 -1.7E+308 1.7E+308 ECU_ADDRESS 0x00236F78 /end MEASUREMENT
/begin MEASUREMENT speedgoat_target_model_2021b_B.D2S "" FLOAT64_IEEE speedgoat_target_model_2021b_CM_double 0 0 -1.7E+308 1.7E+308 ECU_ADDRESS 0x00236B30 /end MEASUREMENT
/begin MEASUREMENT speedgoat_target_model_2021b_B.DataTypeConv1 "" SBYTE speedgoat_target_model_2021b_CM_int8 0 0 -128 127 ECU_ADDRESS 0x002376CE /end MEASUREMENT
/begin MEASUREMENT speedgoat_target_model_2021b_B.DataTypeConv1_p "" SBYTE speedgoat_target_model_2021b_CM_int8 0 0 -128 127 ECU_ADDRESS 0x002376D0 /end MEASUREMENT
/begin MEASUREMENT speedgoat_target_model_2021b_B.DataTypeConv2 "" SBYTE speedgoat_target_model_2021b_CM_int8 0 0 -128 127 ECU_ADDRESS 0x002376CF /end MEASUREMENT
/begin MEASUREMENT speedgoat_target_model_2021b_B.DataTypeConv2_l "" SBYTE speedgoat_target_model_2021b_CM_int8 0 0 -128 127 ECU_ADDRESS 0x002376D1 /end MEASUREMENT
/begin MEASUREMENT speedgoat_target_model_2021b_B.DataTypeConversion "" UBYTE speedgoat_target_model_2021b_CM_logical 0 0 0 1 ECU_ADDRESS 0x00237705 /end MEASUREMENT
/begin MEASUREMENT speedgoat_target_model_2021b_B.DataTypeConversion1 "" UBYTE speedgoat_target_model_2021b_CM_logical 0 0 0 1 ECU_ADDRESS 0x002376D6 /end MEASUREMENT
/begin MEASUREMENT speedgoat_target_model_2021b_B.DataTypeConversion2 "" UBYTE speedgoat_target_model_2021b_CM_logical 0 0 0 1 ECU_ADDRESS 0x002376D4 /end MEASUREMENT
/begin MEASUREMENT speedgoat_target_model_2021b_B.DataTypeConversion3 "" UBYTE speedgoat_target_model_2021b_CM_logical 0 0 0 1 ECU_ADDRESS 0x002376D5 /end MEASUREMENT
/begin MEASUREMENT speedgoat_target_model_2021b_B.DataTypeConversion4 "" UBYTE speedgoat_target_model_2021b_CM_logical 0 0 0 1 ECU_ADDRESS 0x002376D2 /end MEASUREMENT
/begin MEASUREMENT speedgoat_target_model_2021b_B.DataTypeConversion5 "" UBYTE speedgoat_target_model_2021b_CM_logical 0 0 0 1 ECU_ADDRESS 0x002376D3 /end MEASUREMENT
/begin MEASUREMENT speedgoat_target_model_2021b_B.DeadZone "" FLOAT64_IEEE speedgoat_target_model_2021b_CM_double 0 0 -1.7E+308 1.7E+308 ECU_ADDRESS 0x00236FA0 /end MEASUREMENT
/begin MEASUREMENT speedgoat_target_model_2021b_B.DeadZone_n "" FLOAT64_IEEE speedgoat_target_model_2021b_CM_double 0 0 -1.7E+308 1.7E+308 ECU_ADDRESS 0x00236FE8 /end MEASUREMENT
/begin MEASUREMENT speedgoat_target_model_2021b_B.Direction "" FLOAT64_IEEE speedgoat_target_model_2021b_CM_double 0 0 -1.7E+308 1.7E+308 ECU_ADDRESS 0x00236B10 /end MEASUREMENT
/begin MEASUREMENT speedgoat_target_model_2021b_B.Equal1 "" UBYTE speedgoat_target_model_2021b_CM_logical 0 0 0 1 ECU_ADDRESS 0x002376FC /end MEASUREMENT
/begin MEASUREMENT speedgoat_target_model_2021b_B.Equal1_a "" UBYTE speedgoat_target_model_2021b_CM_logical 0 0 0 1 ECU_ADDRESS 0x0023770F /end MEASUREMENT
/begin MEASUREMENT speedgoat_target_model_2021b_B.Equal1_c "" UBYTE speedgoat_target_model_2021b_CM_logical 0 0 0 1 ECU_ADDRESS 0x0023770C /end MEASUREMENT
/begin MEASUREMENT speedgoat_target_model_2021b_B.Equal2 "" UBYTE speedgoat_target_model_2021b_CM_logical 0 0 0 1 ECU_ADDRESS 0x002376F9 /end MEASUREMENT
/begin MEASUREMENT speedgoat_target_model_2021b_B.Equal3 "" UBYTE speedgoat_target_model_2021b_CM_logical 0 0 0 1 ECU_ADDRESS 0x002376FD /end MEASUREMENT
/begin MEASUREMENT speedgoat_target_model_2021b_B.Equal4 "" UBYTE speedgoat_target_model_2021b_CM_logical 0 0 0 1 ECU_ADDRESS 0x00237702 /end MEASUREMENT
/begin MEASUREMENT speedgoat_target_model_2021b_B.Equal5 "" UBYTE speedgoat_target_model_2021b_CM_logical 0 0 0 1 ECU_ADDRESS 0x00237701 /end MEASUREMENT
/begin MEASUREMENT speedgoat_target_model_2021b_B.Equal6 "" UBYTE speedgoat_target_model_2021b_CM_logical 0 0 0 1 ECU_ADDRESS 0x002376FA /end MEASUREMENT
/begin MEASUREMENT speedgoat_target_model_2021b_B.F_aero "" FLOAT64_IEEE speedgoat_target_model_2021b_CM_double 0 0 -1.7E+308 1.7E+308 MATRIX_DIM 1 1 ECU_ADDRESS 0x00236E70 /end MEASUREMENT
/begin MEASUREMENT speedgoat_target_model_2021b_B.F_aero_h "" FLOAT64_IEEE speedgoat_target_model_2021b_CM_double 0 0 -1.7E+308 1.7E+308 ECU_ADDRESS 0x00236EF0 /end MEASUREMENT
/begin MEASUREMENT speedgoat_target_model_2021b_B.F_aero_hy "" FLOAT64_IEEE speedgoat_target_model_2021b_CM_double 0 0 -1.7E+308 1.7E+308 ECU_ADDRESS 0x00236F38 /end MEASUREMENT
/begin MEASUREMENT speedgoat_target_model_2021b_B.F_aero_k "" FLOAT64_IEEE speedgoat_target_model_2021b_CM_double 0 0 -1.7E+308 1.7E+308 MATRIX_DIM 1 1 ECU_ADDRESS 0x00236EB8 /end MEASUREMENT
/begin MEASUREMENT speedgoat_target_model_2021b_B.Floor "" FLOAT64_IEEE speedgoat_target_model_2021b_CM_double 0 0 -1.7E+308 1.7E+308 ECU_ADDRESS 0x00236800 /end MEASUREMENT
/begin MEASUREMENT speedgoat_target_model_2021b_B.Floor1 "" FLOAT64_IEEE speedgoat_target_model_2021b_CM_double 0 0 -1.7E+308 1.7E+308 ECU_ADDRESS 0x00236808 /end MEASUREMENT
/begin MEASUREMENT speedgoat_target_model_2021b_B.Gain "" FLOAT64_IEEE speedgoat_target_model_2021b_CM_double 0 0 -1.7E+308 1.7E+308 ECU_ADDRESS 0x00236708 /end MEASUREMENT
/begin MEASUREMENT speedgoat_target_model_2021b_B.Gain2 "" FLOAT64_IEEE speedgoat_target_model_2021b_CM_double 0 0 -1.7E+308 1.7E+308 ECU_ADDRESS 0x00236E78 /end MEASUREMENT
/begin MEASUREMENT speedgoat_target_model_2021b_B.Gain2_b "" FLOAT64_IEEE speedgoat_target_model_2021b_CM_double 0 0 -1.7E+308 1.7E+308 ECU_ADDRESS 0x00236F40 /end MEASUREMENT
/begin MEASUREMENT speedgoat_target_model_2021b_B.Gain2_k "" FLOAT64_IEEE speedgoat_target_model_2021b_CM_double 0 0 -1.7E+308 1.7E+308 ECU_ADDRESS 0x00236EC0 /end MEASUREMENT
/begin MEASUREMENT speedgoat_target_model_2021b_B.Gain2_p "" FLOAT64_IEEE speedgoat_target_model_2021b_CM_double 0 0 -1.7E+308 1.7E+308 ECU_ADDRESS 0x00236EF8 /end MEASUREMENT
/begin MEASUREMENT speedgoat_target_model_2021b_B.Gain_b "" FLOAT64_IEEE speedgoat_target_model_2021b_CM_double 0 0 -1.7E+308 1.7E+308 ECU_ADDRESS 0x00236F28 /end MEASUREMENT
/begin MEASUREMENT speedgoat_target_model_2021b_B.Gain_d "" FLOAT64_IEEE speedgoat_target_model_2021b_CM_double 0 0 -1.7E+308 1.7E+308 ECU_ADDRESS 0x00236720 /end MEASUREMENT
/begin MEASUREMENT speedgoat_target_model_2021b_B.Gain_dx "" FLOAT64_IEEE speedgoat_target_model_2021b_CM_double 0 0 -1.7E+308 1.7E+308 MATRIX_DIM 1 1 ECU_ADDRESS 0x00236E80 /end MEASUREMENT
/begin MEASUREMENT speedgoat_target_model_2021b_B.Gain_g "" FLOAT64_IEEE speedgoat_target_model_2021b_CM_double 0 0 -1.7E+308 1.7E+308 ECU_ADDRESS 0x00236F00 /end MEASUREMENT
/begin MEASUREMENT speedgoat_target_model_2021b_B.Gain_h "" FLOAT64_IEEE speedgoat_target_model_2021b_CM_double 0 0 -1.7E+308 1.7E+308 MATRIX_DIM 1 1 ECU_ADDRESS 0x00236EA8 /end MEASUREMENT
/begin MEASUREMENT speedgoat_target_model_2021b_B.IntegralGain "" FLOAT64_IEEE speedgoat_target_model_2021b_CM_double 0 0 -1.7E+308 1.7E+308 ECU_ADDRESS 0x00236FB0 /end MEASUREMENT
/begin MEASUREMENT speedgoat_target_model_2021b_B.IntegralGain_a "" FLOAT64_IEEE speedgoat_target_model_2021b_CM_double 0 0 -1.7E+308 1.7E+308 ECU_ADDRESS 0x00236FF8 /end MEASUREMENT
/begin MEASUREMENT speedgoat_target_model_2021b_B.Integrator "" FLOAT64_IEEE speedgoat_target_model_2021b_CM_double 0 0 -1.7E+308 1.7E+308 ECU_ADDRESS 0x00236F88 /end MEASUREMENT
/begin MEASUREMENT speedgoat_target_model_2021b_B.Integrator_b "" FLOAT64_IEEE speedgoat_target_model_2021b_CM_double 0 0 -1.7E+308 1.7E+308 ECU_ADDRESS 0x00236FD0 /end MEASUREMENT
/begin MEASUREMENT speedgoat_target_model_2021b_B.LaneAvailable "" FLOAT64_IEEE speedgoat_target_model_2021b_CM_double 0 0 -1.7E+308 1.7E+308 ECU_ADDRESS 0x002367B0 /end MEASUREMENT
/begin MEASUREMENT speedgoat_target_model_2021b_B.LaneChangeCmd "" FLOAT64_IEEE speedgoat_target_model_2021b_CM_double 0 0 -1.7E+308 1.7E+308 ECU_ADDRESS 0x00237028 /end MEASUREMENT
/begin MEASUREMENT speedgoat_target_model_2021b_B.LaneChanged "" FLOAT64_IEEE speedgoat_target_model_2021b_CM_double 0 0 -1.7E+308 1.7E+308 ECU_ADDRESS 0x002367B8 /end MEASUREMENT
/begin MEASUREMENT speedgoat_target_model_2021b_B.Longitudinalvelocity "" FLOAT64_IEEE speedgoat_target_model_2021b_CM_double 0 0 -1.7E+308 1.7E+308 ECU_ADDRESS 0x00236E30 /end MEASUREMENT
/begin MEASUREMENT speedgoat_target_model_2021b_B.MathFunction "" FLOAT64_IEEE speedgoat_target_model_2021b_CM_double 0 0 -1.7E+308 1.7E+308 LAYOUT COLUMN_DIR MATRIX_DIM 2 1 ECU_ADDRESS 0x00236828 /end MEASUREMENT
/begin MEASUREMENT speedgoat_target_model_2021b_B.MathFunction1 "" FLOAT64_IEEE speedgoat_target_model_2021b_CM_double 0 0 -1.7E+308 1.7E+308 MATRIX_DIM 1 1 ECU_ADDRESS 0x00236838 /end MEASUREMENT
/begin MEASUREMENT speedgoat_target_model_2021b_B.MathFunction2 "" FLOAT64_IEEE speedgoat_target_model_2021b_CM_double 0 0 -1.7E+308 1.7E+308 MATRIX_DIM 1 1 ECU_ADDRESS 0x00236840 /end MEASUREMENT
/begin MEASUREMENT speedgoat_target_model_2021b_B.Memory "" UBYTE speedgoat_target_model_2021b_CM_logical 0 0 0 1 LAYOUT COLUMN_DIR MATRIX_DIM 34 ECU_ADDRESS 0x002376D7 /end MEASUREMENT
/begin MEASUREMENT speedgoat_target_model_2021b_B.Merge "" FLOAT64_IEEE speedgoat_target_model_2021b_CM_double 0 0 -1.7E+308 1.7E+308 ECU_ADDRESS 0x00236AA0 /end MEASUREMENT
/begin MEASUREMENT speedgoat_target_model_2021b_B.Merge1 "" FLOAT64_IEEE speedgoat_target_model_2021b_CM_double 0 0 -1.7E+308 1.7E+308 MATRIX_DIM 1 1 ECU_ADDRESS 0x002367D8 /end MEASUREMENT
/begin MEASUREMENT speedgoat_target_model_2021b_B.Merge2 "" FLOAT64_IEEE speedgoat_target_model_2021b_CM_double 0 0 -1.7E+308 1.7E+308 MATRIX_DIM 1 1 ECU_ADDRESS 0x002367E0 /end MEASUREMENT
/begin MEASUREMENT speedgoat_target_model_2021b_B.MinSpeed "" FLOAT64_IEEE speedgoat_target_model_2021b_CM_double 0 0 -1.7E+308 1.7E+308 ECU_ADDRESS 0x002367A8 /end MEASUREMENT
/begin MEASUREMENT speedgoat_target_model_2021b_B.Minus "" FLOAT64_IEEE speedgoat_target_model_2021b_CM_double 0 0 -1.7E+308 1.7E+308 ECU_ADDRESS 0x00236728 /end MEASUREMENT
/begin MEASUREMENT speedgoat_target_model_2021b_B.Minus1 "" FLOAT64_IEEE speedgoat_target_model_2021b_CM_double 0 0 -1.7E+308 1.7E+308 ECU_ADDRESS 0x00236748 /end MEASUREMENT
/begin MEASUREMENT speedgoat_target_model_2021b_B.Multiply "" FLOAT64_IEEE speedgoat_target_model_2021b_CM_double 0 0 -1.7E+308 1.7E+308 ECU_ADDRESS 0x00236710 /end MEASUREMENT
/begin MEASUREMENT speedgoat_target_model_2021b_B.Multiply_k "" FLOAT64_IEEE speedgoat_target_model_2021b_CM_double 0 0 -1.7E+308 1.7E+308 ECU_ADDRESS 0x00236AA8 /end MEASUREMENT
/begin MEASUREMENT speedgoat_target_model_2021b_B.NOT "" UBYTE speedgoat_target_model_2021b_CM_logical 0 0 0 1 ECU_ADDRESS 0x00237704 /end MEASUREMENT
/begin MEASUREMENT speedgoat_target_model_2021b_B.NOT1 "" UBYTE speedgoat_target_model_2021b_CM_logical 0 0 0 1 ECU_ADDRESS 0x00237700 /end MEASUREMENT
/begin MEASUREMENT speedgoat_target_model_2021b_B.NavigatingFlag "" FLOAT64_IEEE speedgoat_target_model_2021b_CM_double 0 0 -1.7E+308 1.7E+308 ECU_ADDRESS 0x00236788 /end MEASUREMENT
/begin MEASUREMENT speedgoat_target_model_2021b_B.NotEqual "" UBYTE speedgoat_target_model_2021b_CM_logical 0 0 0 1 ECU_ADDRESS 0x0023770B /end MEASUREMENT
/begin MEASUREMENT speedgoat_target_model_2021b_B.NotEqual_b "" UBYTE speedgoat_target_model_2021b_CM_logical 0 0 0 1 ECU_ADDRESS 0x0023770E /end MEASUREMENT
/begin MEASUREMENT speedgoat_target_model_2021b_B.OR "" SWORD speedgoat_target_model_2021b_CM_int16 0 0 -32768 32767 ECU_ADDRESS 0x00237354 /end MEASUREMENT
/begin MEASUREMENT speedgoat_target_model_2021b_B.OR_h "" UBYTE speedgoat_target_model_2021b_CM_logical 0 0 0 1 ECU_ADDRESS 0x002376FF /end MEASUREMENT
/begin MEASUREMENT speedgoat_target_model_2021b_B.ObjAhead "" FLOAT64_IEEE speedgoat_target_model_2021b_CM_double 0 0 -1.7E+308 1.7E+308 ECU_ADDRESS 0x00236E28 /end MEASUREMENT
/begin MEASUREMENT speedgoat_target_model_2021b_B.ObjectDist "" FLOAT64_IEEE speedgoat_target_model_2021b_CM_double 0 0 -1.7E+308 1.7E+308 ECU_ADDRESS 0x00236B28 /end MEASUREMENT
/begin MEASUREMENT speedgoat_target_model_2021b_B.Product "" FLOAT64_IEEE speedgoat_target_model_2021b_CM_double 0 0 -1.7E+308 1.7E+308 ECU_ADDRESS 0x00236700 /end MEASUREMENT
/begin MEASUREMENT speedgoat_target_model_2021b_B.Product2 "" FLOAT64_IEEE speedgoat_target_model_2021b_CM_double 0 0 -1.7E+308 1.7E+308 ECU_ADDRESS 0x002367E8 /end MEASUREMENT
/begin MEASUREMENT speedgoat_target_model_2021b_B.ProportionalGain "" FLOAT64_IEEE speedgoat_target_model_2021b_CM_double 0 0 -1.7E+308 1.7E+308 ECU_ADDRESS 0x00236F80 /end MEASUREMENT
/begin MEASUREMENT speedgoat_target_model_2021b_B.ProportionalGain_f "" FLOAT64_IEEE speedgoat_target_model_2021b_CM_double 0 0 -1.7E+308 1.7E+308 ECU_ADDRESS 0x00236FC8 /end MEASUREMENT
/begin MEASUREMENT speedgoat_target_model_2021b_B.RRCrossing "" FLOAT64_IEEE speedgoat_target_model_2021b_CM_double 0 0 -1.7E+308 1.7E+308 ECU_ADDRESS 0x00236780 /end MEASUREMENT
/begin MEASUREMENT speedgoat_target_model_2021b_B.RefPoses "" FLOAT64_IEEE speedgoat_target_model_2021b_CM_double 0 0 -1.7E+308 1.7E+308 LAYOUT COLUMN_DIR MATRIX_DIM 3 ECU_ADDRESS 0x00236E10 /end MEASUREMENT
/begin MEASUREMENT speedgoat_target_model_2021b_B.RefVelCmd "" FLOAT64_IEEE speedgoat_target_model_2021b_CM_double 0 0 -1.7E+308 1.7E+308 ECU_ADDRESS 0x00236F70 /end MEASUREMENT
/begin MEASUREMENT speedgoat_target_model_2021b_B.Relativedistance "" FLOAT64_IEEE speedgoat_target_model_2021b_CM_double 0 0 -1.7E+308 1.7E+308 ECU_ADDRESS 0x00236B38 /end MEASUREMENT
/begin MEASUREMENT speedgoat_target_model_2021b_B.Relativevelocity "" FLOAT64_IEEE speedgoat_target_model_2021b_CM_double 0 0 -1.7E+308 1.7E+308 ECU_ADDRESS 0x00236E40 /end MEASUREMENT
/begin MEASUREMENT speedgoat_target_model_2021b_B.Reshape "" FLOAT64_IEEE speedgoat_target_model_2021b_CM_double 0 0 -1.7E+308 1.7E+308 MATRIX_DIM 1 1 ECU_ADDRESS 0x00236850 /end MEASUREMENT
/begin MEASUREMENT speedgoat_target_model_2021b_B.Reshape1 "" FLOAT64_IEEE speedgoat_target_model_2021b_CM_double 0 0 -1.7E+308 1.7E+308 LAYOUT COLUMN_DIR MATRIX_DIM 2 1 ECU_ADDRESS 0x00236868 /end MEASUREMENT
/begin MEASUREMENT speedgoat_target_model_2021b_B.Reshape2 "" FLOAT64_IEEE speedgoat_target_model_2021b_CM_double 0 0 -1.7E+308 1.7E+308 MATRIX_DIM 1 1 ECU_ADDRESS 0x00236880 /end MEASUREMENT
/begin MEASUREMENT speedgoat_target_model_2021b_B.Reshape3 "" FLOAT64_IEEE speedgoat_target_model_2021b_CM_double 0 0 -1.7E+308 1.7E+308 LAYOUT COLUMN_DIR MATRIX_DIM 1 2 ECU_ADDRESS 0x00236888 /end MEASUREMENT
/begin MEASUREMENT speedgoat_target_model_2021b_B.Reshape4 "" FLOAT64_IEEE speedgoat_target_model_2021b_CM_double 0 0 -1.7E+308 1.7E+308 MATRIX_DIM 1 1 ECU_ADDRESS 0x00236898 /end MEASUREMENT
/begin MEASUREMENT speedgoat_target_model_2021b_B.Reshape5 "" FLOAT64_IEEE speedgoat_target_model_2021b_CM_double 0 0 -1.7E+308 1.7E+308 MATRIX_DIM 1 1 ECU_ADDRESS 0x002368A0 /end MEASUREMENT
/begin MEASUREMENT speedgoat_target_model_2021b_B.RoadSpeed "" FLOAT64_IEEE speedgoat_target_model_2021b_CM_double 0 0 -1.7E+308 1.7E+308 ECU_ADDRESS 0x00236798 /end MEASUREMENT
/begin MEASUREMENT speedgoat_target_model_2021b_B.Saturation "" FLOAT64_IEEE speedgoat_target_model_2021b_CM_double 0 0 -1.7E+308 1.7E+308 ECU_ADDRESS 0x00236760 /end MEASUREMENT
/begin MEASUREMENT speedgoat_target_model_2021b_B.SceneID "" FLOAT64_IEEE speedgoat_target_model_2021b_CM_double 0 0 -1.7E+308 1.7E+308 ECU_ADDRESS 0x00236E38 /end MEASUREMENT
/begin MEASUREMENT speedgoat_target_model_2021b_B.SceneSpeed "" FLOAT64_IEEE speedgoat_target_model_2021b_CM_double 0 0 -1.7E+308 1.7E+308 ECU_ADDRESS 0x00236770 /end MEASUREMENT
/begin MEASUREMENT speedgoat_target_model_2021b_B.Sign1 "" FLOAT64_IEEE speedgoat_target_model_2021b_CM_double 0 0 -1.7E+308 1.7E+308 ECU_ADDRESS 0x00236A58 /end MEASUREMENT
/begin MEASUREMENT speedgoat_target_model_2021b_B.Sign2 "" FLOAT64_IEEE speedgoat_target_model_2021b_CM_double 0 0 -1.7E+308 1.7E+308 ECU_ADDRESS 0x00236A38 /end MEASUREMENT
/begin MEASUREMENT speedgoat_target_model_2021b_B.SignPreIntegrator "" FLOAT64_IEEE speedgoat_target_model_2021b_CM_double 0 0 -1.7E+308 1.7E+308 ECU_ADDRESS 0x00236FB8 /end MEASUREMENT
/begin MEASUREMENT speedgoat_target_model_2021b_B.SignPreIntegrator_d "" FLOAT64_IEEE speedgoat_target_model_2021b_CM_double 0 0 -1.7E+308 1.7E+308 ECU_ADDRESS 0x00237000 /end MEASUREMENT
/begin MEASUREMENT speedgoat_target_model_2021b_B.SignPreSat "" FLOAT64_IEEE speedgoat_target_model_2021b_CM_double 0 0 -1.7E+308 1.7E+308 ECU_ADDRESS 0x00236FA8 /end MEASUREMENT
/begin MEASUREMENT speedgoat_target_model_2021b_B.SignPreSat_m "" FLOAT64_IEEE speedgoat_target_model_2021b_CM_double 0 0 -1.7E+308 1.7E+308 ECU_ADDRESS 0x00236FF0 /end MEASUREMENT
/begin MEASUREMENT speedgoat_target_model_2021b_B.Square "" FLOAT64_IEEE speedgoat_target_model_2021b_CM_double 0 0 -1.7E+308 1.7E+308 MATRIX_DIM 1 1 ECU_ADDRESS 0x00236E68 /end MEASUREMENT
/begin MEASUREMENT speedgoat_target_model_2021b_B.Square_i "" FLOAT64_IEEE speedgoat_target_model_2021b_CM_double 0 0 -1.7E+308 1.7E+308 MATRIX_DIM 1 1 ECU_ADDRESS 0x00236EB0 /end MEASUREMENT
/begin MEASUREMENT speedgoat_target_model_2021b_B.Square_j "" FLOAT64_IEEE speedgoat_target_model_2021b_CM_double 0 0 -1.7E+308 1.7E+308 ECU_ADDRESS 0x00236EE8 /end MEASUREMENT
/begin MEASUREMENT speedgoat_target_model_2021b_B.Square_k "" FLOAT64_IEEE speedgoat_target_model_2021b_CM_double 0 0 -1.7E+308 1.7E+308 ECU_ADDRESS 0x00236F30 /end MEASUREMENT
/begin MEASUREMENT speedgoat_target_model_2021b_B.SteeringDelay "" FLOAT64_IEEE speedgoat_target_model_2021b_CM_double 0 0 -1.7E+308 1.7E+308 ECU_ADDRESS 0x00236750 /end MEASUREMENT
/begin MEASUREMENT speedgoat_target_model_2021b_B.StopSim "" FLOAT64_IEEE speedgoat_target_model_2021b_CM_double 0 0 -1.7E+308 1.7E+308 ECU_ADDRESS 0x00237050 /end MEASUREMENT
/begin MEASUREMENT speedgoat_target_model_2021b_B.Subtract "" FLOAT64_IEEE speedgoat_target_model_2021b_CM_double 0 0 -1.7E+308 1.7E+308 ECU_ADDRESS 0x00236AC8 /end MEASUREMENT
/begin MEASUREMENT speedgoat_target_model_2021b_B.Subtract_b "" FLOAT64_IEEE speedgoat_target_model_2021b_CM_double 0 0 -1.7E+308 1.7E+308 ECU_ADDRESS 0x00236AF8 /end MEASUREMENT
/begin MEASUREMENT speedgoat_target_model_2021b_B.Subtract_bo "" FLOAT64_IEEE speedgoat_target_model_2021b_CM_double 0 0 -1.7E+308 1.7E+308 ECU_ADDRESS 0x00236B08 /end MEASUREMENT
/begin MEASUREMENT speedgoat_target_model_2021b_B.Subtract_d "" FLOAT64_IEEE speedgoat_target_model_2021b_CM_double 0 0 -1.7E+308 1.7E+308 ECU_ADDRESS 0x00236AE8 /end MEASUREMENT
/begin MEASUREMENT speedgoat_target_model_2021b_B.Subtract_p "" FLOAT64_IEEE speedgoat_target_model_2021b_CM_double 0 0 -1.7E+308 1.7E+308 ECU_ADDRESS 0x00236AD8 /end MEASUREMENT
/begin MEASUREMENT speedgoat_target_model_2021b_B.Sum "" FLOAT64_IEEE speedgoat_target_model_2021b_CM_double 0 0 -1.7E+308 1.7E+308 MATRIX_DIM 1 1 ECU_ADDRESS 0x00236E88 /end MEASUREMENT
/begin MEASUREMENT speedgoat_target_model_2021b_B.Sum_d "" FLOAT64_IEEE speedgoat_target_model_2021b_CM_double 0 0 -1.7E+308 1.7E+308 ECU_ADDRESS 0x00236F08 /end MEASUREMENT
/begin MEASUREMENT speedgoat_target_model_2021b_B.Sum_f "" FLOAT64_IEEE speedgoat_target_model_2021b_CM_double 0 0 -1.7E+308 1.7E+308 ECU_ADDRESS 0x00236F48 /end MEASUREMENT
/begin MEASUREMENT speedgoat_target_model_2021b_B.Sum_fg "" FLOAT64_IEEE speedgoat_target_model_2021b_CM_double 0 0 -1.7E+308 1.7E+308 ECU_ADDRESS 0x00236F90 /end MEASUREMENT
/begin MEASUREMENT speedgoat_target_model_2021b_B.Sum_k "" FLOAT64_IEEE speedgoat_target_model_2021b_CM_double 0 0 -1.7E+308 1.7E+308 ECU_ADDRESS 0x00236FD8 /end MEASUREMENT
/begin MEASUREMENT speedgoat_target_model_2021b_B.Sum_o "" FLOAT64_IEEE speedgoat_target_model_2021b_CM_double 0 0 -1.7E+308 1.7E+308 MATRIX_DIM 1 1 ECU_ADDRESS 0x00236EC8 /end MEASUREMENT
/begin MEASUREMENT speedgoat_target_model_2021b_B.Switch "" FLOAT64_IEEE speedgoat_target_model_2021b_CM_double 0 0 -1.7E+308 1.7E+308 MATRIX_DIM 1 1 ECU_ADDRESS 0x00236AB0 /end MEASUREMENT
/begin MEASUREMENT speedgoat_target_model_2021b_B.Switch1 "" FLOAT64_IEEE speedgoat_target_model_2021b_CM_double 0 0 -1.7E+308 1.7E+308 MATRIX_DIM 1 1 ECU_ADDRESS 0x00236AB8 /end MEASUREMENT
/begin MEASUREMENT speedgoat_target_model_2021b_B.Switch_l "" FLOAT64_IEEE speedgoat_target_model_2021b_CM_double 0 0 -1.7E+308 1.7E+308 ECU_ADDRESS 0x00237008 /end MEASUREMENT
/begin MEASUREMENT speedgoat_target_model_2021b_B.Switch_o "" FLOAT64_IEEE speedgoat_target_model_2021b_CM_double 0 0 -1.7E+308 1.7E+308 ECU_ADDRESS 0x00236FC0 /end MEASUREMENT
/begin MEASUREMENT speedgoat_target_model_2021b_B.TLstate "" FLOAT64_IEEE speedgoat_target_model_2021b_CM_double 0 0 -1.7E+308 1.7E+308 LAYOUT COLUMN_DIR MATRIX_DIM 5 18 ECU_ADDRESS 0x00236B40 /end MEASUREMENT
/begin MEASUREMENT speedgoat_target_model_2021b_B.T_eng "" FLOAT64_IEEE speedgoat_target_model_2021b_CM_double 0 0 -1.7E+308 1.7E+308 MATRIX_DIM 1 1 ECU_ADDRESS 0x00236E90 /end MEASUREMENT
/begin MEASUREMENT speedgoat_target_model_2021b_B.T_eng_c "" FLOAT64_IEEE speedgoat_target_model_2021b_CM_double 0 0 -1.7E+308 1.7E+308 ECU_ADDRESS 0x00236F10 /end MEASUREMENT
/begin MEASUREMENT speedgoat_target_model_2021b_B.T_eng_c0 "" FLOAT64_IEEE speedgoat_target_model_2021b_CM_double 0 0 -1.7E+308 1.7E+308 ECU_ADDRESS 0x00236F50 /end MEASUREMENT
/begin MEASUREMENT speedgoat_target_model_2021b_B.T_eng_h "" FLOAT64_IEEE speedgoat_target_model_2021b_CM_double 0 0 -1.7E+308 1.7E+308 MATRIX_DIM 1 1 ECU_ADDRESS 0x00236ED0 /end MEASUREMENT
/begin MEASUREMENT speedgoat_target_model_2021b_B.Tgap "" FLOAT64_IEEE speedgoat_target_model_2021b_CM_double 0 0 -1.7E+308 1.7E+308 ECU_ADDRESS 0x00237040 /end MEASUREMENT
/begin MEASUREMENT speedgoat_target_model_2021b_B.ThrottleSaturation "" FLOAT64_IEEE speedgoat_target_model_2021b_CM_double 0 0 -1.7E+308 1.7E+308 MATRIX_DIM 1 1 ECU_ADDRESS 0x00236ED8 /end MEASUREMENT
/begin MEASUREMENT speedgoat_target_model_2021b_B.ThrottleSaturation_m "" FLOAT64_IEEE speedgoat_target_model_2021b_CM_double 0 0 -1.7E+308 1.7E+308 ECU_ADDRESS 0x00236F58 /end MEASUREMENT
/begin MEASUREMENT speedgoat_target_model_2021b_B.TmpRTBAtDataTypeConversion_vset "" FLOAT64_IEEE speedgoat_target_model_2021b_CM_double 0 0 -1.7E+308 1.7E+308 ECU_ADDRESS 0x00236908 /end MEASUREMENT
/begin MEASUREMENT speedgoat_target_model_2021b_B.TmpRTBAtEqual1Inport1 "" FLOAT64_IEEE speedgoat_target_model_2021b_CM_double 0 0 -1.7E+308 1.7E+308 ECU_ADDRESS 0x00236A48 /end MEASUREMENT
/begin MEASUREMENT speedgoat_target_model_2021b_B.TmpRTBAtEqual2Inport1 "" FLOAT64_IEEE speedgoat_target_model_2021b_CM_double 0 0 -1.7E+308 1.7E+308 ECU_ADDRESS 0x00236A28 /end MEASUREMENT
/begin MEASUREMENT speedgoat_target_model_2021b_B.TmpRTBAtEqual3Inport1 "" FLOAT64_IEEE speedgoat_target_model_2021b_CM_double 0 0 -1.7E+308 1.7E+308 ECU_ADDRESS 0x00236A60 /end MEASUREMENT
/begin MEASUREMENT speedgoat_target_model_2021b_B.TmpRTBAtEqual4Inport2 "" FLOAT64_IEEE speedgoat_target_model_2021b_CM_double 0 0 -1.7E+308 1.7E+308 ECU_ADDRESS 0x00236A70 /end MEASUREMENT
/begin MEASUREMENT speedgoat_target_model_2021b_B.TmpRTBAtEqual5Inport2 "" FLOAT64_IEEE speedgoat_target_model_2021b_CM_double 0 0 -1.7E+308 1.7E+308 ECU_ADDRESS 0x00236A68 /end MEASUREMENT
/begin MEASUREMENT speedgoat_target_model_2021b_B.TmpRTBAtMinusInport2 "" FLOAT64_IEEE speedgoat_target_model_2021b_CM_double 0 0 -1.7E+308 1.7E+308 ECU_ADDRESS 0x00236A90 /end MEASUREMENT
/begin MEASUREMENT speedgoat_target_model_2021b_B.TmpRTBAtMultiplyInport1 "" FLOAT64_IEEE speedgoat_target_model_2021b_CM_double 0 0 -1.7E+308 1.7E+308 ECU_ADDRESS 0x00236A78 /end MEASUREMENT
/begin MEASUREMENT speedgoat_target_model_2021b_B.TmpRTBAtSign1Inport1 "" FLOAT64_IEEE speedgoat_target_model_2021b_CM_double 0 0 -1.7E+308 1.7E+308 ECU_ADDRESS 0x00236A50 /end MEASUREMENT
/begin MEASUREMENT speedgoat_target_model_2021b_B.TmpRTBAtSwitch1Outport1 "" FLOAT64_IEEE speedgoat_target_model_2021b_CM_double 0 0 -1.7E+308 1.7E+308 MATRIX_DIM 1 1 ECU_ADDRESS 0x002367D0 /end MEASUREMENT
/begin MEASUREMENT speedgoat_target_model_2021b_B.TmpRTBAtSwitchCaseInport1 "" FLOAT64_IEEE speedgoat_target_model_2021b_CM_double 0 0 -1.7E+308 1.7E+308 ECU_ADDRESS 0x00236A80 /end MEASUREMENT
/begin MEASUREMENT speedgoat_target_model_2021b_B.TmpRTBAtSwitchOutport1 "" FLOAT64_IEEE speedgoat_target_model_2021b_CM_double 0 0 -1.7E+308 1.7E+308 MATRIX_DIM 1 1 ECU_ADDRESS 0x002367C8 /end MEASUREMENT
/begin MEASUREMENT speedgoat_target_model_2021b_B.TmpRTBAtoptimizerInport3 "" FLOAT64_IEEE speedgoat_target_model_2021b_CM_double 0 0 -1.7E+308 1.7E+308 LAYOUT COLUMN_DIR MATRIX_DIM 2 ECU_ADDRESS 0x002368E0 /end MEASUREMENT
/begin MEASUREMENT speedgoat_target_model_2021b_B.TmpRTBAtoptimizerInport5 "" FLOAT64_IEEE speedgoat_target_model_2021b_CM_double 0 0 -1.7E+308 1.7E+308 ECU_ADDRESS 0x002368F0 /end MEASUREMENT
/begin MEASUREMENT speedgoat_target_model_2021b_B.TmpSignalConversionAtSFunctio_m "" FLOAT64_IEEE speedgoat_target_model_2021b_CM_double 0 0 -1.7E+308 1.7E+308 LAYOUT COLUMN_DIR MATRIX_DIM 2 ECU_ADDRESS 0x00237068 /end MEASUREMENT
/begin MEASUREMENT speedgoat_target_model_2021b_B.TmpSignalConversionAtSFunctionI "" FLOAT64_IEEE speedgoat_target_model_2021b_CM_double 0 0 -1.7E+308 1.7E+308 LAYOUT COLUMN_DIR MATRIX_DIM 2 ECU_ADDRESS 0x00237058 /end MEASUREMENT
/begin MEASUREMENT speedgoat_target_model_2021b_B.Trans "" FLOAT64_IEEE speedgoat_target_model_2021b_CM_double 0 0 -1.7E+308 1.7E+308 ECU_ADDRESS 0x00237048 /end MEASUREMENT
/begin MEASUREMENT speedgoat_target_model_2021b_B.UDPReceive2_o1 "" UBYTE speedgoat_target_model_2021b_CM_uint8 0 0 0 255 LAYOUT COLUMN_DIR MATRIX_DIM 24 ECU_ADDRESS 0x0023737E /end MEASUREMENT
/begin MEASUREMENT speedgoat_target_model_2021b_B.UDPReceive2_o1_d "" UBYTE speedgoat_target_model_2021b_CM_uint8 0 0 0 255 LAYOUT COLUMN_DIR MATRIX_DIM 24 ECU_ADDRESS 0x0023767E /end MEASUREMENT
/begin MEASUREMENT speedgoat_target_model_2021b_B.UDPReceive2_o1_m "" UBYTE speedgoat_target_model_2021b_CM_uint8 0 0 0 255 LAYOUT COLUMN_DIR MATRIX_DIM 24 ECU_ADDRESS 0x002376B6 /end MEASUREMENT
/begin MEASUREMENT speedgoat_target_model_2021b_B.UDPReceive2_o1_o "" UBYTE speedgoat_target_model_2021b_CM_uint8 0 0 0 255 LAYOUT COLUMN_DIR MATRIX_DIM 744 ECU_ADDRESS 0x00237396 /end MEASUREMENT
/begin MEASUREMENT speedgoat_target_model_2021b_B.UDPReceive2_o1_p "" UBYTE speedgoat_target_model_2021b_CM_uint8 0 0 0 255 LAYOUT COLUMN_DIR MATRIX_DIM 32 ECU_ADDRESS 0x00237696 /end MEASUREMENT
/begin MEASUREMENT speedgoat_target_model_2021b_B.UDPReceive2_o2 "" FLOAT64_IEEE speedgoat_target_model_2021b_CM_double 0 0 -1.7E+308 1.7E+308 ECU_ADDRESS 0x00236AC0 /end MEASUREMENT
/begin MEASUREMENT speedgoat_target_model_2021b_B.UDPReceive2_o2_c "" FLOAT64_IEEE speedgoat_target_model_2021b_CM_double 0 0 -1.7E+308 1.7E+308 ECU_ADDRESS 0x00236B00 /end MEASUREMENT
/begin MEASUREMENT speedgoat_target_model_2021b_B.UDPReceive2_o2_h "" FLOAT64_IEEE speedgoat_target_model_2021b_CM_double 0 0 -1.7E+308 1.7E+308 ECU_ADDRESS 0x00236AE0 /end MEASUREMENT
/begin MEASUREMENT speedgoat_target_model_2021b_B.UDPReceive2_o2_j "" FLOAT64_IEEE speedgoat_target_model_2021b_CM_double 0 0 -1.7E+308 1.7E+308 ECU_ADDRESS 0x00236AF0 /end MEASUREMENT
/begin MEASUREMENT speedgoat_target_model_2021b_B.UDPReceive2_o2_o "" FLOAT64_IEEE speedgoat_target_model_2021b_CM_double 0 0 -1.7E+308 1.7E+308 ECU_ADDRESS 0x00236AD0 /end MEASUREMENT
/begin MEASUREMENT speedgoat_target_model_2021b_B.UnitDelay "" FLOAT64_IEEE speedgoat_target_model_2021b_CM_double 0 0 -1.7E+308 1.7E+308 ECU_ADDRESS 0x00236738 /end MEASUREMENT
/begin MEASUREMENT speedgoat_target_model_2021b_B.UnitDelay_n "" FLOAT64_IEEE speedgoat_target_model_2021b_CM_double 0 0 -1.7E+308 1.7E+308 ECU_ADDRESS 0x00236740 /end MEASUREMENT
/begin MEASUREMENT speedgoat_target_model_2021b_B.VelCmd "" FLOAT64_IEEE speedgoat_target_model_2021b_CM_double 0 0 -1.7E+308 1.7E+308 ECU_ADDRESS 0x00237030 /end MEASUREMENT
/begin MEASUREMENT speedgoat_target_model_2021b_B.WaitTime "" FLOAT64_IEEE speedgoat_target_model_2021b_CM_double 0 0 -1.7E+308 1.7E+308 ECU_ADDRESS 0x002367A0 /end MEASUREMENT
/begin MEASUREMENT speedgoat_target_model_2021b_B.WhileIterator "" SLONG speedgoat_target_model_2021b_CM_int32 0 0 -2147483648 2147483647 ECU_ADDRESS 0x00237340 /end MEASUREMENT
/begin MEASUREMENT speedgoat_target_model_2021b_B.WhileIterator_c "" SLONG speedgoat_target_model_2021b_CM_int32 0 0 -2147483648 2147483647 ECU_ADDRESS 0x00237348 /end MEASUREMENT
/begin MEASUREMENT speedgoat_target_model_2021b_B.WhileIterator_e "" SLONG speedgoat_target_model_2021b_CM_int32 0 0 -2147483648 2147483647 ECU_ADDRESS 0x00237350 /end MEASUREMENT
/begin MEASUREMENT speedgoat_target_model_2021b_B.WhileIterator_k "" SLONG speedgoat_target_model_2021b_CM_int32 0 0 -2147483648 2147483647 ECU_ADDRESS 0x00237344 /end MEASUREMENT
/begin MEASUREMENT speedgoat_target_model_2021b_B.WhileIterator_p "" SLONG speedgoat_target_model_2021b_CM_int32 0 0 -2147483648 2147483647 ECU_ADDRESS 0x0023734C /end MEASUREMENT
/begin MEASUREMENT speedgoat_target_model_2021b_B.YawRateFeedback "" FLOAT64_IEEE speedgoat_target_model_2021b_CM_double 0 0 -1.7E+308 1.7E+308 ECU_ADDRESS 0x00236730 /end MEASUREMENT
/begin MEASUREMENT speedgoat_target_model_2021b_B.ZeroGain "" FLOAT64_IEEE speedgoat_target_model_2021b_CM_double 0 0 -1.7E+308 1.7E+308 ECU_ADDRESS 0x00236F98 /end MEASUREMENT
/begin MEASUREMENT speedgoat_target_model_2021b_B.ZeroGain_l "" FLOAT64_IEEE speedgoat_target_model_2021b_CM_double 0 0 -1.7E+308 1.7E+308 ECU_ADDRESS 0x00236FE0 /end MEASUREMENT
/begin MEASUREMENT speedgoat_target_model_2021b_B.accel "" FLOAT64_IEEE speedgoat_target_model_2021b_CM_double 0 0 -1.7E+308 1.7E+308 ECU_ADDRESS 0x00236F60 /end MEASUREMENT
/begin MEASUREMENT speedgoat_target_model_2021b_B.acceleration "" FLOAT64_IEEE speedgoat_target_model_2021b_CM_double 0 0 -1.7E+308 1.7E+308 ECU_ADDRESS 0x002367C0 /end MEASUREMENT
/begin MEASUREMENT speedgoat_target_model_2021b_B.cost "" FLOAT64_IEEE speedgoat_target_model_2021b_CM_double 0 0 -1.7E+308 1.7E+308 ECU_ADDRESS 0x002370A0 /end MEASUREMENT
/begin MEASUREMENT speedgoat_target_model_2021b_B.decel "" FLOAT64_IEEE speedgoat_target_model_2021b_CM_double 0 0 -1.7E+308 1.7E+308 ECU_ADDRESS 0x00236F68 /end MEASUREMENT
/begin MEASUREMENT speedgoat_target_model_2021b_B.default_spacing "" FLOAT64_IEEE speedgoat_target_model_2021b_CM_double 0 0 -1.7E+308 1.7E+308 ECU_ADDRESS 0x00236820 /end MEASUREMENT
/begin MEASUREMENT speedgoat_target_model_2021b_B.error "" FLOAT64_IEEE speedgoat_target_model_2021b_CM_double 0 0 -1.7E+308 1.7E+308 ECU_ADDRESS 0x00236A98 /end MEASUREMENT
/begin MEASUREMENT speedgoat_target_model_2021b_B.extmv_scale "" FLOAT64_IEEE speedgoat_target_model_2021b_CM_double 0 0 -1.7E+308 1.7E+308 ECU_ADDRESS 0x002368A8 /end MEASUREMENT
/begin MEASUREMENT speedgoat_target_model_2021b_B.extmv_scale1 "" FLOAT64_IEEE speedgoat_target_model_2021b_CM_double 0 0 -1.7E+308 1.7E+308 ECU_ADDRESS 0x002368B0 /end MEASUREMENT
/begin MEASUREMENT speedgoat_target_model_2021b_B.iAout "" UBYTE speedgoat_target_model_2021b_CM_logical 0 0 0 1 LAYOUT COLUMN_DIR MATRIX_DIM 34 ECU_ADDRESS 0x00237711 /end MEASUREMENT
/begin MEASUREMENT speedgoat_target_model_2021b_B.last_mv "" FLOAT64_IEEE speedgoat_target_model_2021b_CM_double 0 0 -1.7E+308 1.7E+308 ECU_ADDRESS 0x002368B8 /end MEASUREMENT
/begin MEASUREMENT speedgoat_target_model_2021b_B.last_x "" FLOAT64_IEEE speedgoat_target_model_2021b_CM_double 0 0 -1.7E+308 1.7E+308 LAYOUT COLUMN_DIR MATRIX_DIM 4 ECU_ADDRESS 0x002368C0 /end MEASUREMENT
/begin MEASUREMENT speedgoat_target_model_2021b_B.lead_velocity "" FLOAT64_IEEE speedgoat_target_model_2021b_CM_double 0 0 -1.7E+308 1.7E+308 ECU_ADDRESS 0x002367F8 /end MEASUREMENT
/begin MEASUREMENT speedgoat_target_model_2021b_B.min_velocity "" FLOAT64_IEEE speedgoat_target_model_2021b_CM_double 0 0 -1.7E+308 1.7E+308 LAYOUT COLUMN_DIR MATRIX_DIM 2 ECU_ADDRESS 0x002368F8 /end MEASUREMENT
/begin MEASUREMENT speedgoat_target_model_2021b_B.safe_distance "" FLOAT64_IEEE speedgoat_target_model_2021b_CM_double 0 0 -1.7E+308 1.7E+308 ECU_ADDRESS 0x002367F0 /end MEASUREMENT
/begin MEASUREMENT speedgoat_target_model_2021b_B.set_velocity "" FLOAT64_IEEE speedgoat_target_model_2021b_CM_double 0 0 -1.7E+308 1.7E+308 ECU_ADDRESS 0x00236A40 /end MEASUREMENT
/begin MEASUREMENT speedgoat_target_model_2021b_B.set_velocity1 "" FLOAT64_IEEE speedgoat_target_model_2021b_CM_double 0 0 -1.7E+308 1.7E+308 ECU_ADDRESS 0x00236A30 /end MEASUREMENT
/begin MEASUREMENT speedgoat_target_model_2021b_B.set_velocity_c "" FLOAT64_IEEE speedgoat_target_model_2021b_CM_double 0 0 -1.7E+308 1.7E+308 ECU_ADDRESS 0x00236A88 /end MEASUREMENT
/begin MEASUREMENT speedgoat_target_model_2021b_B.sf_DataTypeConversion_L0.y "" FLOAT64_IEEE speedgoat_target_model_2021b_CM_double 0 0 -1.7E+308 1.7E+308 ECU_ADDRESS 0x00237778 /end MEASUREMENT
/begin MEASUREMENT speedgoat_target_model_2021b_B.sf_DataTypeConversion_amax.y "" FLOAT64_IEEE speedgoat_target_model_2021b_CM_double 0 0 -1.7E+308 1.7E+308 ECU_ADDRESS 0x00237770 /end MEASUREMENT
/begin MEASUREMENT speedgoat_target_model_2021b_B.sf_DataTypeConversion_amin.y "" FLOAT64_IEEE speedgoat_target_model_2021b_CM_double 0 0 -1.7E+308 1.7E+308 ECU_ADDRESS 0x00237768 /end MEASUREMENT
/begin MEASUREMENT speedgoat_target_model_2021b_B.sf_DataTypeConversion_atrack.y "" FLOAT64_IEEE speedgoat_target_model_2021b_CM_double 0 0 -1.7E+308 1.7E+308 ECU_ADDRESS 0x00237760 /end MEASUREMENT
/begin MEASUREMENT speedgoat_target_model_2021b_B.sf_DataTypeConversion_dmin.y "" FLOAT64_IEEE speedgoat_target_model_2021b_CM_double 0 0 -1.7E+308 1.7E+308 ECU_ADDRESS 0x00237758 /end MEASUREMENT
/begin MEASUREMENT speedgoat_target_model_2021b_B.sf_DataTypeConversion_reldist.y "" FLOAT64_IEEE speedgoat_target_model_2021b_CM_double 0 0 -1.7E+308 1.7E+308 ECU_ADDRESS 0x00237750 /end MEASUREMENT
/begin MEASUREMENT speedgoat_target_model_2021b_B.sf_DataTypeConversion_vego.y "" FLOAT64_IEEE speedgoat_target_model_2021b_CM_double 0 0 -1.7E+308 1.7E+308 ECU_ADDRESS 0x00237748 /end MEASUREMENT
/begin MEASUREMENT speedgoat_target_model_2021b_B.sf_DataTypeConversion_vlead.y "" FLOAT64_IEEE speedgoat_target_model_2021b_CM_double 0 0 -1.7E+308 1.7E+308 ECU_ADDRESS 0x00237740 /end MEASUREMENT
/begin MEASUREMENT speedgoat_target_model_2021b_B.sf_DataTypeConversion_vset.y "" FLOAT64_IEEE speedgoat_target_model_2021b_CM_double 0 0 -1.7E+308 1.7E+308 ECU_ADDRESS 0x00237738 /end MEASUREMENT
/begin MEASUREMENT speedgoat_target_model_2021b_B.status "" FLOAT64_IEEE speedgoat_target_model_2021b_CM_double 0 0 -1.7E+308 1.7E+308 ECU_ADDRESS 0x00237310 /end MEASUREMENT
/begin MEASUREMENT speedgoat_target_model_2021b_B.steerCmd "" FLOAT64_IEEE speedgoat_target_model_2021b_CM_double 0 0 -1.7E+308 1.7E+308 ECU_ADDRESS 0x00237018 /end MEASUREMENT
/begin MEASUREMENT speedgoat_target_model_2021b_B.u "" FLOAT64_IEEE speedgoat_target_model_2021b_CM_double 0 0 -1.7E+308 1.7E+308 ECU_ADDRESS 0x00237098 /end MEASUREMENT
/begin MEASUREMENT speedgoat_target_model_2021b_B.umin_scale1 "" FLOAT64_IEEE speedgoat_target_model_2021b_CM_double 0 0 -1.7E+308 1.7E+308 ECU_ADDRESS 0x00236910 /end MEASUREMENT
/begin MEASUREMENT speedgoat_target_model_2021b_B.umin_scale2 "" FLOAT64_IEEE speedgoat_target_model_2021b_CM_double 0 0 -1.7E+308 1.7E+308 ECU_ADDRESS 0x00236A20 /end MEASUREMENT
/begin MEASUREMENT speedgoat_target_model_2021b_B.umin_scale3 "" FLOAT64_IEEE speedgoat_target_model_2021b_CM_double 0 0 -1.7E+308 1.7E+308 LAYOUT COLUMN_DIR MATRIX_DIM 11 ECU_ADDRESS 0x00236918 /end MEASUREMENT
/begin MEASUREMENT speedgoat_target_model_2021b_B.umin_scale4 "" FLOAT64_IEEE speedgoat_target_model_2021b_CM_double 0 0 -1.7E+308 1.7E+308 MATRIX_DIM 1 1 ECU_ADDRESS 0x00236848 /end MEASUREMENT
/begin MEASUREMENT speedgoat_target_model_2021b_B.umin_scale5 "" FLOAT64_IEEE speedgoat_target_model_2021b_CM_double 0 0 -1.7E+308 1.7E+308 LAYOUT COLUMN_DIR MATRIX_DIM 2 11 ECU_ADDRESS 0x00236970 /end MEASUREMENT
/begin MEASUREMENT speedgoat_target_model_2021b_B.useq "" FLOAT64_IEEE speedgoat_target_model_2021b_CM_double 0 0 -1.7E+308 1.7E+308 LAYOUT COLUMN_DIR MATRIX_DIM 11 ECU_ADDRESS 0x002370A8 /end MEASUREMENT
/begin MEASUREMENT speedgoat_target_model_2021b_B.v "" FLOAT64_IEEE speedgoat_target_model_2021b_CM_double 0 0 -1.7E+308 1.7E+308 MATRIX_DIM 1 1 ECU_ADDRESS 0x00236E60 /end MEASUREMENT
/begin MEASUREMENT speedgoat_target_model_2021b_B.v_g "" FLOAT64_IEEE speedgoat_target_model_2021b_CM_double 0 0 -1.7E+308 1.7E+308 MATRIX_DIM 1 1 ECU_ADDRESS 0x00236EA0 /end MEASUREMENT
/begin MEASUREMENT speedgoat_target_model_2021b_B.v_o "" FLOAT64_IEEE speedgoat_target_model_2021b_CM_double 0 0 -1.7E+308 1.7E+308 ECU_ADDRESS 0x00236F20 /end MEASUREMENT
/begin MEASUREMENT speedgoat_target_model_2021b_B.v_p "" FLOAT64_IEEE speedgoat_target_model_2021b_CM_double 0 0 -1.7E+308 1.7E+308 ECU_ADDRESS 0x00236EE0 /end MEASUREMENT
/begin MEASUREMENT speedgoat_target_model_2021b_B.xest "" FLOAT64_IEEE speedgoat_target_model_2021b_CM_double 0 0 -1.7E+308 1.7E+308 LAYOUT COLUMN_DIR MATRIX_DIM 4 ECU_ADDRESS 0x00237318 /end MEASUREMENT
/begin MEASUREMENT speedgoat_target_model_2021b_B.xk1 "" FLOAT64_IEEE speedgoat_target_model_2021b_CM_double 0 0 -1.7E+308 1.7E+308 LAYOUT COLUMN_DIR MATRIX_DIM 4 ECU_ADDRESS 0x00237078 /end MEASUREMENT
/begin MEASUREMENT speedgoat_target_model_2021b_B.xseq "" FLOAT64_IEEE speedgoat_target_model_2021b_CM_double 0 0 -1.7E+308 1.7E+308 LAYOUT COLUMN_DIR MATRIX_DIM 4 11 ECU_ADDRESS 0x00237100 /end MEASUREMENT
/begin MEASUREMENT speedgoat_target_model_2021b_B.y "" FLOAT64_IEEE speedgoat_target_model_2021b_CM_double 0 0 -1.7E+308 1.7E+308 ECU_ADDRESS 0x00237338 /end MEASUREMENT
/begin MEASUREMENT speedgoat_target_model_2021b_B.yawrate "" FLOAT64_IEEE speedgoat_target_model_2021b_CM_double 0 0 -1.7E+308 1.7E+308 ECU_ADDRESS 0x00236B20 /end MEASUREMENT
/begin MEASUREMENT speedgoat_target_model_2021b_B.ym_zero "" FLOAT64_IEEE speedgoat_target_model_2021b_CM_double 0 0 -1.7E+308 1.7E+308 LAYOUT COLUMN_DIR MATRIX_DIM 2 ECU_ADDRESS 0x00236810 /end MEASUREMENT
/begin MEASUREMENT speedgoat_target_model_2021b_B.ymin_scale1 "" FLOAT64_IEEE speedgoat_target_model_2021b_CM_double 0 0 -1.7E+308 1.7E+308 LAYOUT COLUMN_DIR MATRIX_DIM 2 1 ECU_ADDRESS 0x00236858 /end MEASUREMENT
/begin MEASUREMENT speedgoat_target_model_2021b_B.ymin_scale2 "" FLOAT64_IEEE speedgoat_target_model_2021b_CM_double 0 0 -1.7E+308 1.7E+308 MATRIX_DIM 1 1 ECU_ADDRESS 0x00236878 /end MEASUREMENT
/begin MEASUREMENT speedgoat_target_model_2021b_B.yseq "" FLOAT64_IEEE speedgoat_target_model_2021b_CM_double 0 0 -1.7E+308 1.7E+308 LAYOUT COLUMN_DIR MATRIX_DIM 2 11 ECU_ADDRESS 0x00237260 /end MEASUREMENT
/begin MEASUREMENT speedgoat_target_model_2021b_DW.Assertion1_sltestCurrentResult "" SLONG speedgoat_target_model_2021b_CM_int32 0 0 -2147483648 2147483647 ECU_ADDRESS 0x002365AC /end MEASUREMENT
/begin MEASUREMENT speedgoat_target_model_2021b_DW.Assertion1_sltestFinalResult "" SLONG speedgoat_target_model_2021b_CM_int32 0 0 -2147483648 2147483647 ECU_ADDRESS 0x002365A8 /end MEASUREMENT
/begin MEASUREMENT speedgoat_target_model_2021b_DW.Assertion1_sltestLastResultTime "" FLOAT64_IEEE speedgoat_target_model_2021b_CM_double 0 0 -1.7E+308 1.7E+308 ECU_ADDRESS 0x002364F8 /end MEASUREMENT
/begin MEASUREMENT speedgoat_target_model_2021b_DW.Assertion_sltestCurrentResult "" SLONG speedgoat_target_model_2021b_CM_int32 0 0 -2147483648 2147483647 ECU_ADDRESS 0x002365A4 /end MEASUREMENT
/begin MEASUREMENT speedgoat_target_model_2021b_DW.Assertion_sltestFinalResult "" SLONG speedgoat_target_model_2021b_CM_int32 0 0 -2147483648 2147483647 ECU_ADDRESS 0x002365A0 /end MEASUREMENT
/begin MEASUREMENT speedgoat_target_model_2021b_DW.Assertion_sltestLastResultTime "" FLOAT64_IEEE speedgoat_target_model_2021b_CM_double 0 0 -1.7E+308 1.7E+308 ECU_ADDRESS 0x002364F0 /end MEASUREMENT
/begin MEASUREMENT speedgoat_target_model_2021b_DW.ByteUnpackFifthset_SubsysRanBC "" SBYTE speedgoat_target_model_2021b_CM_int8 0 0 -128 127 ECU_ADDRESS 0x002366B8 /end MEASUREMENT
/begin MEASUREMENT speedgoat_target_model_2021b_DW.ByteUnpackFirstset_SubsysRanBC "" SBYTE speedgoat_target_model_2021b_CM_int8 0 0 -128 127 ECU_ADDRESS 0x002366B7 /end MEASUREMENT
/begin MEASUREMENT speedgoat_target_model_2021b_DW.ByteUnpackFourthset_SubsysRanBC "" SBYTE speedgoat_target_model_2021b_CM_int8 0 0 -128 127 ECU_ADDRESS 0x002366B6 /end MEASUREMENT
/begin MEASUREMENT speedgoat_target_model_2021b_DW.ByteUnpackSecondset_SubsysRanBC "" SBYTE speedgoat_target_model_2021b_CM_int8 0 0 -128 127 ECU_ADDRESS 0x002366B5 /end MEASUREMENT
/begin MEASUREMENT speedgoat_target_model_2021b_DW.ByteUnpackThirdset_SubsysRanBC "" SBYTE speedgoat_target_model_2021b_CM_int8 0 0 -128 127 ECU_ADDRESS 0x002366B4 /end MEASUREMENT
/begin MEASUREMENT speedgoat_target_model_2021b_DW.CurrentVelCmd "" FLOAT64_IEEE speedgoat_target_model_2021b_CM_double 0 0 -1.7E+308 1.7E+308 ECU_ADDRESS 0x00236520 /end MEASUREMENT
/begin MEASUREMENT speedgoat_target_model_2021b_DW.DestReached "" FLOAT64_IEEE speedgoat_target_model_2021b_CM_double 0 0 -1.7E+308 1.7E+308 ECU_ADDRESS 0x00236510 /end MEASUREMENT
/begin MEASUREMENT speedgoat_target_model_2021b_DW.DiscreteTimeIntegrator_DSTATE "" FLOAT64_IEEE speedgoat_target_model_2021b_CM_double 0 0 -1.7E+308 1.7E+308 ECU_ADDRESS 0x00236328 /end MEASUREMENT
/begin MEASUREMENT speedgoat_target_model_2021b_DW.DiscreteTimeIntegrator_DSTATE_a "" FLOAT64_IEEE speedgoat_target_model_2021b_CM_double 0 0 -1.7E+308 1.7E+308 ECU_ADDRESS 0x00236330 /end MEASUREMENT
/begin MEASUREMENT speedgoat_target_model_2021b_DW.DiscreteTimeIntegrator_DSTATE_e "" FLOAT64_IEEE speedgoat_target_model_2021b_CM_double 0 0 -1.7E+308 1.7E+308 ECU_ADDRESS 0x00236340 /end MEASUREMENT
/begin MEASUREMENT speedgoat_target_model_2021b_DW.DiscreteTimeIntegrator_DSTATE_f "" FLOAT64_IEEE speedgoat_target_model_2021b_CM_double 0 0 -1.7E+308 1.7E+308 ECU_ADDRESS 0x00236338 /end MEASUREMENT
/begin MEASUREMENT speedgoat_target_model_2021b_DW.DiscreteTimeIntegrator_PrevR_bg "" SBYTE speedgoat_target_model_2021b_CM_int8 0 0 -128 127 ECU_ADDRESS 0x002366BE /end MEASUREMENT
/begin MEASUREMENT speedgoat_target_model_2021b_DW.DiscreteTimeIntegrator_PrevRe_a "" SBYTE speedgoat_target_model_2021b_CM_int8 0 0 -128 127 ECU_ADDRESS 0x002366BB /end MEASUREMENT
/begin MEASUREMENT speedgoat_target_model_2021b_DW.DiscreteTimeIntegrator_PrevRe_b "" SBYTE speedgoat_target_model_2021b_CM_int8 0 0 -128 127 ECU_ADDRESS 0x002366BD /end MEASUREMENT
/begin MEASUREMENT speedgoat_target_model_2021b_DW.DiscreteTimeIntegrator_PrevRese "" SBYTE speedgoat_target_model_2021b_CM_int8 0 0 -128 127 ECU_ADDRESS 0x002366BA /end MEASUREMENT
/begin MEASUREMENT speedgoat_target_model_2021b_DW.ExitFlag "" FLOAT64_IEEE speedgoat_target_model_2021b_CM_double 0 0 -1.7E+308 1.7E+308 ECU_ADDRESS 0x00236518 /end MEASUREMENT
/begin MEASUREMENT speedgoat_target_model_2021b_DW.Forward_SubsysRanBC "" SBYTE speedgoat_target_model_2021b_CM_int8 0 0 -128 127 ECU_ADDRESS 0x002366C1 /end MEASUREMENT
/begin MEASUREMENT speedgoat_target_model_2021b_DW.Integrator_DSTATE "" FLOAT64_IEEE speedgoat_target_model_2021b_CM_double 0 0 -1.7E+308 1.7E+308 ECU_ADDRESS 0x00236348 /end MEASUREMENT
/begin MEASUREMENT speedgoat_target_model_2021b_DW.Integrator_DSTATE_k "" FLOAT64_IEEE speedgoat_target_model_2021b_CM_double 0 0 -1.7E+308 1.7E+308 ECU_ADDRESS 0x00236350 /end MEASUREMENT
/begin MEASUREMENT speedgoat_target_model_2021b_DW.Integrator_PrevResetState "" SBYTE speedgoat_target_model_2021b_CM_int8 0 0 -128 127 ECU_ADDRESS 0x002366C0 /end MEASUREMENT
/begin MEASUREMENT speedgoat_target_model_2021b_DW.Integrator_PrevResetState_j "" SBYTE speedgoat_target_model_2021b_CM_int8 0 0 -128 127 ECU_ADDRESS 0x002366C2 /end MEASUREMENT
/begin MEASUREMENT speedgoat_target_model_2021b_DW.Memory_PreviousInput "" UBYTE speedgoat_target_model_2021b_CM_logical 0 0 0 1 LAYOUT COLUMN_DIR MATRIX_DIM 34 ECU_ADDRESS 0x002366C6 /end MEASUREMENT
/begin MEASUREMENT speedgoat_target_model_2021b_DW.Navi "" FLOAT64_IEEE speedgoat_target_model_2021b_CM_double 0 0 -1.7E+308 1.7E+308 ECU_ADDRESS 0x00236528 /end MEASUREMENT
/begin MEASUREMENT speedgoat_target_model_2021b_DW.Reverse_SubsysRanBC "" SBYTE speedgoat_target_model_2021b_CM_int8 0 0 -128 127 ECU_ADDRESS 0x002366BF /end MEASUREMENT
/begin MEASUREMENT speedgoat_target_model_2021b_DW.Stuck "" FLOAT64_IEEE speedgoat_target_model_2021b_CM_double 0 0 -1.7E+308 1.7E+308 ECU_ADDRESS 0x00236508 /end MEASUREMENT
/begin MEASUREMENT speedgoat_target_model_2021b_DW.Subsystem1_SubsysRanBC "" SBYTE speedgoat_target_model_2021b_CM_int8 0 0 -128 127 ECU_ADDRESS 0x002366B9 /end MEASUREMENT
/begin MEASUREMENT speedgoat_target_model_2021b_DW.Subsystem2_SubsysRanBC "" SBYTE speedgoat_target_model_2021b_CM_int8 0 0 -128 127 ECU_ADDRESS 0x002366BC /end MEASUREMENT
/begin MEASUREMENT speedgoat_target_model_2021b_DW.Subtract_DWORK1 "" FLOAT64_IEEE speedgoat_target_model_2021b_CM_double 0 0 -1.7E+308 1.7E+308 ECU_ADDRESS 0x00236500 /end MEASUREMENT
/begin MEASUREMENT speedgoat_target_model_2021b_DW.TmpRTBAtDataTypeConversion_vs_m "" SBYTE speedgoat_target_model_2021b_CM_int8 0 0 -128 127 ECU_ADDRESS 0x00236699 /end MEASUREMENT
/begin MEASUREMENT speedgoat_target_model_2021b_DW.TmpRTBAtDataTypeConversion_vs_n "" SBYTE speedgoat_target_model_2021b_CM_int8 0 0 -128 127 ECU_ADDRESS 0x00236698 /end MEASUREMENT
/begin MEASUREMENT speedgoat_target_model_2021b_DW.TmpRTBAtDataTypeConversion_vset "" FLOAT64_IEEE speedgoat_target_model_2021b_CM_double 0 0 -1.7E+308 1.7E+308 LAYOUT COLUMN_DIR MATRIX_DIM 2 ECU_ADDRESS 0x002363E8 /end MEASUREMENT
/begin MEASUREMENT speedgoat_target_model_2021b_DW.TmpRTBAtEqual1Inport1_Buf "" FLOAT64_IEEE speedgoat_target_model_2021b_CM_double 0 0 -1.7E+308 1.7E+308 LAYOUT COLUMN_DIR MATRIX_DIM 2 ECU_ADDRESS 0x00236410 /end MEASUREMENT
/begin MEASUREMENT speedgoat_target_model_2021b_DW.TmpRTBAtEqual1Inport1_RdBufIdx "" SBYTE speedgoat_target_model_2021b_CM_int8 0 0 -128 127 ECU_ADDRESS 0x0023669C /end MEASUREMENT
/begin MEASUREMENT speedgoat_target_model_2021b_DW.TmpRTBAtEqual1Inport1_WrBufIdx "" SBYTE speedgoat_target_model_2021b_CM_int8 0 0 -128 127 ECU_ADDRESS 0x0023669D /end MEASUREMENT
/begin MEASUREMENT speedgoat_target_model_2021b_DW.TmpRTBAtEqual2Inport1_Buf "" FLOAT64_IEEE speedgoat_target_model_2021b_CM_double 0 0 -1.7E+308 1.7E+308 LAYOUT COLUMN_DIR MATRIX_DIM 2 ECU_ADDRESS 0x00236420 /end MEASUREMENT
/begin MEASUREMENT speedgoat_target_model_2021b_DW.TmpRTBAtEqual2Inport1_RdBufIdx "" SBYTE speedgoat_target_model_2021b_CM_int8 0 0 -128 127 ECU_ADDRESS 0x0023669E /end MEASUREMENT
/begin MEASUREMENT speedgoat_target_model_2021b_DW.TmpRTBAtEqual2Inport1_WrBufIdx "" SBYTE speedgoat_target_model_2021b_CM_int8 0 0 -128 127 ECU_ADDRESS 0x0023669F /end MEASUREMENT
/begin MEASUREMENT speedgoat_target_model_2021b_DW.TmpRTBAtEqual3Inport1_Buf "" FLOAT64_IEEE speedgoat_target_model_2021b_CM_double 0 0 -1.7E+308 1.7E+308 LAYOUT COLUMN_DIR MATRIX_DIM 2 ECU_ADDRESS 0x00236430 /end MEASUREMENT
/begin MEASUREMENT speedgoat_target_model_2021b_DW.TmpRTBAtEqual3Inport1_RdBufIdx "" SBYTE speedgoat_target_model_2021b_CM_int8 0 0 -128 127 ECU_ADDRESS 0x002366A0 /end MEASUREMENT
/begin MEASUREMENT speedgoat_target_model_2021b_DW.TmpRTBAtEqual3Inport1_WrBufIdx "" SBYTE speedgoat_target_model_2021b_CM_int8 0 0 -128 127 ECU_ADDRESS 0x002366A1 /end MEASUREMENT
/begin MEASUREMENT speedgoat_target_model_2021b_DW.TmpRTBAtEqual4Inport2_Buf "" FLOAT64_IEEE speedgoat_target_model_2021b_CM_double 0 0 -1.7E+308 1.7E+308 LAYOUT COLUMN_DIR MATRIX_DIM 2 ECU_ADDRESS 0x00236440 /end MEASUREMENT
/begin MEASUREMENT speedgoat_target_model_2021b_DW.TmpRTBAtEqual4Inport2_RdBufIdx "" SBYTE speedgoat_target_model_2021b_CM_int8 0 0 -128 127 ECU_ADDRESS 0x002366A2 /end MEASUREMENT
/begin MEASUREMENT speedgoat_target_model_2021b_DW.TmpRTBAtEqual4Inport2_WrBufIdx "" SBYTE speedgoat_target_model_2021b_CM_int8 0 0 -128 127 ECU_ADDRESS 0x002366A3 /end MEASUREMENT
/begin MEASUREMENT speedgoat_target_model_2021b_DW.TmpRTBAtEqual5Inport2_Buf "" FLOAT64_IEEE speedgoat_target_model_2021b_CM_double 0 0 -1.7E+308 1.7E+308 LAYOUT COLUMN_DIR MATRIX_DIM 2 ECU_ADDRESS 0x00236450 /end MEASUREMENT
/begin MEASUREMENT speedgoat_target_model_2021b_DW.TmpRTBAtEqual5Inport2_RdBufIdx "" SBYTE speedgoat_target_model_2021b_CM_int8 0 0 -128 127 ECU_ADDRESS 0x002366A4 /end MEASUREMENT
/begin MEASUREMENT speedgoat_target_model_2021b_DW.TmpRTBAtEqual5Inport2_WrBufIdx "" SBYTE speedgoat_target_model_2021b_CM_int8 0 0 -128 127 ECU_ADDRESS 0x002366A5 /end MEASUREMENT
/begin MEASUREMENT speedgoat_target_model_2021b_DW.TmpRTBAtMinusInport2_Buf "" FLOAT64_IEEE speedgoat_target_model_2021b_CM_double 0 0 -1.7E+308 1.7E+308 LAYOUT COLUMN_DIR MATRIX_DIM 2 ECU_ADDRESS 0x002364B0 /end MEASUREMENT
/begin MEASUREMENT speedgoat_target_model_2021b_DW.TmpRTBAtMinusInport2_RdBufIdx "" SBYTE speedgoat_target_model_2021b_CM_int8 0 0 -128 127 ECU_ADDRESS 0x002366B0 /end MEASUREMENT
/begin MEASUREMENT speedgoat_target_model_2021b_DW.TmpRTBAtMinusInport2_WrBufIdx "" SBYTE speedgoat_target_model_2021b_CM_int8 0 0 -128 127 ECU_ADDRESS 0x002366B1 /end MEASUREMENT
/begin MEASUREMENT speedgoat_target_model_2021b_DW.TmpRTBAtMultiplyInport1_Buf "" FLOAT64_IEEE speedgoat_target_model_2021b_CM_double 0 0 -1.7E+308 1.7E+308 LAYOUT COLUMN_DIR MATRIX_DIM 2 ECU_ADDRESS 0x00236490 /end MEASUREMENT
/begin MEASUREMENT speedgoat_target_model_2021b_DW.TmpRTBAtMultiplyInport1_RdBufId "" SBYTE speedgoat_target_model_2021b_CM_int8 0 0 -128 127 ECU_ADDRESS 0x002366AC /end MEASUREMENT
/begin MEASUREMENT speedgoat_target_model_2021b_DW.TmpRTBAtMultiplyInport1_WrBufId "" SBYTE speedgoat_target_model_2021b_CM_int8 0 0 -128 127 ECU_ADDRESS 0x002366AD /end MEASUREMENT
/begin MEASUREMENT speedgoat_target_model_2021b_DW.TmpRTBAtSign1Inport1_Buf "" FLOAT64_IEEE speedgoat_target_model_2021b_CM_double 0 0 -1.7E+308 1.7E+308 LAYOUT COLUMN_DIR MATRIX_DIM 2 ECU_ADDRESS 0x00236460 /end MEASUREMENT
/begin MEASUREMENT speedgoat_target_model_2021b_DW.TmpRTBAtSign1Inport1_RdBufIdx "" SBYTE speedgoat_target_model_2021b_CM_int8 0 0 -128 127 ECU_ADDRESS 0x002366A6 /end MEASUREMENT
/begin MEASUREMENT speedgoat_target_model_2021b_DW.TmpRTBAtSign1Inport1_WrBufIdx "" SBYTE speedgoat_target_model_2021b_CM_int8 0 0 -128 127 ECU_ADDRESS 0x002366A7 /end MEASUREMENT
/begin MEASUREMENT speedgoat_target_model_2021b_DW.TmpRTBAtSwitch1Outport1_Buf "" FLOAT64_IEEE speedgoat_target_model_2021b_CM_double 0 0 -1.7E+308 1.7E+308 LAYOUT COLUMN_DIR MATRIX_DIM 2 ECU_ADDRESS 0x00236378 /end MEASUREMENT
/begin MEASUREMENT speedgoat_target_model_2021b_DW.TmpRTBAtSwitch1Outport1_RdBufId "" SBYTE speedgoat_target_model_2021b_CM_int8 0 0 -128 127 ECU_ADDRESS 0x00236690 /end MEASUREMENT
/begin MEASUREMENT speedgoat_target_model_2021b_DW.TmpRTBAtSwitch1Outport1_WrBufId "" SBYTE speedgoat_target_model_2021b_CM_int8 0 0 -128 127 ECU_ADDRESS 0x00236691 /end MEASUREMENT
/begin MEASUREMENT speedgoat_target_model_2021b_DW.TmpRTBAtSwitchCaseInport1_Buf "" FLOAT64_IEEE speedgoat_target_model_2021b_CM_double 0 0 -1.7E+308 1.7E+308 LAYOUT COLUMN_DIR MATRIX_DIM 2 ECU_ADDRESS 0x002364A0 /end MEASUREMENT
/begin MEASUREMENT speedgoat_target_model_2021b_DW.TmpRTBAtSwitchCaseInport1_RdBuf "" SBYTE speedgoat_target_model_2021b_CM_int8 0 0 -128 127 ECU_ADDRESS 0x002366AE /end MEASUREMENT
/begin MEASUREMENT speedgoat_target_model_2021b_DW.TmpRTBAtSwitchCaseInport1_WrBuf "" SBYTE speedgoat_target_model_2021b_CM_int8 0 0 -128 127 ECU_ADDRESS 0x002366AF /end MEASUREMENT
/begin MEASUREMENT speedgoat_target_model_2021b_DW.TmpRTBAtSwitchOutport1_Buf "" FLOAT64_IEEE speedgoat_target_model_2021b_CM_double 0 0 -1.7E+308 1.7E+308 LAYOUT COLUMN_DIR MATRIX_DIM 2 ECU_ADDRESS 0x00236368 /end MEASUREMENT
/begin MEASUREMENT speedgoat_target_model_2021b_DW.TmpRTBAtSwitchOutport1_RdBufIdx "" SBYTE speedgoat_target_model_2021b_CM_int8 0 0 -128 127 ECU_ADDRESS 0x0023668E /end MEASUREMENT
/begin MEASUREMENT speedgoat_target_model_2021b_DW.TmpRTBAtSwitchOutport1_WrBufIdx "" SBYTE speedgoat_target_model_2021b_CM_int8 0 0 -128 127 ECU_ADDRESS 0x0023668F /end MEASUREMENT
/begin MEASUREMENT speedgoat_target_model_2021b_DW.TmpRTBAtoptimizerInport3_Buf "" FLOAT64_IEEE speedgoat_target_model_2021b_CM_double 0 0 -1.7E+308 1.7E+308 LAYOUT COLUMN_DIR MATRIX_DIM 4 ECU_ADDRESS 0x00236388 /end MEASUREMENT
/begin MEASUREMENT speedgoat_target_model_2021b_DW.TmpRTBAtoptimizerInport3_RdBufI "" SBYTE speedgoat_target_model_2021b_CM_int8 0 0 -128 127 ECU_ADDRESS 0x00236692 /end MEASUREMENT
/begin MEASUREMENT speedgoat_target_model_2021b_DW.TmpRTBAtoptimizerInport3_WrBufI "" SBYTE speedgoat_target_model_2021b_CM_int8 0 0 -128 127 ECU_ADDRESS 0x00236693 /end MEASUREMENT
/begin MEASUREMENT speedgoat_target_model_2021b_DW.TmpRTBAtoptimizerInport5_Buf "" FLOAT64_IEEE speedgoat_target_model_2021b_CM_double 0 0 -1.7E+308 1.7E+308 LAYOUT COLUMN_DIR MATRIX_DIM 2 ECU_ADDRESS 0x002363A8 /end MEASUREMENT
/begin MEASUREMENT speedgoat_target_model_2021b_DW.TmpRTBAtoptimizerInport5_RdBufI "" SBYTE speedgoat_target_model_2021b_CM_int8 0 0 -128 127 ECU_ADDRESS 0x00236694 /end MEASUREMENT
/begin MEASUREMENT speedgoat_target_model_2021b_DW.TmpRTBAtoptimizerInport5_WrBufI "" SBYTE speedgoat_target_model_2021b_CM_int8 0 0 -128 127 ECU_ADDRESS 0x00236695 /end MEASUREMENT
/begin MEASUREMENT speedgoat_target_model_2021b_DW.UnitDelay_DSTATE "" FLOAT64_IEEE speedgoat_target_model_2021b_CM_double 0 0 -1.7E+308 1.7E+308 ECU_ADDRESS 0x00236310 /end MEASUREMENT
/begin MEASUREMENT speedgoat_target_model_2021b_DW.UnitDelay_DSTATE_o "" FLOAT64_IEEE speedgoat_target_model_2021b_CM_double 0 0 -1.7E+308 1.7E+308 ECU_ADDRESS 0x00236318 /end MEASUREMENT
/begin MEASUREMENT speedgoat_target_model_2021b_DW.acceleration_Buf "" FLOAT64_IEEE speedgoat_target_model_2021b_CM_double 0 0 -1.7E+308 1.7E+308 LAYOUT COLUMN_DIR MATRIX_DIM 2 ECU_ADDRESS 0x00236358 /end MEASUREMENT
/begin MEASUREMENT speedgoat_target_model_2021b_DW.acceleration_RdBufIdx "" SBYTE speedgoat_target_model_2021b_CM_int8 0 0 -128 127 ECU_ADDRESS 0x0023668C /end MEASUREMENT
/begin MEASUREMENT speedgoat_target_model_2021b_DW.acceleration_WrBufIdx "" SBYTE speedgoat_target_model_2021b_CM_int8 0 0 -128 127 ECU_ADDRESS 0x0023668D /end MEASUREMENT
/begin MEASUREMENT speedgoat_target_model_2021b_DW.default_spacing_Buf0 "" FLOAT64_IEEE speedgoat_target_model_2021b_CM_double 0 0 -1.7E+308 1.7E+308 ECU_ADDRESS 0x002363F8 /end MEASUREMENT
/begin MEASUREMENT speedgoat_target_model_2021b_DW.default_spacing_Buf1 "" FLOAT64_IEEE speedgoat_target_model_2021b_CM_double 0 0 -1.7E+308 1.7E+308 ECU_ADDRESS 0x00236400 /end MEASUREMENT
/begin MEASUREMENT speedgoat_target_model_2021b_DW.default_spacing_Buf2 "" FLOAT64_IEEE speedgoat_target_model_2021b_CM_double 0 0 -1.7E+308 1.7E+308 ECU_ADDRESS 0x00236408 /end MEASUREMENT
/begin MEASUREMENT speedgoat_target_model_2021b_DW.default_spacing_LstBufWR "" SBYTE speedgoat_target_model_2021b_CM_int8 0 0 -128 127 ECU_ADDRESS 0x0023669A /end MEASUREMENT
/begin MEASUREMENT speedgoat_target_model_2021b_DW.default_spacing_RDBuf "" SBYTE speedgoat_target_model_2021b_CM_int8 0 0 -128 127 ECU_ADDRESS 0x0023669B /end MEASUREMENT
/begin MEASUREMENT speedgoat_target_model_2021b_DW.is_Navigation "" ULONG speedgoat_target_model_2021b_CM_uint32 0 0 0 2147483646 ECU_ADDRESS 0x002365C4 /end MEASUREMENT
/begin MEASUREMENT speedgoat_target_model_2021b_DW.is_RailCrossing "" ULONG speedgoat_target_model_2021b_CM_uint32 0 0 0 2147483646 ECU_ADDRESS 0x002365C8 /end MEASUREMENT
/begin MEASUREMENT speedgoat_target_model_2021b_DW.is_RoundAbout "" ULONG speedgoat_target_model_2021b_CM_uint32 0 0 0 2147483646 ECU_ADDRESS 0x002365CC /end MEASUREMENT
/begin MEASUREMENT speedgoat_target_model_2021b_DW.is_StopSign "" ULONG speedgoat_target_model_2021b_CM_uint32 0 0 0 2147483646 ECU_ADDRESS 0x002365D4 /end MEASUREMENT
/begin MEASUREMENT speedgoat_target_model_2021b_DW.is_TrafficLight "" ULONG speedgoat_target_model_2021b_CM_uint32 0 0 0 2147483646 ECU_ADDRESS 0x002365D0 /end MEASUREMENT
/begin MEASUREMENT speedgoat_target_model_2021b_DW.is_active_c21_speedgoat_target_ "" UBYTE speedgoat_target_model_2021b_CM_uint8 0 0 0 255 ECU_ADDRESS 0x002366C4 /end MEASUREMENT
/begin MEASUREMENT speedgoat_target_model_2021b_DW.is_active_c9_speedgoat_target_m "" UBYTE speedgoat_target_model_2021b_CM_uint8 0 0 0 255 ECU_ADDRESS 0x002366C3 /end MEASUREMENT
/begin MEASUREMENT speedgoat_target_model_2021b_DW.is_c21_speedgoat_target_model_2 "" ULONG speedgoat_target_model_2021b_CM_uint32 0 0 0 2147483646 ECU_ADDRESS 0x002365C0 /end MEASUREMENT
/begin MEASUREMENT speedgoat_target_model_2021b_DW.is_c9_speedgoat_target_model_20 "" ULONG speedgoat_target_model_2021b_CM_uint32 0 0 0 2147483646 ECU_ADDRESS 0x002365B8 /end MEASUREMENT
/begin MEASUREMENT speedgoat_target_model_2021b_DW.last_mv_DSTATE "" FLOAT64_IEEE speedgoat_target_model_2021b_CM_double 0 0 -1.7E+308 1.7E+308 ECU_ADDRESS 0x00236320 /end MEASUREMENT
/begin MEASUREMENT speedgoat_target_model_2021b_DW.last_x_PreviousInput "" FLOAT64_IEEE speedgoat_target_model_2021b_CM_double 0 0 -1.7E+308 1.7E+308 LAYOUT COLUMN_DIR MATRIX_DIM 4 ECU_ADDRESS 0x002364D0 /end MEASUREMENT
/begin MEASUREMENT speedgoat_target_model_2021b_DW.min_velocity_Buf0 "" FLOAT64_IEEE speedgoat_target_model_2021b_CM_double 0 0 -1.7E+308 1.7E+308 LAYOUT COLUMN_DIR MATRIX_DIM 2 ECU_ADDRESS 0x002363B8 /end MEASUREMENT
/begin MEASUREMENT speedgoat_target_model_2021b_DW.min_velocity_Buf1 "" FLOAT64_IEEE speedgoat_target_model_2021b_CM_double 0 0 -1.7E+308 1.7E+308 LAYOUT COLUMN_DIR MATRIX_DIM 2 ECU_ADDRESS 0x002363C8 /end MEASUREMENT
/begin MEASUREMENT speedgoat_target_model_2021b_DW.min_velocity_Buf2 "" FLOAT64_IEEE speedgoat_target_model_2021b_CM_double 0 0 -1.7E+308 1.7E+308 LAYOUT COLUMN_DIR MATRIX_DIM 2 ECU_ADDRESS 0x002363D8 /end MEASUREMENT
/begin MEASUREMENT speedgoat_target_model_2021b_DW.min_velocity_LstBufWR "" SBYTE speedgoat_target_model_2021b_CM_int8 0 0 -128 127 ECU_ADDRESS 0x00236696 /end MEASUREMENT
/begin MEASUREMENT speedgoat_target_model_2021b_DW.min_velocity_RDBuf "" SBYTE speedgoat_target_model_2021b_CM_int8 0 0 -128 127 ECU_ADDRESS 0x00236697 /end MEASUREMENT
/begin MEASUREMENT speedgoat_target_model_2021b_DW.set_velocity1_Buf "" FLOAT64_IEEE speedgoat_target_model_2021b_CM_double 0 0 -1.7E+308 1.7E+308 LAYOUT COLUMN_DIR MATRIX_DIM 2 ECU_ADDRESS 0x00236480 /end MEASUREMENT
/begin MEASUREMENT speedgoat_target_model_2021b_DW.set_velocity1_RdBufIdx "" SBYTE speedgoat_target_model_2021b_CM_int8 0 0 -128 127 ECU_ADDRESS 0x002366AA /end MEASUREMENT
/begin MEASUREMENT speedgoat_target_model_2021b_DW.set_velocity1_WrBufIdx "" SBYTE speedgoat_target_model_2021b_CM_int8 0 0 -128 127 ECU_ADDRESS 0x002366AB /end MEASUREMENT
/begin MEASUREMENT speedgoat_target_model_2021b_DW.set_velocity_Buf "" FLOAT64_IEEE speedgoat_target_model_2021b_CM_double 0 0 -1.7E+308 1.7E+308 LAYOUT COLUMN_DIR MATRIX_DIM 2 ECU_ADDRESS 0x00236470 /end MEASUREMENT
/begin MEASUREMENT speedgoat_target_model_2021b_DW.set_velocity_Buf_n "" FLOAT64_IEEE speedgoat_target_model_2021b_CM_double 0 0 -1.7E+308 1.7E+308 LAYOUT COLUMN_DIR MATRIX_DIM 2 ECU_ADDRESS 0x002364C0 /end MEASUREMENT
/begin MEASUREMENT speedgoat_target_model_2021b_DW.set_velocity_RdBufIdx "" SBYTE speedgoat_target_model_2021b_CM_int8 0 0 -128 127 ECU_ADDRESS 0x002366A8 /end MEASUREMENT
/begin MEASUREMENT speedgoat_target_model_2021b_DW.set_velocity_RdBufIdx_p "" SBYTE speedgoat_target_model_2021b_CM_int8 0 0 -128 127 ECU_ADDRESS 0x002366B2 /end MEASUREMENT
/begin MEASUREMENT speedgoat_target_model_2021b_DW.set_velocity_WrBufIdx "" SBYTE speedgoat_target_model_2021b_CM_int8 0 0 -128 127 ECU_ADDRESS 0x002366A9 /end MEASUREMENT
/begin MEASUREMENT speedgoat_target_model_2021b_DW.set_velocity_WrBufIdx_k "" SBYTE speedgoat_target_model_2021b_CM_int8 0 0 -128 127 ECU_ADDRESS 0x002366B3 /end MEASUREMENT
/begin MEASUREMENT speedgoat_target_model_2021b_DW.sfEvent "" SLONG speedgoat_target_model_2021b_CM_int32 0 0 -2147483648 2147483647 ECU_ADDRESS 0x002365B0 /end MEASUREMENT
/begin MEASUREMENT speedgoat_target_model_2021b_DW.sfEvent_o "" SLONG speedgoat_target_model_2021b_CM_int32 0 0 -2147483648 2147483647 ECU_ADDRESS 0x002365B4 /end MEASUREMENT
/begin MEASUREMENT speedgoat_target_model_2021b_DW.temporalCounter_i1 "" ULONG speedgoat_target_model_2021b_CM_uint32 0 0 0 2147483646 ECU_ADDRESS 0x002365BC /end MEASUREMENT
/begin MEASUREMENT speedgoat_target_model_2021b_DW.temporalCounter_i1_i "" UBYTE speedgoat_target_model_2021b_CM_uint8 0 0 0 255 ECU_ADDRESS 0x002366C5 /end MEASUREMENT
/begin COMPU_METHOD speedgoat_target_model_2021b_CM_double "" IDENTICAL "%15.10" "" /end COMPU_METHOD
/begin COMPU_METHOD speedgoat_target_model_2021b_CM_int16 "" IDENTICAL "%5.0" "" /end COMPU_METHOD
/begin COMPU_METHOD speedgoat_target_model_2021b_CM_int32 "" IDENTICAL "%10.0" "" /end COMPU_METHOD
/begin COMPU_METHOD speedgoat_target_model_2021b_CM_int8 "" IDENTICAL "%3.0" "" /end COMPU_METHOD
/begin COMPU_METHOD speedgoat_target_model_2021b_CM_logical "" IDENTICAL "%1.0" "" /end COMPU_METHOD
/begin COMPU_METHOD speedgoat_target_model_2021b_CM_uint16 "" IDENTICAL "%5.0" "" /end COMPU_METHOD
/begin COMPU_METHOD speedgoat_target_model_2021b_CM_uint32 "" IDENTICAL "%10.0" "" /end COMPU_METHOD
/begin COMPU_METHOD speedgoat_target_model_2021b_CM_uint8 "" IDENTICAL "%3.0" "" /end COMPU_METHOD
/begin RECORD_LAYOUT Scalar_BOOLEAN FNC_VALUES 1 UBYTE COLUMN_DIR DIRECT /end RECORD_LAYOUT
/begin RECORD_LAYOUT Scalar_FLOAT64_IEEE FNC_VALUES 1 FLOAT64_IEEE COLUMN_DIR DIRECT /end RECORD_LAYOUT
/begin RECORD_LAYOUT Scalar_SBYTE FNC_VALUES 1 SBYTE COLUMN_DIR DIRECT /end RECORD_LAYOUT
/begin RECORD_LAYOUT Scalar_SLONG FNC_VALUES 1 SLONG COLUMN_DIR DIRECT /end RECORD_LAYOUT
/begin RECORD_LAYOUT Scalar_SWORD FNC_VALUES 1 SWORD COLUMN_DIR DIRECT /end RECORD_LAYOUT
/begin RECORD_LAYOUT Scalar_UBYTE FNC_VALUES 1 UBYTE COLUMN_DIR DIRECT /end RECORD_LAYOUT
/begin RECORD_LAYOUT Scalar_ULONG FNC_VALUES 1 ULONG COLUMN_DIR DIRECT /end RECORD_LAYOUT
/begin RECORD_LAYOUT Scalar_UWORD FNC_VALUES 1 UWORD COLUMN_DIR DIRECT /end RECORD_LAYOUT
/begin GROUP speedgoat_target_model_2021b "speedgoat_target_model_2021b" ROOT
 /begin SUB_GROUP speedgoat_target_model_2021b_Planning_and_Control speedgoat_target_model_2021b_UDP_Data_Receive speedgoat_target_model_2021b_UDP_Data_Send /end SUB_GROUP
/end GROUP
/begin GROUP speedgoat_target_model_2021b_Planning_and_Control "speedgoat_target_model_2021b/Planning and Control"
 /begin SUB_GROUP speedgoat_target_model_2021b_Planning_and_Control_ACC_system speedgoat_target_model_2021b_Planning_and_Control_Lateral_Controller_Stanley speedgoat_target_model_2021b_Planning_and_Control_Longitudinal_Controller_Stanley speedgoat_target_model_2021b_Planning_and_Control_Subsystem3 /end SUB_GROUP
 /begin REF_CHARACTERISTIC speedgoat_target_model_cal_impl.ApproachingSpeed_Value speedgoat_target_model_cal_impl.Clear2Go_Value speedgoat_target_model_cal_impl.Constant1_Value_i4 speedgoat_target_model_cal_impl.Constant_Value_kp speedgoat_target_model_cal_impl.Gain_Gain_k speedgoat_target_model_cal_impl.LaneAvailable_Value speedgoat_target_model_cal_impl.LaneChanged_Value speedgoat_target_model_cal_impl.MinSpeed_Value speedgoat_target_model_cal_impl.NavigatingFlag_Value speedgoat_target_model_cal_impl.RRCrossing_Value speedgoat_target_model_cal_impl.RoadSpeed_Value speedgoat_target_model_cal_impl.SceneSpeed_Value speedgoat_target_model_cal_impl.UnitDelay_InitialCondition_j speedgoat_target_model_cal_impl.WaitTime_Value speedgoat_target_model_cal_impl.reset_Value /end REF_CHARACTERISTIC
 /begin REF_MEASUREMENT speedgoat_target_model_2021b_B.ACC speedgoat_target_model_2021b_B.ACC_i speedgoat_target_model_2021b_B.ApproachingSpeed speedgoat_target_model_2021b_B.Clear2Go speedgoat_target_model_2021b_B.Constant1 speedgoat_target_model_2021b_B.CurrPoses speedgoat_target_model_2021b_B.Curvature speedgoat_target_model_2021b_B.D2D speedgoat_target_model_2021b_B.D2S speedgoat_target_model_2021b_B.Gain_d speedgoat_target_model_2021b_B.LaneAvailable speedgoat_target_model_2021b_B.LaneChangeCmd speedgoat_target_model_2021b_B.LaneChanged speedgoat_target_model_2021b_B.Longitudinalvelocity speedgoat_target_model_2021b_B.MinSpeed speedgoat_target_model_2021b_B.NavigatingFlag speedgoat_target_model_2021b_B.OR speedgoat_target_model_2021b_B.ObjAhead speedgoat_target_model_2021b_B.ObjectDist speedgoat_target_model_2021b_B.RRCrossing speedgoat_target_model_2021b_B.RefVelCmd speedgoat_target_model_2021b_B.RoadSpeed speedgoat_target_model_2021b_B.Saturation speedgoat_target_model_2021b_B.SceneID speedgoat_target_model_2021b_B.SceneSpeed speedgoat_target_model_2021b_B.StopSim speedgoat_target_model_2021b_B.TLstate speedgoat_target_model_2021b_B.Tgap speedgoat_target_model_2021b_B.Trans speedgoat_target_model_2021b_B.UnitDelay_n speedgoat_target_model_2021b_B.VelCmd speedgoat_target_model_2021b_B.WaitTime speedgoat_target_model_2021b_B.yawrate speedgoat_target_model_2021b_DW.CurrentVelCmd speedgoat_target_model_2021b_DW.DestReached speedgoat_target_model_2021b_DW.ExitFlag speedgoat_target_model_2021b_DW.Navi speedgoat_target_model_2021b_DW.Stuck speedgoat_target_model_2021b_DW.UnitDelay_DSTATE_o speedgoat_target_model_2021b_DW.is_Navigation speedgoat_target_model_2021b_DW.is_RailCrossing speedgoat_target_model_2021b_DW.is_RoundAbout speedgoat_target_model_2021b_DW.is_StopSign speedgoat_target_model_2021b_DW.is_TrafficLight speedgoat_target_model_2021b_DW.is_active_c21_speedgoat_target_ speedgoat_target_model_2021b_DW.is_active_c9_speedgoat_target_m speedgoat_target_model_2021b_DW.is_c21_speedgoat_target_model_2 speedgoat_target_model_2021b_DW.is_c9_speedgoat_target_model_20 speedgoat_target_model_2021b_DW.sfEvent speedgoat_target_model_2021b_DW.sfEvent_o speedgoat_target_model_2021b_DW.temporalCounter_i1 speedgoat_target_model_2021b_DW.temporalCounter_i1_i /end REF_MEASUREMENT
/end GROUP
/begin GROUP speedgoat_target_model_2021b_Planning_and_Control_ACC_system "speedgoat_target_model_2021b/Planning and Control/ACC system"
 /begin SUB_GROUP speedgoat_target_model_2021b_Planning_and_Control_ACC_system_MPC /end SUB_GROUP
 /begin REF_CHARACTERISTIC speedgoat_target_model_cal_impl.ACCsystem_DefaultSpacing speedgoat_target_model_cal_impl.ACCsystem_MaxAcceleration speedgoat_target_model_cal_impl.ACCsystem_MaxVelocity speedgoat_target_model_cal_impl.ACCsystem_MinAcceleration speedgoat_target_model_cal_impl.Enableoptimizationconstant_Valu speedgoat_target_model_cal_impl.Externalcontrolsignalconstant_V speedgoat_target_model_cal_impl.Minimumvelocityconstant_Value speedgoat_target_model_cal_impl.Unconstrained_Value /end REF_CHARACTERISTIC
 /begin REF_MEASUREMENT speedgoat_target_model_2021b_B.Longitudinalvelocity speedgoat_target_model_2021b_B.Product2 speedgoat_target_model_2021b_B.RefVelCmd speedgoat_target_model_2021b_B.Relativedistance speedgoat_target_model_2021b_B.Relativevelocity speedgoat_target_model_2021b_B.Tgap speedgoat_target_model_2021b_B.default_spacing speedgoat_target_model_2021b_B.lead_velocity speedgoat_target_model_2021b_B.safe_distance speedgoat_target_model_2021b_B.y /end REF_MEASUREMENT
/end GROUP
/begin GROUP speedgoat_target_model_2021b_Planning_and_Control_ACC_system_MPC "speedgoat_target_model_2021b/Planning and Control/ACC system/MPC"
 /begin SUB_GROUP speedgoat_target_model_2021b_Planning_and_Control_ACC_system_MPC_MPC /end SUB_GROUP
 /begin REF_CHARACTERISTIC speedgoat_target_model_cal_impl.E_zero_Value speedgoat_target_model_cal_impl.F_zero_Value speedgoat_target_model_cal_impl.G_zero_Value speedgoat_target_model_cal_impl.S_zero_Value speedgoat_target_model_cal_impl.duwt_zero_Value speedgoat_target_model_cal_impl.ecrwt_zero_Value speedgoat_target_model_cal_impl.extmv_zero_Value speedgoat_target_model_cal_impl.m_zero_Value speedgoat_target_model_cal_impl.mvtarget_zero_Value speedgoat_target_model_cal_impl.p_zero_Value speedgoat_target_model_cal_impl.uwt_zero_Value speedgoat_target_model_cal_impl.ywt_zero_Value /end REF_CHARACTERISTIC
/end GROUP
/begin GROUP speedgoat_target_model_2021b_Planning_and_Control_ACC_system_MPC_MPC "speedgoat_target_model_2021b/Planning and Control/ACC system/MPC/MPC"
 /begin SUB_GROUP speedgoat_target_model_2021b_Planning_and_Control_ACC_system_MPC_MPC_MPC_Matrix_Signal_Check speedgoat_target_model_2021b_Planning_and_Control_ACC_system_MPC_MPC_MPC_Matrix_Signal_Check1 speedgoat_target_model_2021b_Planning_and_Control_ACC_system_MPC_MPC_MPC_Matrix_Signal_Check2 speedgoat_target_model_2021b_Planning_and_Control_ACC_system_MPC_MPC_MPC_Preview_Signal_Check speedgoat_target_model_2021b_Planning_and_Control_ACC_system_MPC_MPC_MPC_Preview_Signal_Check1 speedgoat_target_model_2021b_Planning_and_Control_ACC_system_MPC_MPC_MPC_Preview_Signal_Check2 speedgoat_target_model_2021b_Planning_and_Control_ACC_system_MPC_MPC_MPC_Preview_Signal_Check3 speedgoat_target_model_2021b_Planning_and_Control_ACC_system_MPC_MPC_MPC_Preview_Signal_Check4 speedgoat_target_model_2021b_Planning_and_Control_ACC_system_MPC_MPC_MPC_Preview_Signal_Check5 speedgoat_target_model_2021b_Planning_and_Control_ACC_system_MPC_MPC_MPC_Preview_Signal_Check6 speedgoat_target_model_2021b_Planning_and_Control_ACC_system_MPC_MPC_MPC_Preview_Signal_Check7 speedgoat_target_model_2021b_Planning_and_Control_ACC_system_MPC_MPC_MPC_Preview_Signal_Check8 speedgoat_target_model_2021b_Planning_and_Control_ACC_system_MPC_MPC_MPC_Scalar_Signal_Check speedgoat_target_model_2021b_Planning_and_Control_ACC_system_MPC_MPC_MPC_Scalar_Signal_Check1 speedgoat_target_model_2021b_Planning_and_Control_ACC_system_MPC_MPC_MPC_Scalar_Signal_Check2 speedgoat_target_model_2021b_Planning_and_Control_ACC_system_MPC_MPC_MPC_Vector_Signal_Check speedgoat_target_model_2021b_Planning_and_Control_ACC_system_MPC_MPC_MPC_Vector_Signal_Check1 speedgoat_target_model_2021b_Planning_and_Control_ACC_system_MPC_MPC_MPC_Vector_Signal_Check6 speedgoat_target_model_2021b_Planning_and_Control_ACC_system_MPC_MPC_moorx /end SUB_GROUP
 /begin REF_CHARACTERISTIC speedgoat_target_model_cal_impl.Memory_InitialCondition speedgoat_target_model_cal_impl.constant_Value speedgoat_target_model_cal_impl.extmv_scale1_Gain speedgoat_target_model_cal_impl.extmv_scale_Gain speedgoat_target_model_cal_impl.last_mv_InitialCondition speedgoat_target_model_cal_impl.last_x_InitialCondition speedgoat_target_model_cal_impl.umin_scale1_Gain speedgoat_target_model_cal_impl.umin_scale2_Gain speedgoat_target_model_cal_impl.umin_scale3_Gain speedgoat_target_model_cal_impl.umin_scale4_Gain speedgoat_target_model_cal_impl.umin_scale5_Gain speedgoat_target_model_cal_impl.ym_zero_Value speedgoat_target_model_cal_impl.ymin_scale1_Gain speedgoat_target_model_cal_impl.ymin_scale2_Gain /end REF_CHARACTERISTIC
 /begin REF_MEASUREMENT speedgoat_target_model_2021b_B.Floor speedgoat_target_model_2021b_B.Floor1 speedgoat_target_model_2021b_B.MathFunction speedgoat_target_model_2021b_B.MathFunction1 speedgoat_target_model_2021b_B.MathFunction2 speedgoat_target_model_2021b_B.Memory speedgoat_target_model_2021b_B.Reshape speedgoat_target_model_2021b_B.Reshape1 speedgoat_target_model_2021b_B.Reshape2 speedgoat_target_model_2021b_B.Reshape3 speedgoat_target_model_2021b_B.Reshape4 speedgoat_target_model_2021b_B.Reshape5 speedgoat_target_model_2021b_B.extmv_scale speedgoat_target_model_2021b_B.extmv_scale1 speedgoat_target_model_2021b_B.iAout speedgoat_target_model_2021b_B.last_mv speedgoat_target_model_2021b_B.last_x speedgoat_target_model_2021b_B.u speedgoat_target_model_2021b_B.umin_scale1 speedgoat_target_model_2021b_B.umin_scale2 speedgoat_target_model_2021b_B.umin_scale3 speedgoat_target_model_2021b_B.umin_scale4 speedgoat_target_model_2021b_B.umin_scale5 speedgoat_target_model_2021b_B.useq speedgoat_target_model_2021b_B.xk1 speedgoat_target_model_2021b_B.ym_zero speedgoat_target_model_2021b_B.ymin_scale1 speedgoat_target_model_2021b_B.ymin_scale2 speedgoat_target_model_2021b_B.yseq speedgoat_target_model_2021b_DW.Memory_PreviousInput speedgoat_target_model_2021b_DW.last_mv_DSTATE speedgoat_target_model_2021b_DW.last_x_PreviousInput /end REF_MEASUREMENT
/end GROUP
/begin GROUP speedgoat_target_model_2021b_Planning_and_Control_ACC_system_MPC_MPC_MPC_Matrix_Signal_Check "speedgoat_target_model_2021b/Planning and Control/ACC system/MPC/MPC/MPC Matrix Signal Check"
 /begin REF_CHARACTERISTIC speedgoat_target_model_cal_impl.MatrixDimensionCheck_P1_p speedgoat_target_model_cal_impl.MatrixDimensionCheck_P2_c speedgoat_target_model_cal_impl.MatrixDimensionCheck_P3_d speedgoat_target_model_cal_impl.MatrixDimensionCheck_P4_e speedgoat_target_model_cal_impl.MatrixDimensionCheck_P5 speedgoat_target_model_cal_impl.MatrixDimensionCheck_P6 /end REF_CHARACTERISTIC
/end GROUP
/begin GROUP speedgoat_target_model_2021b_Planning_and_Control_ACC_system_MPC_MPC_MPC_Matrix_Signal_Check1 "speedgoat_target_model_2021b/Planning and Control/ACC system/MPC/MPC/MPC Matrix Signal Check1"
 /begin REF_CHARACTERISTIC speedgoat_target_model_cal_impl.MatrixDimensionCheck_P1_c speedgoat_target_model_cal_impl.MatrixDimensionCheck_P2_i speedgoat_target_model_cal_impl.MatrixDimensionCheck_P3_n speedgoat_target_model_cal_impl.MatrixDimensionCheck_P4_p speedgoat_target_model_cal_impl.MatrixDimensionCheck_P5_m speedgoat_target_model_cal_impl.MatrixDimensionCheck_P6_d /end REF_CHARACTERISTIC
/end GROUP
/begin GROUP speedgoat_target_model_2021b_Planning_and_Control_ACC_system_MPC_MPC_MPC_Matrix_Signal_Check2 "speedgoat_target_model_2021b/Planning and Control/ACC system/MPC/MPC/MPC Matrix Signal Check2"
 /begin REF_CHARACTERISTIC speedgoat_target_model_cal_impl.MatrixDimensionCheck_P1_i speedgoat_target_model_cal_impl.MatrixDimensionCheck_P2_e speedgoat_target_model_cal_impl.MatrixDimensionCheck_P3_m speedgoat_target_model_cal_impl.MatrixDimensionCheck_P4_ms speedgoat_target_model_cal_impl.MatrixDimensionCheck_P5_h speedgoat_target_model_cal_impl.MatrixDimensionCheck_P6_l /end REF_CHARACTERISTIC
/end GROUP
/begin GROUP speedgoat_target_model_2021b_Planning_and_Control_ACC_system_MPC_MPC_MPC_Preview_Signal_Check "speedgoat_target_model_2021b/Planning and Control/ACC system/MPC/MPC/MPC Preview Signal Check"
 /begin REF_CHARACTERISTIC speedgoat_target_model_cal_impl.MatrixDimensionCheck_P1_cd speedgoat_target_model_cal_impl.MatrixDimensionCheck_P2_k speedgoat_target_model_cal_impl.MatrixDimensionCheck_P3_l speedgoat_target_model_cal_impl.MatrixDimensionCheck_P4_k /end REF_CHARACTERISTIC
/end GROUP
/begin GROUP speedgoat_target_model_2021b_Planning_and_Control_ACC_system_MPC_MPC_MPC_Preview_Signal_Check1 "speedgoat_target_model_2021b/Planning and Control/ACC system/MPC/MPC/MPC Preview Signal Check1"
 /begin REF_CHARACTERISTIC speedgoat_target_model_cal_impl.MatrixDimensionCheck_P1 speedgoat_target_model_cal_impl.MatrixDimensionCheck_P2 speedgoat_target_model_cal_impl.MatrixDimensionCheck_P3 speedgoat_target_model_cal_impl.MatrixDimensionCheck_P4 /end REF_CHARACTERISTIC
/end GROUP
/begin GROUP speedgoat_target_model_2021b_Planning_and_Control_ACC_system_MPC_MPC_MPC_Preview_Signal_Check2 "speedgoat_target_model_2021b/Planning and Control/ACC system/MPC/MPC/MPC Preview Signal Check2"
 /begin REF_CHARACTERISTIC speedgoat_target_model_cal_impl.MatrixDimensionCheck_P1_d speedgoat_target_model_cal_impl.MatrixDimensionCheck_P2_j0 speedgoat_target_model_cal_impl.MatrixDimensionCheck_P3_i speedgoat_target_model_cal_impl.MatrixDimensionCheck_P4_j /end REF_CHARACTERISTIC
/end GROUP
/begin GROUP speedgoat_target_model_2021b_Planning_and_Control_ACC_system_MPC_MPC_MPC_Preview_Signal_Check3 "speedgoat_target_model_2021b/Planning and Control/ACC system/MPC/MPC/MPC Preview Signal Check3"
 /begin REF_CHARACTERISTIC speedgoat_target_model_cal_impl.MatrixDimensionCheck_P1_dw speedgoat_target_model_cal_impl.MatrixDimensionCheck_P2_d speedgoat_target_model_cal_impl.MatrixDimensionCheck_P3_k speedgoat_target_model_cal_impl.MatrixDimensionCheck_P4_c /end REF_CHARACTERISTIC
/end GROUP
/begin GROUP speedgoat_target_model_2021b_Planning_and_Control_ACC_system_MPC_MPC_MPC_Preview_Signal_Check4 "speedgoat_target_model_2021b/Planning and Control/ACC system/MPC/MPC/MPC Preview Signal Check4"
 /begin REF_CHARACTERISTIC speedgoat_target_model_cal_impl.MatrixDimensionCheck_P1_jj speedgoat_target_model_cal_impl.MatrixDimensionCheck_P2_ie speedgoat_target_model_cal_impl.MatrixDimensionCheck_P3_p speedgoat_target_model_cal_impl.MatrixDimensionCheck_P4_j2 /end REF_CHARACTERISTIC
/end GROUP
/begin GROUP speedgoat_target_model_2021b_Planning_and_Control_ACC_system_MPC_MPC_MPC_Preview_Signal_Check5 "speedgoat_target_model_2021b/Planning and Control/ACC system/MPC/MPC/MPC Preview Signal Check5"
 /begin REF_CHARACTERISTIC speedgoat_target_model_cal_impl.MatrixDimensionCheck_P1_o speedgoat_target_model_cal_impl.MatrixDimensionCheck_P2_n speedgoat_target_model_cal_impl.MatrixDimensionCheck_P3_p0 speedgoat_target_model_cal_impl.MatrixDimensionCheck_P4_i /end REF_CHARACTERISTIC
/end GROUP
/begin GROUP speedgoat_target_model_2021b_Planning_and_Control_ACC_system_MPC_MPC_MPC_Preview_Signal_Check6 "speedgoat_target_model_2021b/Planning and Control/ACC system/MPC/MPC/MPC Preview Signal Check6"
 /begin REF_CHARACTERISTIC speedgoat_target_model_cal_impl.MatrixDimensionCheck_P1_l speedgoat_target_model_cal_impl.MatrixDimensionCheck_P2_d3 speedgoat_target_model_cal_impl.MatrixDimensionCheck_P3_e speedgoat_target_model_cal_impl.MatrixDimensionCheck_P4_jh /end REF_CHARACTERISTIC
/end GROUP
/begin GROUP speedgoat_target_model_2021b_Planning_and_Control_ACC_system_MPC_MPC_MPC_Preview_Signal_Check7 "speedgoat_target_model_2021b/Planning and Control/ACC system/MPC/MPC/MPC Preview Signal Check7"
 /begin REF_CHARACTERISTIC speedgoat_target_model_cal_impl.MatrixDimensionCheck_P1_j speedgoat_target_model_cal_impl.MatrixDimensionCheck_P2_j speedgoat_target_model_cal_impl.MatrixDimensionCheck_P3_a speedgoat_target_model_cal_impl.MatrixDimensionCheck_P4_m /end REF_CHARACTERISTIC
/end GROUP
/begin GROUP speedgoat_target_model_2021b_Planning_and_Control_ACC_system_MPC_MPC_MPC_Preview_Signal_Check8 "speedgoat_target_model_2021b/Planning and Control/ACC system/MPC/MPC/MPC Preview Signal Check8"
 /begin REF_CHARACTERISTIC speedgoat_target_model_cal_impl.MatrixDimensionCheck_P1_jjz speedgoat_target_model_cal_impl.MatrixDimensionCheck_P2_g speedgoat_target_model_cal_impl.MatrixDimensionCheck_P3_e2 speedgoat_target_model_cal_impl.MatrixDimensionCheck_P4_jd /end REF_CHARACTERISTIC
/end GROUP
/begin GROUP speedgoat_target_model_2021b_Planning_and_Control_ACC_system_MPC_MPC_MPC_Scalar_Signal_Check "speedgoat_target_model_2021b/Planning and Control/ACC system/MPC/MPC/MPC Scalar Signal Check"
 /begin REF_CHARACTERISTIC speedgoat_target_model_cal_impl.VectorDimensionCheck_P1_f speedgoat_target_model_cal_impl.VectorDimensionCheck_P2_b /end REF_CHARACTERISTIC
 /begin REF_MEASUREMENT speedgoat_target_model_2021b_B.y /end REF_MEASUREMENT
/end GROUP
/begin GROUP speedgoat_target_model_2021b_Planning_and_Control_ACC_system_MPC_MPC_MPC_Scalar_Signal_Check1 "speedgoat_target_model_2021b/Planning and Control/ACC system/MPC/MPC/MPC Scalar Signal Check1"
 /begin REF_CHARACTERISTIC speedgoat_target_model_cal_impl.VectorDimensionCheck_P1_fq speedgoat_target_model_cal_impl.VectorDimensionCheck_P2_n /end REF_CHARACTERISTIC
/end GROUP
/begin GROUP speedgoat_target_model_2021b_Planning_and_Control_ACC_system_MPC_MPC_MPC_Scalar_Signal_Check2 "speedgoat_target_model_2021b/Planning and Control/ACC system/MPC/MPC/MPC Scalar Signal Check2"
 /begin REF_CHARACTERISTIC speedgoat_target_model_cal_impl.VectorDimensionCheck_P1 speedgoat_target_model_cal_impl.VectorDimensionCheck_P2 /end REF_CHARACTERISTIC
/end GROUP
/begin GROUP speedgoat_target_model_2021b_Planning_and_Control_ACC_system_MPC_MPC_MPC_Vector_Signal_Check "speedgoat_target_model_2021b/Planning and Control/ACC system/MPC/MPC/MPC Vector Signal Check"
 /begin REF_CHARACTERISTIC speedgoat_target_model_cal_impl.VectorDimensionCheck_P1_h speedgoat_target_model_cal_impl.VectorDimensionCheck_P2_h speedgoat_target_model_cal_impl.VectorDimensionCheck_P3_i speedgoat_target_model_cal_impl.VectorDimensionCheck_P4_c /end REF_CHARACTERISTIC
/end GROUP
/begin GROUP speedgoat_target_model_2021b_Planning_and_Control_ACC_system_MPC_MPC_MPC_Vector_Signal_Check1 "speedgoat_target_model_2021b/Planning and Control/ACC system/MPC/MPC/MPC Vector Signal Check1"
 /begin REF_CHARACTERISTIC speedgoat_target_model_cal_impl.VectorDimensionCheck_P1_o speedgoat_target_model_cal_impl.VectorDimensionCheck_P2_p speedgoat_target_model_cal_impl.VectorDimensionCheck_P3_d speedgoat_target_model_cal_impl.VectorDimensionCheck_P4_f /end REF_CHARACTERISTIC
/end GROUP
/begin GROUP speedgoat_target_model_2021b_Planning_and_Control_ACC_system_MPC_MPC_MPC_Vector_Signal_Check6 "speedgoat_target_model_2021b/Planning and Control/ACC system/MPC/MPC/MPC Vector Signal Check6"
 /begin REF_CHARACTERISTIC speedgoat_target_model_cal_impl.VectorDimensionCheck_P1_oo speedgoat_target_model_cal_impl.VectorDimensionCheck_P2_f speedgoat_target_model_cal_impl.VectorDimensionCheck_P3_dg speedgoat_target_model_cal_impl.VectorDimensionCheck_P4_b /end REF_CHARACTERISTIC
/end GROUP
/begin GROUP speedgoat_target_model_2021b_Planning_and_Control_ACC_system_MPC_MPC_moorx "speedgoat_target_model_2021b/Planning and Control/ACC system/MPC/MPC/moorx"
 /begin REF_CHARACTERISTIC speedgoat_target_model_cal_impl.VectorDimensionCheck_P1_b speedgoat_target_model_cal_impl.VectorDimensionCheck_P2_l speedgoat_target_model_cal_impl.VectorDimensionCheck_P3 speedgoat_target_model_cal_impl.VectorDimensionCheck_P4 /end REF_CHARACTERISTIC
/end GROUP
/begin GROUP speedgoat_target_model_2021b_Planning_and_Control_Lateral_Controller_Stanley "speedgoat_target_model_2021b/Planning and Control/Lateral Controller Stanley"
 /begin SUB_GROUP speedgoat_target_model_2021b_Planning_and_Control_Lateral_Controller_Stanley_Dynamic /end SUB_GROUP
 /begin REF_CHARACTERISTIC speedgoat_target_model_cal_impl.Kinematic_MaxSteeringAngle speedgoat_target_model_cal_impl.Kinematic_Wheelbase speedgoat_target_model_cal_impl.LateralControllerStanley_Posi_i speedgoat_target_model_cal_impl.LateralControllerStanley_Positi /end REF_CHARACTERISTIC
 /begin REF_MEASUREMENT speedgoat_target_model_2021b_B.CurrPoses speedgoat_target_model_2021b_B.Direction speedgoat_target_model_2021b_B.Longitudinalvelocity speedgoat_target_model_2021b_B.RefPoses speedgoat_target_model_2021b_B.steerCmd /end REF_MEASUREMENT
/end GROUP
/begin GROUP speedgoat_target_model_2021b_Planning_and_Control_Lateral_Controller_Stanley_Dynamic "speedgoat_target_model_2021b/Planning and Control/Lateral Controller Stanley/Dynamic"
 /begin SUB_GROUP speedgoat_target_model_2021b_Planning_and_Control_Lateral_Controller_Stanley_Dynamic_Dynamic_Enabled /end SUB_GROUP
/end GROUP
/begin GROUP speedgoat_target_model_2021b_Planning_and_Control_Lateral_Controller_Stanley_Dynamic_Dynamic_Enabled "speedgoat_target_model_2021b/Planning and Control/Lateral Controller Stanley/Dynamic/Dynamic Enabled"
 /begin SUB_GROUP speedgoat_target_model_2021b_Planning_and_Control_Lateral_Controller_Stanley_Dynamic_Dynamic_Enabled_Radians_to_Degrees /end SUB_GROUP
 /begin REF_CHARACTERISTIC speedgoat_target_model_cal_impl.Gain1_Gain_j3 speedgoat_target_model_cal_impl.LateralControllerStanley_DelayG speedgoat_target_model_cal_impl.LateralControllerStanley_YawRat speedgoat_target_model_cal_impl.Saturation_LowerSat speedgoat_target_model_cal_impl.Saturation_UpperSat speedgoat_target_model_cal_impl.UnitDelay_InitialCondition /end REF_CHARACTERISTIC
 /begin REF_MEASUREMENT speedgoat_target_model_2021b_B.Add speedgoat_target_model_2021b_B.Curvature speedgoat_target_model_2021b_B.CurvedSteadyYaw speedgoat_target_model_2021b_B.Gain speedgoat_target_model_2021b_B.Gain_d speedgoat_target_model_2021b_B.Longitudinalvelocity speedgoat_target_model_2021b_B.Minus speedgoat_target_model_2021b_B.Minus1 speedgoat_target_model_2021b_B.Multiply speedgoat_target_model_2021b_B.Product speedgoat_target_model_2021b_B.Saturation speedgoat_target_model_2021b_B.SteeringDelay speedgoat_target_model_2021b_B.UnitDelay speedgoat_target_model_2021b_B.UnitDelay_n speedgoat_target_model_2021b_B.YawRateFeedback speedgoat_target_model_2021b_B.steerCmd speedgoat_target_model_2021b_DW.UnitDelay_DSTATE /end REF_MEASUREMENT
/end GROUP
/begin GROUP speedgoat_target_model_2021b_Planning_and_Control_Lateral_Controller_Stanley_Dynamic_Dynamic_Enabled_Radians_to_Degrees "speedgoat_target_model_2021b/Planning and Control/Lateral Controller Stanley/Dynamic/Dynamic Enabled/Radians
to Degrees" /begin REF_CHARACTERISTIC speedgoat_target_model_cal_impl.Gain_Gain_g /end REF_CHARACTERISTIC
 /begin REF_MEASUREMENT speedgoat_target_model_2021b_B.Gain speedgoat_target_model_2021b_B.Product /end REF_MEASUREMENT
/end GROUP
/begin GROUP speedgoat_target_model_2021b_Planning_and_Control_Longitudinal_Controller_Stanley "speedgoat_target_model_2021b/Planning and Control/Longitudinal Controller Stanley"
 /begin SUB_GROUP speedgoat_target_model_2021b_Planning_and_Control_Longitudinal_Controller_Stanley_Convert_Command_ speedgoat_target_model_2021b_Planning_and_Control_Longitudinal_Controller_Stanley_PI_Controller speedgoat_target_model_2021b_Planning_and_Control_Longitudinal_Controller_Stanley_Verify_Direction /end SUB_GROUP
 /begin REF_MEASUREMENT speedgoat_target_model_2021b_B.TmpRTBAtMinusInport2 speedgoat_target_model_2021b_B.error speedgoat_target_model_2021b_B.set_velocity_c /end REF_MEASUREMENT
/end GROUP
/begin GROUP speedgoat_target_model_2021b_Planning_and_Control_Longitudinal_Controller_Stanley_Convert_Command_ "speedgoat_target_model_2021b/Planning and Control/Longitudinal Controller Stanley/Convert Command "
 /begin REF_CHARACTERISTIC speedgoat_target_model_cal_impl.Constant_Value_m speedgoat_target_model_cal_impl.Switch1_Threshold_g speedgoat_target_model_cal_impl.Switch_Threshold_k /end REF_CHARACTERISTIC
 /begin REF_MEASUREMENT speedgoat_target_model_2021b_B.Abs speedgoat_target_model_2021b_B.Merge speedgoat_target_model_2021b_B.Multiply_k speedgoat_target_model_2021b_B.Switch speedgoat_target_model_2021b_B.Switch1 speedgoat_target_model_2021b_B.TmpRTBAtMultiplyInport1 /end REF_MEASUREMENT
/end GROUP
/begin GROUP speedgoat_target_model_2021b_Planning_and_Control_Longitudinal_Controller_Stanley_PI_Controller "speedgoat_target_model_2021b/Planning and Control/Longitudinal Controller Stanley/PI Controller"
 /begin SUB_GROUP speedgoat_target_model_2021b_Planning_and_Control_Longitudinal_Controller_Stanley_PI_Controller_Forward speedgoat_target_model_2021b_Planning_and_Control_Longitudinal_Controller_Stanley_PI_Controller_Reverse /end SUB_GROUP
 /begin REF_CHARACTERISTIC speedgoat_target_model_cal_impl.Merge_InitialOutput /end REF_CHARACTERISTIC
 /begin REF_MEASUREMENT speedgoat_target_model_2021b_B.DataTypeConversion speedgoat_target_model_2021b_B.Merge speedgoat_target_model_2021b_B.TmpRTBAtSwitchCaseInport1 /end REF_MEASUREMENT
/end GROUP
/begin GROUP speedgoat_target_model_2021b_Planning_and_Control_Longitudinal_Controller_Stanley_PI_Controller_Forward "speedgoat_target_model_2021b/Planning and Control/Longitudinal Controller Stanley/PI Controller/Forward"
 /begin SUB_GROUP speedgoat_target_model_2021b_Planning_and_Control_Longitudinal_Controller_Stanley_PI_Controller_Forward_PI_Forward_ /end SUB_GROUP
/end GROUP
/begin GROUP speedgoat_target_model_2021b_Planning_and_Control_Longitudinal_Controller_Stanley_PI_Controller_Forward_PI_Forward_ "speedgoat_target_model_2021b/Planning and Control/Longitudinal Controller Stanley/PI Controller/Forward/PI Forward
"
 /begin SUB_GROUP speedgoat_target_model_2021b_Planning_and_Control_Longitudinal_Controller_Stanley_PI_Controller_Forward_PI_Forward__Anti_windup speedgoat_target_model_2021b_Planning_and_Control_Longitudinal_Controller_Stanley_PI_Controller_Forward_PI_Forward__D_Gain speedgoat_target_model_2021b_Planning_and_Control_Longitudinal_Controller_Stanley_PI_Controller_Forward_PI_Forward__Filter speedgoat_target_model_2021b_Planning_and_Control_Longitudinal_Controller_Stanley_PI_Controller_Forward_PI_Forward__Filter_ICs speedgoat_target_model_2021b_Planning_and_Control_Longitudinal_Controller_Stanley_PI_Controller_Forward_PI_Forward__I_Gain speedgoat_target_model_2021b_Planning_and_Control_Longitudinal_Controller_Stanley_PI_Controller_Forward_PI_Forward__Ideal_P_Gain speedgoat_target_model_2021b_Planning_and_Control_Longitudinal_Controller_Stanley_PI_Controller_Forward_PI_Forward__Ideal_P_Gain_Fdbk speedgoat_target_model_2021b_Planning_and_Control_Longitudinal_Controller_Stanley_PI_Controller_Forward_PI_Forward__Integrator speedgoat_target_model_2021b_Planning_and_Control_Longitudinal_Controller_Stanley_PI_Controller_Forward_PI_Forward__Integrator_ICs speedgoat_target_model_2021b_Planning_and_Control_Longitudinal_Controller_Stanley_PI_Controller_Forward_PI_Forward__N_Copy speedgoat_target_model_2021b_Planning_and_Control_Longitudinal_Controller_Stanley_PI_Controller_Forward_PI_Forward__N_Gain speedgoat_target_model_2021b_Planning_and_Control_Longitudinal_Controller_Stanley_PI_Controller_Forward_PI_Forward__PID_Compensator_Formula speedgoat_target_model_2021b_Planning_and_Control_Longitudinal_Controller_Stanley_PI_Controller_Forward_PI_Forward__P_Copy speedgoat_target_model_2021b_Planning_and_Control_Longitudinal_Controller_Stanley_PI_Controller_Forward_PI_Forward__Parallel_P_Gain speedgoat_target_model_2021b_Planning_and_Control_Longitudinal_Controller_Stanley_PI_Controller_Forward_PI_Forward__Reset_Signal speedgoat_target_model_2021b_Planning_and_Control_Longitudinal_Controller_Stanley_PI_Controller_Forward_PI_Forward__Saturation speedgoat_target_model_2021b_Planning_and_Control_Longitudinal_Controller_Stanley_PI_Controller_Forward_PI_Forward__Saturation_Fdbk speedgoat_target_model_2021b_Planning_and_Control_Longitudinal_Controller_Stanley_PI_Controller_Forward_PI_Forward__Sum /end SUB_GROUP
/end GROUP
/begin GROUP speedgoat_target_model_2021b_Planning_and_Control_Longitudinal_Controller_Stanley_PI_Controller_Forward_PI_Forward__Anti_windup "speedgoat_target_model_2021b/Planning and Control/Longitudinal Controller Stanley/PI Controller/Forward/PI Forward
/Anti-windup"
 /begin SUB_GROUP speedgoat_target_model_2021b_Planning_and_Control_Longitudinal_Controller_Stanley_PI_Controller_Forward_PI_Forward__Anti_windup_Disc__Clamping_Parallel /end SUB_GROUP
/end GROUP
/begin GROUP speedgoat_target_model_2021b_Planning_and_Control_Longitudinal_Controller_Stanley_PI_Controller_Forward_PI_Forward__Anti_windup_Disc__Clamping_Parallel "speedgoat_target_model_2021b/Planning and Control/Longitudinal Controller Stanley/PI Controller/Forward/PI Forward
/Anti-windup/Disc. Clamping Parallel"
 /begin SUB_GROUP speedgoat_target_model_2021b_Planning_and_Control_Longitudinal_Controller_Stanley_PI_Controller_Forward_PI_Forward__Anti_windup_Disc__Clamping_Parallel_Dead_Zone /end SUB_GROUP
 /begin REF_CHARACTERISTIC speedgoat_target_model_cal_impl.Constant1_Value speedgoat_target_model_cal_impl.ZeroGain_Gain /end REF_CHARACTERISTIC
 /begin REF_MEASUREMENT speedgoat_target_model_2021b_B.AND3_j speedgoat_target_model_2021b_B.DataTypeConv1_p speedgoat_target_model_2021b_B.DataTypeConv2_l speedgoat_target_model_2021b_B.DeadZone_n speedgoat_target_model_2021b_B.Equal1_a speedgoat_target_model_2021b_B.IntegralGain_a speedgoat_target_model_2021b_B.NotEqual_b speedgoat_target_model_2021b_B.SignPreIntegrator_d speedgoat_target_model_2021b_B.SignPreSat_m speedgoat_target_model_2021b_B.Sum_k speedgoat_target_model_2021b_B.Switch_l speedgoat_target_model_2021b_B.ZeroGain_l /end REF_MEASUREMENT
/end GROUP
/begin GROUP speedgoat_target_model_2021b_Planning_and_Control_Longitudinal_Controller_Stanley_PI_Controller_Forward_PI_Forward__Anti_windup_Disc__Clamping_Parallel_Dead_Zone "speedgoat_target_model_2021b/Planning and Control/Longitudinal Controller Stanley/PI Controller/Forward/PI Forward
/Anti-windup/Disc. Clamping Parallel/Dead Zone"
 /begin SUB_GROUP speedgoat_target_model_2021b_Planning_and_Control_Longitudinal_Controller_Stanley_PI_Controller_Forward_PI_Forward__Anti_windup_Disc__Clamping_Parallel_Dead_Zone_Enabled /end SUB_GROUP
/end GROUP
/begin GROUP speedgoat_target_model_2021b_Planning_and_Control_Longitudinal_Controller_Stanley_PI_Controller_Forward_PI_Forward__Anti_windup_Disc__Clamping_Parallel_Dead_Zone_Enabled "speedgoat_target_model_2021b/Planning and Control/Longitudinal Controller Stanley/PI Controller/Forward/PI Forward
/Anti-windup/Disc. Clamping Parallel/Dead Zone/Enabled"
 /begin REF_CHARACTERISTIC speedgoat_target_model_cal_impl.PIForward_LowerSaturationLimit speedgoat_target_model_cal_impl.PIForward_UpperSaturationLimit /end REF_CHARACTERISTIC
 /begin REF_MEASUREMENT speedgoat_target_model_2021b_B.DeadZone_n speedgoat_target_model_2021b_B.Sum_k /end REF_MEASUREMENT
/end GROUP
/begin GROUP speedgoat_target_model_2021b_Planning_and_Control_Longitudinal_Controller_Stanley_PI_Controller_Forward_PI_Forward__I_Gain "speedgoat_target_model_2021b/Planning and Control/Longitudinal Controller Stanley/PI Controller/Forward/PI Forward
/I Gain"
 /begin SUB_GROUP speedgoat_target_model_2021b_Planning_and_Control_Longitudinal_Controller_Stanley_PI_Controller_Forward_PI_Forward__I_Gain_Internal_Parameters /end SUB_GROUP
/end GROUP
/begin GROUP speedgoat_target_model_2021b_Planning_and_Control_Longitudinal_Controller_Stanley_PI_Controller_Forward_PI_Forward__I_Gain_Internal_Parameters "speedgoat_target_model_2021b/Planning and Control/Longitudinal Controller Stanley/PI Controller/Forward/PI Forward
/I Gain/Internal Parameters"
 /begin REF_CHARACTERISTIC speedgoat_target_model_cal_impl.LongitudinalControllerStanley_K /end REF_CHARACTERISTIC
 /begin REF_MEASUREMENT speedgoat_target_model_2021b_B.IntegralGain_a speedgoat_target_model_2021b_B.error /end REF_MEASUREMENT
/end GROUP
/begin GROUP speedgoat_target_model_2021b_Planning_and_Control_Longitudinal_Controller_Stanley_PI_Controller_Forward_PI_Forward__Integrator "speedgoat_target_model_2021b/Planning and Control/Longitudinal Controller Stanley/PI Controller/Forward/PI Forward
/Integrator"
 /begin SUB_GROUP speedgoat_target_model_2021b_Planning_and_Control_Longitudinal_Controller_Stanley_PI_Controller_Forward_PI_Forward__Integrator_Discrete /end SUB_GROUP
/end GROUP
/begin GROUP speedgoat_target_model_2021b_Planning_and_Control_Longitudinal_Controller_Stanley_PI_Controller_Forward_PI_Forward__Integrator_Discrete "speedgoat_target_model_2021b/Planning and Control/Longitudinal Controller Stanley/PI Controller/Forward/PI Forward
/Integrator/Discrete"
 /begin REF_CHARACTERISTIC speedgoat_target_model_cal_impl.Integrator_gainval speedgoat_target_model_cal_impl.PIForward_InitialConditionForIn /end REF_CHARACTERISTIC
 /begin REF_MEASUREMENT speedgoat_target_model_2021b_B.DataTypeConversion speedgoat_target_model_2021b_B.Integrator_b speedgoat_target_model_2021b_B.Switch_l speedgoat_target_model_2021b_DW.Integrator_DSTATE_k speedgoat_target_model_2021b_DW.Integrator_PrevResetState_j /end REF_MEASUREMENT
/end GROUP
/begin GROUP speedgoat_target_model_2021b_Planning_and_Control_Longitudinal_Controller_Stanley_PI_Controller_Forward_PI_Forward__Parallel_P_Gain "speedgoat_target_model_2021b/Planning and Control/Longitudinal Controller Stanley/PI Controller/Forward/PI Forward
/Parallel P Gain"
 /begin SUB_GROUP speedgoat_target_model_2021b_Planning_and_Control_Longitudinal_Controller_Stanley_PI_Controller_Forward_PI_Forward__Parallel_P_Gain_Internal_Parameters /end SUB_GROUP
/end GROUP
/begin GROUP speedgoat_target_model_2021b_Planning_and_Control_Longitudinal_Controller_Stanley_PI_Controller_Forward_PI_Forward__Parallel_P_Gain_Internal_Parameters "speedgoat_target_model_2021b/Planning and Control/Longitudinal Controller Stanley/PI Controller/Forward/PI Forward
/Parallel P Gain/Internal Parameters"
 /begin REF_CHARACTERISTIC speedgoat_target_model_cal_impl.LongitudinalControllerStanley_n /end REF_CHARACTERISTIC
 /begin REF_MEASUREMENT speedgoat_target_model_2021b_B.ProportionalGain_f speedgoat_target_model_2021b_B.error /end REF_MEASUREMENT
/end GROUP
/begin GROUP speedgoat_target_model_2021b_Planning_and_Control_Longitudinal_Controller_Stanley_PI_Controller_Forward_PI_Forward__Saturation "speedgoat_target_model_2021b/Planning and Control/Longitudinal Controller Stanley/PI Controller/Forward/PI Forward
/Saturation"
 /begin SUB_GROUP speedgoat_target_model_2021b_Planning_and_Control_Longitudinal_Controller_Stanley_PI_Controller_Forward_PI_Forward__Saturation_Enabled /end SUB_GROUP
/end GROUP
/begin GROUP speedgoat_target_model_2021b_Planning_and_Control_Longitudinal_Controller_Stanley_PI_Controller_Forward_PI_Forward__Saturation_Enabled "speedgoat_target_model_2021b/Planning and Control/Longitudinal Controller Stanley/PI Controller/Forward/PI Forward
/Saturation/Enabled"
 /begin REF_CHARACTERISTIC speedgoat_target_model_cal_impl.PIForward_LowerSaturationLimit speedgoat_target_model_cal_impl.PIForward_UpperSaturationLimit /end REF_CHARACTERISTIC
 /begin REF_MEASUREMENT speedgoat_target_model_2021b_B.Merge speedgoat_target_model_2021b_B.Sum_k /end REF_MEASUREMENT
/end GROUP
/begin GROUP speedgoat_target_model_2021b_Planning_and_Control_Longitudinal_Controller_Stanley_PI_Controller_Forward_PI_Forward__Sum "speedgoat_target_model_2021b/Planning and Control/Longitudinal Controller Stanley/PI Controller/Forward/PI Forward
/Sum"
 /begin SUB_GROUP speedgoat_target_model_2021b_Planning_and_Control_Longitudinal_Controller_Stanley_PI_Controller_Forward_PI_Forward__Sum_Sum_PI /end SUB_GROUP
/end GROUP
/begin GROUP speedgoat_target_model_2021b_Planning_and_Control_Longitudinal_Controller_Stanley_PI_Controller_Forward_PI_Forward__Sum_Sum_PI "speedgoat_target_model_2021b/Planning and Control/Longitudinal Controller Stanley/PI Controller/Forward/PI Forward
/Sum/Sum_PI"
 /begin REF_MEASUREMENT speedgoat_target_model_2021b_B.Integrator_b speedgoat_target_model_2021b_B.ProportionalGain_f speedgoat_target_model_2021b_B.Sum_k /end REF_MEASUREMENT
/end GROUP
/begin GROUP speedgoat_target_model_2021b_Planning_and_Control_Longitudinal_Controller_Stanley_PI_Controller_Reverse "speedgoat_target_model_2021b/Planning and Control/Longitudinal Controller Stanley/PI Controller/Reverse"
 /begin SUB_GROUP speedgoat_target_model_2021b_Planning_and_Control_Longitudinal_Controller_Stanley_PI_Controller_Reverse_PI_Reverse /end SUB_GROUP
/end GROUP
/begin GROUP speedgoat_target_model_2021b_Planning_and_Control_Longitudinal_Controller_Stanley_PI_Controller_Reverse_PI_Reverse "speedgoat_target_model_2021b/Planning and Control/Longitudinal Controller Stanley/PI Controller/Reverse/PI Reverse"
 /begin SUB_GROUP speedgoat_target_model_2021b_Planning_and_Control_Longitudinal_Controller_Stanley_PI_Controller_Reverse_PI_Reverse_Anti_windup speedgoat_target_model_2021b_Planning_and_Control_Longitudinal_Controller_Stanley_PI_Controller_Reverse_PI_Reverse_D_Gain speedgoat_target_model_2021b_Planning_and_Control_Longitudinal_Controller_Stanley_PI_Controller_Reverse_PI_Reverse_Filter speedgoat_target_model_2021b_Planning_and_Control_Longitudinal_Controller_Stanley_PI_Controller_Reverse_PI_Reverse_Filter_ICs speedgoat_target_model_2021b_Planning_and_Control_Longitudinal_Controller_Stanley_PI_Controller_Reverse_PI_Reverse_I_Gain speedgoat_target_model_2021b_Planning_and_Control_Longitudinal_Controller_Stanley_PI_Controller_Reverse_PI_Reverse_Ideal_P_Gain speedgoat_target_model_2021b_Planning_and_Control_Longitudinal_Controller_Stanley_PI_Controller_Reverse_PI_Reverse_Ideal_P_Gain_Fdbk speedgoat_target_model_2021b_Planning_and_Control_Longitudinal_Controller_Stanley_PI_Controller_Reverse_PI_Reverse_Integrator speedgoat_target_model_2021b_Planning_and_Control_Longitudinal_Controller_Stanley_PI_Controller_Reverse_PI_Reverse_Integrator_ICs speedgoat_target_model_2021b_Planning_and_Control_Longitudinal_Controller_Stanley_PI_Controller_Reverse_PI_Reverse_N_Copy speedgoat_target_model_2021b_Planning_and_Control_Longitudinal_Controller_Stanley_PI_Controller_Reverse_PI_Reverse_N_Gain speedgoat_target_model_2021b_Planning_and_Control_Longitudinal_Controller_Stanley_PI_Controller_Reverse_PI_Reverse_PID_Compensator_Formula speedgoat_target_model_2021b_Planning_and_Control_Longitudinal_Controller_Stanley_PI_Controller_Reverse_PI_Reverse_P_Copy speedgoat_target_model_2021b_Planning_and_Control_Longitudinal_Controller_Stanley_PI_Controller_Reverse_PI_Reverse_Parallel_P_Gain speedgoat_target_model_2021b_Planning_and_Control_Longitudinal_Controller_Stanley_PI_Controller_Reverse_PI_Reverse_Reset_Signal speedgoat_target_model_2021b_Planning_and_Control_Longitudinal_Controller_Stanley_PI_Controller_Reverse_PI_Reverse_Saturation speedgoat_target_model_2021b_Planning_and_Control_Longitudinal_Controller_Stanley_PI_Controller_Reverse_PI_Reverse_Saturation_Fdbk speedgoat_target_model_2021b_Planning_and_Control_Longitudinal_Controller_Stanley_PI_Controller_Reverse_PI_Reverse_Sum /end SUB_GROUP
/end GROUP
/begin GROUP speedgoat_target_model_2021b_Planning_and_Control_Longitudinal_Controller_Stanley_PI_Controller_Reverse_PI_Reverse_Anti_windup "speedgoat_target_model_2021b/Planning and Control/Longitudinal Controller Stanley/PI Controller/Reverse/PI Reverse/Anti-windup"
 /begin SUB_GROUP speedgoat_target_model_2021b_Planning_and_Control_Longitudinal_Controller_Stanley_PI_Controller_Reverse_PI_Reverse_Anti_windup_Disc__Clamping_Parallel /end SUB_GROUP
/end GROUP
/begin GROUP speedgoat_target_model_2021b_Planning_and_Control_Longitudinal_Controller_Stanley_PI_Controller_Reverse_PI_Reverse_Anti_windup_Disc__Clamping_Parallel "speedgoat_target_model_2021b/Planning and Control/Longitudinal Controller Stanley/PI Controller/Reverse/PI Reverse/Anti-windup/Disc. Clamping Parallel"
 /begin SUB_GROUP speedgoat_target_model_2021b_Planning_and_Control_Longitudinal_Controller_Stanley_PI_Controller_Reverse_PI_Reverse_Anti_windup_Disc__Clamping_Parallel_Dead_Zone /end SUB_GROUP
 /begin REF_CHARACTERISTIC speedgoat_target_model_cal_impl.Constant1_Value_f speedgoat_target_model_cal_impl.ZeroGain_Gain_k /end REF_CHARACTERISTIC
 /begin REF_MEASUREMENT speedgoat_target_model_2021b_B.AND3_b speedgoat_target_model_2021b_B.DataTypeConv1 speedgoat_target_model_2021b_B.DataTypeConv2 speedgoat_target_model_2021b_B.DeadZone speedgoat_target_model_2021b_B.Equal1_c speedgoat_target_model_2021b_B.IntegralGain speedgoat_target_model_2021b_B.NotEqual speedgoat_target_model_2021b_B.SignPreIntegrator speedgoat_target_model_2021b_B.SignPreSat speedgoat_target_model_2021b_B.Sum_fg speedgoat_target_model_2021b_B.Switch_o speedgoat_target_model_2021b_B.ZeroGain /end REF_MEASUREMENT
/end GROUP
/begin GROUP speedgoat_target_model_2021b_Planning_and_Control_Longitudinal_Controller_Stanley_PI_Controller_Reverse_PI_Reverse_Anti_windup_Disc__Clamping_Parallel_Dead_Zone "speedgoat_target_model_2021b/Planning and Control/Longitudinal Controller Stanley/PI Controller/Reverse/PI Reverse/Anti-windup/Disc. Clamping Parallel/Dead Zone"
 /begin SUB_GROUP speedgoat_target_model_2021b_Planning_and_Control_Longitudinal_Controller_Stanley_PI_Controller_Reverse_PI_Reverse_Anti_windup_Disc__Clamping_Parallel_Dead_Zone_Enabled /end SUB_GROUP
/end GROUP
/begin GROUP speedgoat_target_model_2021b_Planning_and_Control_Longitudinal_Controller_Stanley_PI_Controller_Reverse_PI_Reverse_Anti_windup_Disc__Clamping_Parallel_Dead_Zone_Enabled "speedgoat_target_model_2021b/Planning and Control/Longitudinal Controller Stanley/PI Controller/Reverse/PI Reverse/Anti-windup/Disc. Clamping Parallel/Dead Zone/Enabled"
 /begin REF_CHARACTERISTIC speedgoat_target_model_cal_impl.PIReverse_LowerSaturationLimit speedgoat_target_model_cal_impl.PIReverse_UpperSaturationLimit /end REF_CHARACTERISTIC
 /begin REF_MEASUREMENT speedgoat_target_model_2021b_B.DeadZone speedgoat_target_model_2021b_B.Sum_fg /end REF_MEASUREMENT
/end GROUP
/begin GROUP speedgoat_target_model_2021b_Planning_and_Control_Longitudinal_Controller_Stanley_PI_Controller_Reverse_PI_Reverse_I_Gain "speedgoat_target_model_2021b/Planning and Control/Longitudinal Controller Stanley/PI Controller/Reverse/PI Reverse/I Gain"
 /begin SUB_GROUP speedgoat_target_model_2021b_Planning_and_Control_Longitudinal_Controller_Stanley_PI_Controller_Reverse_PI_Reverse_I_Gain_Internal_Parameters /end SUB_GROUP
/end GROUP
/begin GROUP speedgoat_target_model_2021b_Planning_and_Control_Longitudinal_Controller_Stanley_PI_Controller_Reverse_PI_Reverse_I_Gain_Internal_Parameters "speedgoat_target_model_2021b/Planning and Control/Longitudinal Controller Stanley/PI Controller/Reverse/PI Reverse/I Gain/Internal Parameters"
 /begin REF_CHARACTERISTIC speedgoat_target_model_cal_impl.LongitudinalControllerStanley_K /end REF_CHARACTERISTIC
 /begin REF_MEASUREMENT speedgoat_target_model_2021b_B.IntegralGain speedgoat_target_model_2021b_B.error /end REF_MEASUREMENT
/end GROUP
/begin GROUP speedgoat_target_model_2021b_Planning_and_Control_Longitudinal_Controller_Stanley_PI_Controller_Reverse_PI_Reverse_Integrator "speedgoat_target_model_2021b/Planning and Control/Longitudinal Controller Stanley/PI Controller/Reverse/PI Reverse/Integrator"
 /begin SUB_GROUP speedgoat_target_model_2021b_Planning_and_Control_Longitudinal_Controller_Stanley_PI_Controller_Reverse_PI_Reverse_Integrator_Discrete /end SUB_GROUP
/end GROUP
/begin GROUP speedgoat_target_model_2021b_Planning_and_Control_Longitudinal_Controller_Stanley_PI_Controller_Reverse_PI_Reverse_Integrator_Discrete "speedgoat_target_model_2021b/Planning and Control/Longitudinal Controller Stanley/PI Controller/Reverse/PI Reverse/Integrator/Discrete"
 /begin REF_CHARACTERISTIC speedgoat_target_model_cal_impl.Integrator_gainval_b speedgoat_target_model_cal_impl.PIReverse_InitialConditionForIn /end REF_CHARACTERISTIC
 /begin REF_MEASUREMENT speedgoat_target_model_2021b_B.DataTypeConversion speedgoat_target_model_2021b_B.Integrator speedgoat_target_model_2021b_B.Switch_o speedgoat_target_model_2021b_DW.Integrator_DSTATE speedgoat_target_model_2021b_DW.Integrator_PrevResetState /end REF_MEASUREMENT
/end GROUP
/begin GROUP speedgoat_target_model_2021b_Planning_and_Control_Longitudinal_Controller_Stanley_PI_Controller_Reverse_PI_Reverse_Parallel_P_Gain "speedgoat_target_model_2021b/Planning and Control/Longitudinal Controller Stanley/PI Controller/Reverse/PI Reverse/Parallel P Gain"
 /begin SUB_GROUP speedgoat_target_model_2021b_Planning_and_Control_Longitudinal_Controller_Stanley_PI_Controller_Reverse_PI_Reverse_Parallel_P_Gain_Internal_Parameters /end SUB_GROUP
/end GROUP
/begin GROUP speedgoat_target_model_2021b_Planning_and_Control_Longitudinal_Controller_Stanley_PI_Controller_Reverse_PI_Reverse_Parallel_P_Gain_Internal_Parameters "speedgoat_target_model_2021b/Planning and Control/Longitudinal Controller Stanley/PI Controller/Reverse/PI Reverse/Parallel P Gain/Internal Parameters"
 /begin REF_CHARACTERISTIC speedgoat_target_model_cal_impl.LongitudinalControllerStanley_n /end REF_CHARACTERISTIC
 /begin REF_MEASUREMENT speedgoat_target_model_2021b_B.ProportionalGain speedgoat_target_model_2021b_B.error /end REF_MEASUREMENT
/end GROUP
/begin GROUP speedgoat_target_model_2021b_Planning_and_Control_Longitudinal_Controller_Stanley_PI_Controller_Reverse_PI_Reverse_Saturation "speedgoat_target_model_2021b/Planning and Control/Longitudinal Controller Stanley/PI Controller/Reverse/PI Reverse/Saturation"
 /begin SUB_GROUP speedgoat_target_model_2021b_Planning_and_Control_Longitudinal_Controller_Stanley_PI_Controller_Reverse_PI_Reverse_Saturation_Enabled /end SUB_GROUP
/end GROUP
/begin GROUP speedgoat_target_model_2021b_Planning_and_Control_Longitudinal_Controller_Stanley_PI_Controller_Reverse_PI_Reverse_Saturation_Enabled "speedgoat_target_model_2021b/Planning and Control/Longitudinal Controller Stanley/PI Controller/Reverse/PI Reverse/Saturation/Enabled"
 /begin REF_CHARACTERISTIC speedgoat_target_model_cal_impl.PIReverse_LowerSaturationLimit speedgoat_target_model_cal_impl.PIReverse_UpperSaturationLimit /end REF_CHARACTERISTIC
 /begin REF_MEASUREMENT speedgoat_target_model_2021b_B.Merge speedgoat_target_model_2021b_B.Sum_fg /end REF_MEASUREMENT
/end GROUP
/begin GROUP speedgoat_target_model_2021b_Planning_and_Control_Longitudinal_Controller_Stanley_PI_Controller_Reverse_PI_Reverse_Sum "speedgoat_target_model_2021b/Planning and Control/Longitudinal Controller Stanley/PI Controller/Reverse/PI Reverse/Sum"
 /begin SUB_GROUP speedgoat_target_model_2021b_Planning_and_Control_Longitudinal_Controller_Stanley_PI_Controller_Reverse_PI_Reverse_Sum_Sum_PI /end SUB_GROUP
/end GROUP
/begin GROUP speedgoat_target_model_2021b_Planning_and_Control_Longitudinal_Controller_Stanley_PI_Controller_Reverse_PI_Reverse_Sum_Sum_PI "speedgoat_target_model_2021b/Planning and Control/Longitudinal Controller Stanley/PI Controller/Reverse/PI Reverse/Sum/Sum_PI"
 /begin REF_MEASUREMENT speedgoat_target_model_2021b_B.Integrator speedgoat_target_model_2021b_B.ProportionalGain speedgoat_target_model_2021b_B.Sum_fg /end REF_MEASUREMENT
/end GROUP
/begin GROUP speedgoat_target_model_2021b_Planning_and_Control_Longitudinal_Controller_Stanley_Verify_Direction "speedgoat_target_model_2021b/Planning and Control/Longitudinal Controller Stanley/Verify Direction"
 /begin REF_CHARACTERISTIC speedgoat_target_model_cal_impl.Constant1_Value_id speedgoat_target_model_cal_impl.Constant2_Value speedgoat_target_model_cal_impl.Constant3_Value speedgoat_target_model_cal_impl.Constant4_Value /end REF_CHARACTERISTIC
 /begin REF_MEASUREMENT speedgoat_target_model_2021b_B.AND1 speedgoat_target_model_2021b_B.AND2 speedgoat_target_model_2021b_B.AND3 speedgoat_target_model_2021b_B.Equal1 speedgoat_target_model_2021b_B.Equal2 speedgoat_target_model_2021b_B.Equal3 speedgoat_target_model_2021b_B.Equal4 speedgoat_target_model_2021b_B.Equal5 speedgoat_target_model_2021b_B.Equal6 speedgoat_target_model_2021b_B.NOT speedgoat_target_model_2021b_B.NOT1 speedgoat_target_model_2021b_B.OR_h speedgoat_target_model_2021b_B.Sign1 speedgoat_target_model_2021b_B.Sign2 speedgoat_target_model_2021b_B.TmpRTBAtEqual1Inport1 speedgoat_target_model_2021b_B.TmpRTBAtEqual2Inport1 speedgoat_target_model_2021b_B.TmpRTBAtEqual3Inport1 speedgoat_target_model_2021b_B.TmpRTBAtEqual4Inport2 speedgoat_target_model_2021b_B.TmpRTBAtEqual5Inport2 speedgoat_target_model_2021b_B.TmpRTBAtSign1Inport1 speedgoat_target_model_2021b_B.set_velocity speedgoat_target_model_2021b_B.set_velocity1 speedgoat_target_model_2021b_DW.Assertion1_sltestCurrentResult speedgoat_target_model_2021b_DW.Assertion1_sltestFinalResult speedgoat_target_model_2021b_DW.Assertion1_sltestLastResultTime speedgoat_target_model_2021b_DW.Assertion_sltestCurrentResult speedgoat_target_model_2021b_DW.Assertion_sltestFinalResult speedgoat_target_model_2021b_DW.Assertion_sltestLastResultTime /end REF_MEASUREMENT
/end GROUP
/begin GROUP speedgoat_target_model_2021b_Planning_and_Control_Subsystem3 "speedgoat_target_model_2021b/Planning and Control/Subsystem3"
 /begin SUB_GROUP speedgoat_target_model_2021b_Planning_and_Control_Subsystem3_Subsystem1 speedgoat_target_model_2021b_Planning_and_Control_Subsystem3_Subsystem2 /end SUB_GROUP
 /begin REF_CHARACTERISTIC speedgoat_target_model_cal_impl.Merge1_InitialOutput speedgoat_target_model_cal_impl.Merge2_InitialOutput /end REF_CHARACTERISTIC
 /begin REF_MEASUREMENT speedgoat_target_model_2021b_B.Merge1 speedgoat_target_model_2021b_B.Merge2 speedgoat_target_model_2021b_B.OR /end REF_MEASUREMENT
/end GROUP
/begin GROUP speedgoat_target_model_2021b_Planning_and_Control_Subsystem3_Subsystem1 "speedgoat_target_model_2021b/Planning and Control/Subsystem3/Subsystem1"
 /begin SUB_GROUP speedgoat_target_model_2021b_Planning_and_Control_Subsystem3_Subsystem1_Subsystem2 /end SUB_GROUP
 /begin REF_CHARACTERISTIC speedgoat_target_model_cal_impl.BrakeSaturation_LowerSat_m speedgoat_target_model_cal_impl.BrakeSaturation_UpperSat_a speedgoat_target_model_cal_impl.Constant_Value_d speedgoat_target_model_cal_impl.Switch1_Threshold_m speedgoat_target_model_cal_impl.Switch_Threshold_f speedgoat_target_model_cal_impl.ThrottleSaturation_LowerSat_g speedgoat_target_model_cal_impl.ThrottleSaturation_UpperSat_e /end REF_CHARACTERISTIC
 /begin REF_MEASUREMENT speedgoat_target_model_2021b_B.BrakeSaturation speedgoat_target_model_2021b_B.Merge1 speedgoat_target_model_2021b_B.Merge2 speedgoat_target_model_2021b_B.T_eng speedgoat_target_model_2021b_B.T_eng_h speedgoat_target_model_2021b_B.ThrottleSaturation /end REF_MEASUREMENT
/end GROUP
/begin GROUP speedgoat_target_model_2021b_Planning_and_Control_Subsystem3_Subsystem1_Subsystem2 "speedgoat_target_model_2021b/Planning and Control/Subsystem3/Subsystem1/Subsystem2"
 /begin SUB_GROUP speedgoat_target_model_2021b_Planning_and_Control_Subsystem3_Subsystem1_Subsystem2_Subsystem speedgoat_target_model_2021b_Planning_and_Control_Subsystem3_Subsystem1_Subsystem2_Subsystem1 /end SUB_GROUP
/end GROUP
/begin GROUP speedgoat_target_model_2021b_Planning_and_Control_Subsystem3_Subsystem1_Subsystem2_Subsystem "speedgoat_target_model_2021b/Planning and Control/Subsystem3/Subsystem1/Subsystem2/Subsystem"
 /begin REF_CHARACTERISTIC speedgoat_target_model_cal_impl.Constant1_Value_fy speedgoat_target_model_cal_impl.DiscreteTimeIntegrator_IC_d speedgoat_target_model_cal_impl.DiscreteTimeIntegrator_gainva_a speedgoat_target_model_cal_impl.Gain1_Gain_j speedgoat_target_model_cal_impl.Gain2_Gain_h speedgoat_target_model_cal_impl.Gain4_Gain_n speedgoat_target_model_cal_impl.Gain_Gain_c /end REF_CHARACTERISTIC
 /begin REF_MEASUREMENT speedgoat_target_model_2021b_B.F_aero_k speedgoat_target_model_2021b_B.Gain2_k speedgoat_target_model_2021b_B.Gain_h speedgoat_target_model_2021b_B.Square_i speedgoat_target_model_2021b_B.Sum_o speedgoat_target_model_2021b_B.T_eng_h speedgoat_target_model_2021b_B.TmpRTBAtSwitchOutport1 speedgoat_target_model_2021b_B.v_g speedgoat_target_model_2021b_DW.DiscreteTimeIntegrator_DSTATE_a speedgoat_target_model_2021b_DW.DiscreteTimeIntegrator_PrevRe_a /end REF_MEASUREMENT
/end GROUP
/begin GROUP speedgoat_target_model_2021b_Planning_and_Control_Subsystem3_Subsystem1_Subsystem2_Subsystem1 "speedgoat_target_model_2021b/Planning and Control/Subsystem3/Subsystem1/Subsystem2/Subsystem1"
 /begin REF_CHARACTERISTIC speedgoat_target_model_cal_impl.Constant1_Value_o speedgoat_target_model_cal_impl.DiscreteTimeIntegrator_IC_i speedgoat_target_model_cal_impl.DiscreteTimeIntegrator_gainva_c speedgoat_target_model_cal_impl.Gain1_Gain_m speedgoat_target_model_cal_impl.Gain2_Gain_l speedgoat_target_model_cal_impl.Gain4_Gain_m speedgoat_target_model_cal_impl.Gain_Gain_m /end REF_CHARACTERISTIC
 /begin REF_MEASUREMENT speedgoat_target_model_2021b_B.F_aero speedgoat_target_model_2021b_B.Gain2 speedgoat_target_model_2021b_B.Gain_dx speedgoat_target_model_2021b_B.Square speedgoat_target_model_2021b_B.Sum speedgoat_target_model_2021b_B.T_eng speedgoat_target_model_2021b_B.TmpRTBAtSwitch1Outport1 speedgoat_target_model_2021b_B.v speedgoat_target_model_2021b_DW.DiscreteTimeIntegrator_DSTATE speedgoat_target_model_2021b_DW.DiscreteTimeIntegrator_PrevRese /end REF_MEASUREMENT
/end GROUP
/begin GROUP speedgoat_target_model_2021b_Planning_and_Control_Subsystem3_Subsystem2 "speedgoat_target_model_2021b/Planning and Control/Subsystem3/Subsystem2"
 /begin SUB_GROUP speedgoat_target_model_2021b_Planning_and_Control_Subsystem3_Subsystem2_Subsystem2 /end SUB_GROUP
 /begin REF_CHARACTERISTIC speedgoat_target_model_cal_impl.BrakeSaturation_LowerSat speedgoat_target_model_cal_impl.BrakeSaturation_UpperSat speedgoat_target_model_cal_impl.Constant_Value speedgoat_target_model_cal_impl.Switch1_Threshold speedgoat_target_model_cal_impl.Switch_Threshold speedgoat_target_model_cal_impl.ThrottleSaturation_LowerSat speedgoat_target_model_cal_impl.ThrottleSaturation_UpperSat /end REF_CHARACTERISTIC
 /begin REF_MEASUREMENT speedgoat_target_model_2021b_B.BrakeSaturation_n speedgoat_target_model_2021b_B.Merge1 speedgoat_target_model_2021b_B.Merge2 speedgoat_target_model_2021b_B.T_eng_c speedgoat_target_model_2021b_B.T_eng_c0 speedgoat_target_model_2021b_B.ThrottleSaturation_m speedgoat_target_model_2021b_B.accel speedgoat_target_model_2021b_B.acceleration speedgoat_target_model_2021b_B.decel /end REF_MEASUREMENT
/end GROUP
/begin GROUP speedgoat_target_model_2021b_Planning_and_Control_Subsystem3_Subsystem2_Subsystem2 "speedgoat_target_model_2021b/Planning and Control/Subsystem3/Subsystem2/Subsystem2"
 /begin SUB_GROUP speedgoat_target_model_2021b_Planning_and_Control_Subsystem3_Subsystem2_Subsystem2_Subsystem speedgoat_target_model_2021b_Planning_and_Control_Subsystem3_Subsystem2_Subsystem2_Subsystem1 /end SUB_GROUP
/end GROUP
/begin GROUP speedgoat_target_model_2021b_Planning_and_Control_Subsystem3_Subsystem2_Subsystem2_Subsystem "speedgoat_target_model_2021b/Planning and Control/Subsystem3/Subsystem2/Subsystem2/Subsystem"
 /begin REF_CHARACTERISTIC speedgoat_target_model_cal_impl.Constant1_Value_d speedgoat_target_model_cal_impl.DiscreteTimeIntegrator_IC_a speedgoat_target_model_cal_impl.DiscreteTimeIntegrator_gainva_j speedgoat_target_model_cal_impl.Gain1_Gain_d speedgoat_target_model_cal_impl.Gain2_Gain_n speedgoat_target_model_cal_impl.Gain4_Gain_b speedgoat_target_model_cal_impl.Gain_Gain_n /end REF_CHARACTERISTIC
 /begin REF_MEASUREMENT speedgoat_target_model_2021b_B.F_aero_hy speedgoat_target_model_2021b_B.Gain2_b speedgoat_target_model_2021b_B.Gain_b speedgoat_target_model_2021b_B.Square_k speedgoat_target_model_2021b_B.Sum_f speedgoat_target_model_2021b_B.T_eng_c0 speedgoat_target_model_2021b_B.accel speedgoat_target_model_2021b_B.v_o speedgoat_target_model_2021b_DW.DiscreteTimeIntegrator_DSTATE_e speedgoat_target_model_2021b_DW.DiscreteTimeIntegrator_PrevR_bg /end REF_MEASUREMENT
/end GROUP
/begin GROUP speedgoat_target_model_2021b_Planning_and_Control_Subsystem3_Subsystem2_Subsystem2_Subsystem1 "speedgoat_target_model_2021b/Planning and Control/Subsystem3/Subsystem2/Subsystem2/Subsystem1"
 /begin REF_CHARACTERISTIC speedgoat_target_model_cal_impl.Constant1_Value_i speedgoat_target_model_cal_impl.DiscreteTimeIntegrator_IC speedgoat_target_model_cal_impl.DiscreteTimeIntegrator_gainval speedgoat_target_model_cal_impl.Gain1_Gain speedgoat_target_model_cal_impl.Gain2_Gain speedgoat_target_model_cal_impl.Gain4_Gain speedgoat_target_model_cal_impl.Gain_Gain /end REF_CHARACTERISTIC
 /begin REF_MEASUREMENT speedgoat_target_model_2021b_B.F_aero_h speedgoat_target_model_2021b_B.Gain2_p speedgoat_target_model_2021b_B.Gain_g speedgoat_target_model_2021b_B.Square_j speedgoat_target_model_2021b_B.Sum_d speedgoat_target_model_2021b_B.T_eng_c speedgoat_target_model_2021b_B.decel speedgoat_target_model_2021b_B.v_p speedgoat_target_model_2021b_DW.DiscreteTimeIntegrator_DSTATE_f speedgoat_target_model_2021b_DW.DiscreteTimeIntegrator_PrevRe_b /end REF_MEASUREMENT
/end GROUP
/begin GROUP speedgoat_target_model_2021b_UDP_Data_Receive "speedgoat_target_model_2021b/UDP Data Receive"
 /begin SUB_GROUP speedgoat_target_model_2021b_UDP_Data_Receive_Byte_Unpack__Fifth_set speedgoat_target_model_2021b_UDP_Data_Receive_Byte_Unpack__First_set speedgoat_target_model_2021b_UDP_Data_Receive_Byte_Unpack__Fourth_set speedgoat_target_model_2021b_UDP_Data_Receive_Byte_Unpack__Second_set speedgoat_target_model_2021b_UDP_Data_Receive_Byte_Unpack__Third_set speedgoat_target_model_2021b_UDP_Data_Receive_UDP_Receive__Fifth_set speedgoat_target_model_2021b_UDP_Data_Receive_UDP_Receive__First_set speedgoat_target_model_2021b_UDP_Data_Receive_UDP_Receive__Fourth_set speedgoat_target_model_2021b_UDP_Data_Receive_UDP_Receive__Second_set speedgoat_target_model_2021b_UDP_Data_Receive_UDP_Receive__Third_set /end SUB_GROUP
 /begin REF_MEASUREMENT speedgoat_target_model_2021b_B.DataTypeConversion1 speedgoat_target_model_2021b_B.DataTypeConversion2 speedgoat_target_model_2021b_B.DataTypeConversion3 speedgoat_target_model_2021b_B.DataTypeConversion4 speedgoat_target_model_2021b_B.DataTypeConversion5 speedgoat_target_model_2021b_B.Subtract speedgoat_target_model_2021b_B.Subtract_b speedgoat_target_model_2021b_B.Subtract_bo speedgoat_target_model_2021b_B.Subtract_d speedgoat_target_model_2021b_B.Subtract_p /end REF_MEASUREMENT
/end GROUP
/begin GROUP speedgoat_target_model_2021b_UDP_Data_Receive_Byte_Unpack__Fifth_set "speedgoat_target_model_2021b/UDP Data Receive/Byte Unpack: Fifth set" /begin REF_CHARACTERISTIC speedgoat_target_model_cal_impl.CurrPoses_Y0 /end REF_CHARACTERISTIC
 /begin REF_MEASUREMENT speedgoat_target_model_2021b_B.CurrPoses speedgoat_target_model_2021b_B.UDPReceive2_o1_m /end REF_MEASUREMENT
/end GROUP
/begin GROUP speedgoat_target_model_2021b_UDP_Data_Receive_Byte_Unpack__First_set "speedgoat_target_model_2021b/UDP Data Receive/Byte Unpack: First set"
 /begin REF_CHARACTERISTIC speedgoat_target_model_cal_impl.Longitudinalvelocity_Y0 speedgoat_target_model_cal_impl.ObjAhead_Y0 speedgoat_target_model_cal_impl.Relativevelocity_Y0 speedgoat_target_model_cal_impl.SceneID_Y0 /end REF_CHARACTERISTIC
 /begin REF_MEASUREMENT speedgoat_target_model_2021b_B.Longitudinalvelocity speedgoat_target_model_2021b_B.ObjAhead speedgoat_target_model_2021b_B.Relativevelocity speedgoat_target_model_2021b_B.SceneID speedgoat_target_model_2021b_B.UDPReceive2_o1_p /end REF_MEASUREMENT
/end GROUP
/begin GROUP speedgoat_target_model_2021b_UDP_Data_Receive_Byte_Unpack__Fourth_set "speedgoat_target_model_2021b/UDP Data Receive/Byte Unpack: Fourth set" /begin REF_CHARACTERISTIC speedgoat_target_model_cal_impl.RefPoses_Y0 /end REF_CHARACTERISTIC
 /begin REF_MEASUREMENT speedgoat_target_model_2021b_B.RefPoses speedgoat_target_model_2021b_B.UDPReceive2_o1_d /end REF_MEASUREMENT
/end GROUP
/begin GROUP speedgoat_target_model_2021b_UDP_Data_Receive_Byte_Unpack__Second_set "speedgoat_target_model_2021b/UDP Data Receive/Byte Unpack: Second set"
 /begin REF_CHARACTERISTIC speedgoat_target_model_cal_impl.D2S_Y0 speedgoat_target_model_cal_impl.ObjectDist_Y0 speedgoat_target_model_cal_impl.Relativedistance_Y0 speedgoat_target_model_cal_impl.TLstate_Y0 /end REF_CHARACTERISTIC
 /begin REF_MEASUREMENT speedgoat_target_model_2021b_B.D2S speedgoat_target_model_2021b_B.ObjectDist speedgoat_target_model_2021b_B.Relativedistance speedgoat_target_model_2021b_B.TLstate speedgoat_target_model_2021b_B.UDPReceive2_o1_o /end REF_MEASUREMENT
/end GROUP
/begin GROUP speedgoat_target_model_2021b_UDP_Data_Receive_Byte_Unpack__Third_set "speedgoat_target_model_2021b/UDP Data Receive/Byte Unpack: Third set"
 /begin REF_CHARACTERISTIC speedgoat_target_model_cal_impl.Curvature_Y0 speedgoat_target_model_cal_impl.Direction_Y0 speedgoat_target_model_cal_impl.yawrate_Y0 /end REF_CHARACTERISTIC
 /begin REF_MEASUREMENT speedgoat_target_model_2021b_B.Curvature speedgoat_target_model_2021b_B.Direction speedgoat_target_model_2021b_B.UDPReceive2_o1 speedgoat_target_model_2021b_B.yawrate /end REF_MEASUREMENT
/end GROUP
/begin GROUP speedgoat_target_model_2021b_UDP_Data_Receive_UDP_Receive__Fifth_set "speedgoat_target_model_2021b/UDP Data Receive/UDP Receive: Fifth set"
 /begin SUB_GROUP speedgoat_target_model_2021b_UDP_Data_Receive_UDP_Receive__Fifth_set_Compare_To_Constant /end SUB_GROUP
 /begin REF_CHARACTERISTIC speedgoat_target_model_cal_impl.Constant_Value_k speedgoat_target_model_cal_impl.Data_Y0 speedgoat_target_model_cal_impl.NumMsg_Y0 speedgoat_target_model_cal_impl.UDPReceive2_fmAddress /end REF_CHARACTERISTIC
 /begin REF_MEASUREMENT speedgoat_target_model_2021b_B.Compare_b speedgoat_target_model_2021b_B.Subtract_bo speedgoat_target_model_2021b_B.UDPReceive2_o1_m speedgoat_target_model_2021b_B.UDPReceive2_o2_c speedgoat_target_model_2021b_B.WhileIterator_e speedgoat_target_model_2021b_DW.Subtract_DWORK1 speedgoat_target_model_2021b_DW.UDPReceive2_PWORK_e0 /end REF_MEASUREMENT
/end GROUP
/begin GROUP speedgoat_target_model_2021b_UDP_Data_Receive_UDP_Receive__Fifth_set_Compare_To_Constant "speedgoat_target_model_2021b/UDP Data Receive/UDP Receive: Fifth set/Compare
To Constant" /begin REF_CHARACTERISTIC speedgoat_target_model_cal_impl.CompareToConstant_const /end REF_CHARACTERISTIC
 /begin REF_MEASUREMENT speedgoat_target_model_2021b_B.Compare_b speedgoat_target_model_2021b_B.UDPReceive2_o2_c /end REF_MEASUREMENT
/end GROUP
/begin GROUP speedgoat_target_model_2021b_UDP_Data_Receive_UDP_Receive__First_set "speedgoat_target_model_2021b/UDP Data Receive/UDP Receive: First set"
 /begin SUB_GROUP speedgoat_target_model_2021b_UDP_Data_Receive_UDP_Receive__First_set_Compare_To_Constant /end SUB_GROUP
 /begin REF_CHARACTERISTIC speedgoat_target_model_cal_impl.Constant_Value_dy speedgoat_target_model_cal_impl.Data_Y0_j speedgoat_target_model_cal_impl.NumMsg_Y0_b speedgoat_target_model_cal_impl.UDPReceive2_fmAddress_e /end REF_CHARACTERISTIC
 /begin REF_MEASUREMENT speedgoat_target_model_2021b_B.Compare_p speedgoat_target_model_2021b_B.Subtract_b speedgoat_target_model_2021b_B.UDPReceive2_o1_p speedgoat_target_model_2021b_B.UDPReceive2_o2_j speedgoat_target_model_2021b_B.WhileIterator_p speedgoat_target_model_2021b_DW.Subtract_DWORK1 speedgoat_target_model_2021b_DW.UDPReceive2_PWORK_e /end REF_MEASUREMENT
/end GROUP
/begin GROUP speedgoat_target_model_2021b_UDP_Data_Receive_UDP_Receive__First_set_Compare_To_Constant "speedgoat_target_model_2021b/UDP Data Receive/UDP Receive: First set/Compare
To Constant" /begin REF_CHARACTERISTIC speedgoat_target_model_cal_impl.CompareToConstant_const_e /end REF_CHARACTERISTIC
 /begin REF_MEASUREMENT speedgoat_target_model_2021b_B.Compare_p speedgoat_target_model_2021b_B.UDPReceive2_o2_j /end REF_MEASUREMENT
/end GROUP
/begin GROUP speedgoat_target_model_2021b_UDP_Data_Receive_UDP_Receive__Fourth_set "speedgoat_target_model_2021b/UDP Data Receive/UDP Receive: Fourth set"
 /begin SUB_GROUP speedgoat_target_model_2021b_UDP_Data_Receive_UDP_Receive__Fourth_set_Compare_To_Constant /end SUB_GROUP
 /begin REF_CHARACTERISTIC speedgoat_target_model_cal_impl.Constant_Value_p speedgoat_target_model_cal_impl.Data_Y0_k speedgoat_target_model_cal_impl.NumMsg_Y0_bf speedgoat_target_model_cal_impl.UDPReceive2_fmAddress_c /end REF_CHARACTERISTIC
 /begin REF_MEASUREMENT speedgoat_target_model_2021b_B.Compare_n speedgoat_target_model_2021b_B.Subtract_d speedgoat_target_model_2021b_B.UDPReceive2_o1_d speedgoat_target_model_2021b_B.UDPReceive2_o2_h speedgoat_target_model_2021b_B.WhileIterator_c speedgoat_target_model_2021b_DW.Subtract_DWORK1 speedgoat_target_model_2021b_DW.UDPReceive2_PWORK_f /end REF_MEASUREMENT
/end GROUP
/begin GROUP speedgoat_target_model_2021b_UDP_Data_Receive_UDP_Receive__Fourth_set_Compare_To_Constant "speedgoat_target_model_2021b/UDP Data Receive/UDP Receive: Fourth set/Compare
To Constant" /begin REF_CHARACTERISTIC speedgoat_target_model_cal_impl.CompareToConstant_const_l /end REF_CHARACTERISTIC
 /begin REF_MEASUREMENT speedgoat_target_model_2021b_B.Compare_n speedgoat_target_model_2021b_B.UDPReceive2_o2_h /end REF_MEASUREMENT
/end GROUP
/begin GROUP speedgoat_target_model_2021b_UDP_Data_Receive_UDP_Receive__Second_set "speedgoat_target_model_2021b/UDP Data Receive/UDP Receive: Second set"
 /begin SUB_GROUP speedgoat_target_model_2021b_UDP_Data_Receive_UDP_Receive__Second_set_Compare_To_Constant /end SUB_GROUP
 /begin REF_CHARACTERISTIC speedgoat_target_model_cal_impl.Constant_Value_g speedgoat_target_model_cal_impl.Data_Y0_ja speedgoat_target_model_cal_impl.NumMsg_Y0_f speedgoat_target_model_cal_impl.UDPReceive2_fmAddress_h /end REF_CHARACTERISTIC
 /begin REF_MEASUREMENT speedgoat_target_model_2021b_B.Compare_j speedgoat_target_model_2021b_B.Subtract_p speedgoat_target_model_2021b_B.UDPReceive2_o1_o speedgoat_target_model_2021b_B.UDPReceive2_o2_o speedgoat_target_model_2021b_B.WhileIterator_k speedgoat_target_model_2021b_DW.Subtract_DWORK1 speedgoat_target_model_2021b_DW.UDPReceive2_PWORK_b /end REF_MEASUREMENT
/end GROUP
/begin GROUP speedgoat_target_model_2021b_UDP_Data_Receive_UDP_Receive__Second_set_Compare_To_Constant "speedgoat_target_model_2021b/UDP Data Receive/UDP Receive: Second set/Compare
To Constant" /begin REF_CHARACTERISTIC speedgoat_target_model_cal_impl.CompareToConstant_const_k /end REF_CHARACTERISTIC
 /begin REF_MEASUREMENT speedgoat_target_model_2021b_B.Compare_j speedgoat_target_model_2021b_B.UDPReceive2_o2_o /end REF_MEASUREMENT
/end GROUP
/begin GROUP speedgoat_target_model_2021b_UDP_Data_Receive_UDP_Receive__Third_set "speedgoat_target_model_2021b/UDP Data Receive/UDP Receive: Third set"
 /begin SUB_GROUP speedgoat_target_model_2021b_UDP_Data_Receive_UDP_Receive__Third_set_Compare_To_Constant /end SUB_GROUP
 /begin REF_CHARACTERISTIC speedgoat_target_model_cal_impl.Constant_Value_j speedgoat_target_model_cal_impl.Data_Y0_l speedgoat_target_model_cal_impl.NumMsg_Y0_c speedgoat_target_model_cal_impl.UDPReceive2_fmAddress_i /end REF_CHARACTERISTIC
 /begin REF_MEASUREMENT speedgoat_target_model_2021b_B.Compare speedgoat_target_model_2021b_B.Subtract speedgoat_target_model_2021b_B.UDPReceive2_o1 speedgoat_target_model_2021b_B.UDPReceive2_o2 speedgoat_target_model_2021b_B.WhileIterator speedgoat_target_model_2021b_DW.Subtract_DWORK1 speedgoat_target_model_2021b_DW.UDPReceive2_PWORK /end REF_MEASUREMENT
/end GROUP
/begin GROUP speedgoat_target_model_2021b_UDP_Data_Receive_UDP_Receive__Third_set_Compare_To_Constant "speedgoat_target_model_2021b/UDP Data Receive/UDP Receive: Third set/Compare
To Constant" /begin REF_CHARACTERISTIC speedgoat_target_model_cal_impl.CompareToConstant_const_g /end REF_CHARACTERISTIC
 /begin REF_MEASUREMENT speedgoat_target_model_2021b_B.Compare speedgoat_target_model_2021b_B.UDPReceive2_o2 /end REF_MEASUREMENT
/end GROUP
/begin GROUP speedgoat_target_model_2021b_UDP_Data_Send "speedgoat_target_model_2021b/UDP Data Send"
 /begin SUB_GROUP speedgoat_target_model_2021b_UDP_Data_Send_Byte_Pack__Controller_Intermediate_Signals speedgoat_target_model_2021b_UDP_Data_Send_Byte_Pack__Controller_Output /end SUB_GROUP
 /begin REF_CHARACTERISTIC speedgoat_target_model_cal_impl.UDPSendControllerIntermediateSi speedgoat_target_model_cal_impl.UDPSendControllerIntermediate_k speedgoat_target_model_cal_impl.UDPSendControllerOutput_toAddre speedgoat_target_model_cal_impl.UDPSendControllerOutput_toPort /end REF_CHARACTERISTIC
 /begin REF_MEASUREMENT speedgoat_target_model_2021b_B.BytePacking speedgoat_target_model_2021b_B.BytePacking1 speedgoat_target_model_2021b_DW.UDPSendControllerIntermediateSi speedgoat_target_model_2021b_DW.UDPSendControllerOutput_PWORK speedgoat_target_model_2_ConstB.Width speedgoat_target_model_2_ConstB.Width1 /end REF_MEASUREMENT
/end GROUP
/begin GROUP speedgoat_target_model_2021b_UDP_Data_Send_Byte_Pack__Controller_Intermediate_Signals "speedgoat_target_model_2021b/UDP Data Send/Byte Pack: Controller Intermediate Signals"
 /begin REF_MEASUREMENT speedgoat_target_model_2021b_B.BytePacking1 speedgoat_target_model_2021b_B.StopSim speedgoat_target_model_2021b_B.Trans /end REF_MEASUREMENT
/end GROUP
/begin GROUP speedgoat_target_model_2021b_UDP_Data_Send_Byte_Pack__Controller_Output "speedgoat_target_model_2021b/UDP Data Send/Byte Pack: Controller Output"
 /begin REF_MEASUREMENT speedgoat_target_model_2021b_B.BytePacking speedgoat_target_model_2021b_B.Merge1 speedgoat_target_model_2021b_B.Merge2 speedgoat_target_model_2021b_B.Saturation /end REF_MEASUREMENT
/end GROUP
/end MODULE
/end PROJECT
